## CMakeLists.txt
```
# SPDX-License-Identifier: Apache-2.0

cmake_minimum_required(VERSION 3.20.0)

find_package(Zephyr REQUIRED HINTS $ENV{ZEPHYR_BASE})
project(flight_controller)

target_compile_definitions(app PRIVATE
    USE_CPU
    USE_TYPE=float32
)

set(ACCEL_TINY_MPC_DIR /home/mihir/Accelerated-TinyMPC)

# Add all source files
target_sources(app PRIVATE
    src/main.c
    src/attitude_estimator_madgwick.c
    src/control_task.cpp
    src/state.c
    ../drone_control/madgwick_test/src/madgwick_wrapper.cc
    #../drone_control/tinympc/external/admm/src/admm_rvv.cpp
    #../drone_control/tinympc/external/matlib/src/matlib.cpp
    #../drone_control/src/main_tracking.cpp 
    ${ACCEL_TINY_MPC_DIR}/external/admm/src/admm_matlib.cpp
    ${ACCEL_TINY_MPC_DIR}/external/matlib/src/matlib.cpp
)

#target_compile_definitions(app PRIVATE
#    USE_RVV
#)



# Include directories
target_include_directories(app PRIVATE
    #${CMAKE_CURRENT_SOURCE_DIR}/../drone_control/eigen_shim
    #${ZEPHYR_BASE}/../modules/lib/eigen

    ${CMAKE_CURRENT_SOURCE_DIR}/../drone_control/tinympc/examples
    ${CMAKE_CURRENT_SOURCE_DIR}/../drone_control/tinympc/examples/problem_data

    ${CMAKE_CURRENT_SOURCE_DIR}/../drone_control/madgwick_test/src
    ${CMAKE_CURRENT_SOURCE_DIR}/../drone_control/ento-bench/src
    ${CMAKE_CURRENT_SOURCE_DIR}/../drone_control
    #${CMAKE_CURRENT_SOURCE_DIR}/../drone_control/tinympc/include
    #${CMAKE_CURRENT_SOURCE_DIR}/../drone_control/tinympc/external/admm/include
    #${CMAKE_CURRENT_SOURCE_DIR}/../drone_control/tinympc/external/matlib/include

    ${ACCEL_TINY_MPC_DIR}/include
    ${ACCEL_TINY_MPC_DIR}/external/admm/include
    ${ACCEL_TINY_MPC_DIR}/external/matlib/include
    ${ACCEL_TINY_MPC_DIR}/external/matlib/include/float32
    #${ACCEL_TINY_MPC_DIR}/external/matlib/include/float64
    #${ACCEL_TINY_MPC_DIR}/external/matlib/include/int32
)

target_include_directories(app PRIVATE
    ${CMAKE_CURRENT_SOURCE_DIR}/../drone_control/eigen_shim
    ${ZEPHYR_BASE}/../modules/lib/eigen
)

# add_subdirectory(../drone_control/tinympc tinympc_build)
```

## Kconfig
```
# SPDX-License-Identifier: Apache-2.0

mainmenu "Flight Controller Configuration"

config ATTITUDE_ESTIMATOR_FREQUENCY
	int "Attitude estimator frequency (Hz)"
	default 200
	range 10 1000
	help
	  Frequency at which the attitude estimator runs.
	  Higher frequencies provide better responsiveness but use more CPU.

config ATTITUDE_ESTIMATOR_STACK_SIZE
	int "Attitude estimator thread stack size"
	default 2048
	help
	  Stack size for the attitude estimator thread.

source "Kconfig.zephyr"
```

## sample.yaml
```
sample:
  description: Flight controller application with attitude estimation
  name: flight controller
common:
  tags: sensor control
  integration_platforms:
    - native_sim
  harness: console
  harness_config:
    type: one_line
    regex:
      - "Flight Controller.*"
tests:
  sample.basic.flight_controller:
    tags: sensor control
```

## prj.conf
```kconfig
CONFIG_SENSOR=y
CONFIG_BMI08X=y
CONFIG_I2C=y

# Threading support
CONFIG_MULTITHREADING=y

# Logging
CONFIG_LOG=y
# Enable asynchronous logging to prevent blocking on UART transmission
CONFIG_LOG_MODE_DEFERRED=y
# Increase log buffer size for better throughput
CONFIG_LOG_BUFFER_SIZE=8192
# Enable UART backend for logging
CONFIG_LOG_BACKEND_UART=y
# Use immediate flush for better real-time behavior (optional, can remove if still slow)
# CONFIG_LOG_BACKEND_UART_OUTPUT_DICTIONARY=n
# CONFIG_LOG_BACKEND_UART_OUTPUT_TIMESTAMP=y

# Stack sizes
CONFIG_MAIN_STACK_SIZE=2048
CONFIG_ATTITUDE_ESTIMATOR_STACK_SIZE=2048

# Attitude estimator configuration
CONFIG_ATTITUDE_ESTIMATOR_FREQUENCY=200

CONFIG_CPP=y
CONFIG_REQUIRES_FULL_LIBCPP=y

CONFIG_XIP=n
CONFIG_FLASH_LOAD_OFFSET=0
```

## src/main.c
```c
#include <zephyr/kernel.h>
#include <zephyr/logging/log.h>

#include "attitude_estimator.h"
#include "control_task.h"

LOG_MODULE_REGISTER(main, CONFIG_LOG_DEFAULT_LEVEL);

int main(void)
{
    int ret;
    struct attitude att;

    LOG_INF("Flight Controller Starting...");

    /* --- Initialize attitude estimator --- */
    ret = attitude_estimator_init();
    if (ret < 0) {
        LOG_ERR("Failed to initialize attitude estimator: %d", ret);
        return ret;
    }

    /* --- Start attitude estimator thread --- */
    ret = attitude_estimator_start();
    if (ret < 0) {
        LOG_ERR("Failed to start attitude estimator: %d", ret);
        return ret;
    }

    /* --- Start control task (TinyMPC runs inside this) --- */
    control_task_start();

    LOG_INF("Flight Controller Initialized");

    /* --- Optional monitoring loop --- */
    while (1) {
        if (attitude_estimator_get(&att) == 0) {
            LOG_INF("Attitude [deg] r=%.2f p=%.2f y=%.2f",
                    att.roll, att.pitch, att.yaw);
        }
        k_msleep(100);
    }

    return 0;
}
```

## src/attitude_estimator.c
```c
/*
 * SPDX-License-Identifier: Apache-2.0
 */

#include "attitude_estimator.h"
#include <zephyr/kernel.h>
#include <zephyr/device.h>
#include <zephyr/drivers/sensor.h>
#include <zephyr/logging/log.h>
#include <math.h>
#include <stdio.h>

LOG_MODULE_REGISTER(attitude_estimator, CONFIG_LOG_DEFAULT_LEVEL);

/* Get device tree nodes for accelerometer and gyroscope */
#define BMI088_ACCEL_NODE DT_ALIAS(bmi088_accel)
#define BMI088_GYRO_NODE DT_ALIAS(bmi088_gyro)

#if !DT_NODE_EXISTS(BMI088_ACCEL_NODE)
#error "BMI088 accelerometer alias 'bmi088-accel' not defined in device tree"
#endif

#if !DT_NODE_EXISTS(BMI088_GYRO_NODE)
#error "BMI088 gyroscope alias 'bmi088-gyro' not defined in device tree"
#endif

static const struct device *accel_dev = DEVICE_DT_GET(BMI088_ACCEL_NODE);
static const struct device *gyro_dev = DEVICE_DT_GET(BMI088_GYRO_NODE);

/* Configuration */
#ifndef CONFIG_ATTITUDE_ESTIMATOR_FREQUENCY
#define CONFIG_ATTITUDE_ESTIMATOR_FREQUENCY 200
#endif

#ifndef CONFIG_ATTITUDE_ESTIMATOR_STACK_SIZE
#define CONFIG_ATTITUDE_ESTIMATOR_STACK_SIZE 2048
#endif

#define ESTIMATOR_FREQUENCY CONFIG_ATTITUDE_ESTIMATOR_FREQUENCY
#define ESTIMATOR_PERIOD_MS (1000 / ESTIMATOR_FREQUENCY)
#define ESTIMATOR_PERIOD_US ((1000000LL) / ESTIMATOR_FREQUENCY)
#define COMPLEMENTARY_FILTER_ALPHA 0.98f  /* Gyro weight (0-1), higher = trust gyro more */

/* Thread and synchronization */
static struct k_thread estimator_thread;
static K_THREAD_STACK_DEFINE(estimator_stack, CONFIG_ATTITUDE_ESTIMATOR_STACK_SIZE);
static volatile bool estimator_running = false;
static struct k_mutex attitude_mutex;

/* Current attitude estimate */
static struct attitude current_attitude = {0.0f, 0.0f, 0.0f};

/**
 * @brief Complementary filter for attitude estimation
 *
 * This combines accelerometer (for roll/pitch) and gyroscope (for all axes)
 * to estimate the drone's attitude.
 *
 * @param accel Accelerometer data (m/s^2)
 * @param gyro Gyroscope data (rad/s)
 * @param dt Time step in seconds
 * @param attitude Output attitude estimate
 */
static void complementary_filter(const float accel[3], const float gyro[3],
				 float dt, struct attitude *attitude)
{
	/* Calculate roll and pitch from accelerometer (assuming gravity is dominant) */
	float accel_roll = atan2f(accel[1], accel[2]);
	float accel_pitch = atan2f(-accel[0], sqrtf(accel[1] * accel[1] + accel[2] * accel[2]));

	/* Integrate gyroscope to get attitude change */
	float gyro_roll = attitude->roll + gyro[0] * dt;
	float gyro_pitch = attitude->pitch + gyro[1] * dt;
	float gyro_yaw = attitude->yaw + gyro[2] * dt;

	/* Complementary filter: blend accelerometer and gyroscope */
	attitude->roll = COMPLEMENTARY_FILTER_ALPHA * gyro_roll +
			 (1.0f - COMPLEMENTARY_FILTER_ALPHA) * accel_roll;
	attitude->pitch = COMPLEMENTARY_FILTER_ALPHA * gyro_pitch +
			  (1.0f - COMPLEMENTARY_FILTER_ALPHA) * accel_pitch;
	attitude->yaw = gyro_yaw; /* Yaw from gyro only (no magnetometer) */
}

/**
 * @brief Attitude estimator thread
 */
static void attitude_estimator_thread(void *arg1, void *arg2, void *arg3)
{
	struct sensor_value accel[3], gyro[3];
	int ret;
	float accel_f[3], gyro_f[3];
	int64_t last_time = k_uptime_get();
	int64_t current_time;
	float dt;

	LOG_INF("Attitude estimator thread started");

	while (estimator_running) {
		current_time = k_uptime_get();
		dt = (current_time - last_time) / 1000.0f;  /* Convert to seconds */
		last_time = current_time;

		/* Read accelerometer */
		ret = sensor_sample_fetch(accel_dev);
		if (ret < 0) {
			LOG_ERR("Failed to fetch accelerometer sample: %d", ret);
			k_msleep(ESTIMATOR_PERIOD_MS);
			continue;
		}

		ret = sensor_channel_get(accel_dev, SENSOR_CHAN_ACCEL_XYZ, accel);
		if (ret < 0) {
			LOG_ERR("Failed to get accelerometer data: %d", ret);
			k_msleep(ESTIMATOR_PERIOD_MS);
			continue;
		}

		/* Read gyroscope */
		ret = sensor_sample_fetch(gyro_dev);
		if (ret < 0) {
			LOG_ERR("Failed to fetch gyroscope sample: %d", ret);
			k_msleep(ESTIMATOR_PERIOD_MS);
			continue;
		}

		ret = sensor_channel_get(gyro_dev, SENSOR_CHAN_GYRO_XYZ, gyro);
		if (ret < 0) {
			LOG_ERR("Failed to get gyroscope data: %d", ret);
			k_msleep(ESTIMATOR_PERIOD_MS);
			continue;
		}

		/* Convert sensor values to float */
		accel_f[0] = sensor_value_to_double(&accel[0]);
		accel_f[1] = sensor_value_to_double(&accel[1]);
		accel_f[2] = sensor_value_to_double(&accel[2]);

		gyro_f[0] = sensor_value_to_double(&gyro[0]);
		gyro_f[1] = sensor_value_to_double(&gyro[1]);
		gyro_f[2] = sensor_value_to_double(&gyro[2]);

		/* Update attitude estimate */
		k_mutex_lock(&attitude_mutex, K_FOREVER);
		complementary_filter(accel_f, gyro_f, dt, &current_attitude);
		k_mutex_unlock(&attitude_mutex);

		/* Sleep until next iteration - use microseconds for better precision */
		if (ESTIMATOR_PERIOD_MS > 0) {
			k_msleep(ESTIMATOR_PERIOD_MS);
		} else {
			k_usleep(ESTIMATOR_PERIOD_US);
		}
	}

	LOG_INF("Attitude estimator thread stopped");
}

int attitude_estimator_init(void)
{
	int ret;

	/* Check if accelerometer device is ready */
	if (!device_is_ready(accel_dev)) {
		LOG_ERR("Accelerometer device is not ready");
		return -ENODEV;
	}

	/* Check if gyroscope device is ready */
	if (!device_is_ready(gyro_dev)) {
		LOG_ERR("Gyroscope device is not ready");
		return -ENODEV;
	}

	/* Initialize mutex */
	k_mutex_init(&attitude_mutex);

	LOG_INF("Attitude estimator initialized (frequency: %d Hz)", ESTIMATOR_FREQUENCY);

	return 0;
}

int attitude_estimator_get(struct attitude *attitude)
{
	if (attitude == NULL) {
		return -EINVAL;
	}

	k_mutex_lock(&attitude_mutex, K_FOREVER);
	*attitude = current_attitude;
	k_mutex_unlock(&attitude_mutex);

	return 0;
}

int attitude_estimator_start(void)
{
	if (estimator_running) {
		return -EALREADY;
	}

	estimator_running = true;

	k_thread_create(&estimator_thread, estimator_stack,
			K_THREAD_STACK_SIZEOF(estimator_stack),
			attitude_estimator_thread,
			NULL, NULL, NULL,
			K_PRIO_COOP(7), 0, K_NO_WAIT);

	k_thread_name_set(&estimator_thread, "attitude_estimator");

	LOG_INF("Attitude estimator started");

	return 0;
}

int attitude_estimator_stop(void)
{
	if (!estimator_running) {
		return -EALREADY;
	}

	estimator_running = false;
	k_thread_join(&estimator_thread, K_FOREVER);

	LOG_INF("Attitude estimator stopped");

	return 0;
}
```

## src/attitude_estimator.h
```c
/*
 * SPDX-License-Identifier: Apache-2.0
 */

#ifndef ATTITUDE_ESTIMATOR_H
#define ATTITUDE_ESTIMATOR_H

#include <zephyr/kernel.h>

/* Attitude estimation result */
struct attitude {
	float roll;   /* Roll angle in radians */
	float pitch;  /* Pitch angle in radians */
	float yaw;    /* Yaw angle in radians */
};

/**
 * @brief Initialize the attitude estimator
 *
 * @return 0 on success, negative error code on failure
 */
int attitude_estimator_init(void);

/**
 * @brief Get the current attitude estimate
 *
 * @param attitude Pointer to attitude structure to fill
 * @return 0 on success, negative error code on failure
 */
int attitude_estimator_get(struct attitude *attitude);

/**
 * @brief Start the attitude estimator task
 *
 * @return 0 on success, negative error code on failure
 */
int attitude_estimator_start(void);

/**
 * @brief Stop the attitude estimator task
 *
 * @return 0 on success, negative error code on failure
 */
int attitude_estimator_stop(void);

#endif /* ATTITUDE_ESTIMATOR_H */
```

## src/attitude_estimator_madgwick.c
```c
#include "attitude_estimator.h"
#include <zephyr/kernel.h>
#include <zephyr/device.h>
#include <zephyr/drivers/sensor.h>
#include <zephyr/logging/log.h>
#include <math.h>
#ifndef M_PI
#define M_PI 3.14159265358979323846f
#endif
#include <stdio.h>

#include "madgwick_wrapper.h"

LOG_MODULE_REGISTER(attitude_estimator, CONFIG_LOG_DEFAULT_LEVEL);

#define BMI088_ACCEL_NODE DT_ALIAS(bmi088_accel)
#define BMI088_GYRO_NODE DT_ALIAS(bmi088_gyro)

#if !DT_NODE_EXISTS(BMI088_ACCEL_NODE)
#error "BMI088 accelerometer alias 'bmi088-accel' not defined in device tree"
#endif

#if !DT_NODE_EXISTS(BMI088_GYRO_NODE)
#error "BMI088 gyroscope alias 'bmi088-gyro' not defined in device tree"
#endif

static const struct device *accel_dev = DEVICE_DT_GET(BMI088_ACCEL_NODE);
static const struct device *gyro_dev = DEVICE_DT_GET(BMI088_GYRO_NODE);

#ifndef CONFIG_ATTITUDE_ESTIMATOR_FREQUENCY
#define CONFIG_ATTITUDE_ESTIMATOR_FREQUENCY 200
#endif

#ifndef CONFIG_ATTITUDE_ESTIMATOR_STACK_SIZE
#define CONFIG_ATTITUDE_ESTIMATOR_STACK_SIZE 2048
#endif

#define ESTIMATOR_FREQUENCY CONFIG_ATTITUDE_ESTIMATOR_FREQUENCY
#define ESTIMATOR_PERIOD_MS (1000 / ESTIMATOR_FREQUENCY)
#define ESTIMATOR_PERIOD_US ((1000000LL) / ESTIMATOR_FREQUENCY)
#define COMPLEMENTARY_FILTER_ALPHA 0.98f  

static struct k_thread estimator_thread;
static K_THREAD_STACK_DEFINE(estimator_stack, CONFIG_ATTITUDE_ESTIMATOR_STACK_SIZE);
static volatile bool estimator_running = false;
static struct k_mutex attitude_mutex;

static struct attitude current_attitude = {0.0f, 0.0f, 0.0f};

static void attitude_estimator_thread(void *arg1, void *arg2, void *arg3)
{
    struct sensor_value accel[3], gyro[3];
    int ret;
    float accel_f[3], gyro_f[3];
    int64_t last_time = k_uptime_get();
    int64_t current_time;
    float dt;
    int log_counter = 0;  

    LOG_INF("Attitude estimator thread started (Madgwick)");

    while (estimator_running) {
        current_time = k_uptime_get();
        dt = (current_time - last_time) / 1000.0f;  
        last_time = current_time;

        ret = sensor_sample_fetch(accel_dev);
        if (ret < 0) {
            LOG_ERR("Failed to fetch accelerometer sample: %d", ret);
            k_msleep(ESTIMATOR_PERIOD_MS);
            continue;
        }

        ret = sensor_channel_get(accel_dev, SENSOR_CHAN_ACCEL_XYZ, accel);
        if (ret < 0) {
            LOG_ERR("Failed to get accelerometer data: %d", ret);
            k_msleep(ESTIMATOR_PERIOD_MS);
            continue;
        }

        ret = sensor_sample_fetch(gyro_dev);
        if (ret < 0) {
            LOG_ERR("Failed to fetch gyroscope sample: %d", ret);
            k_msleep(ESTIMATOR_PERIOD_MS);
            continue;
        }

        ret = sensor_channel_get(gyro_dev, SENSOR_CHAN_GYRO_XYZ, gyro);
        if (ret < 0) {
            LOG_ERR("Failed to get gyroscope data: %d", ret);
            k_msleep(ESTIMATOR_PERIOD_MS);
            continue;
        }

        accel_f[0] = sensor_value_to_double(&accel[0]);
        accel_f[1] = sensor_value_to_double(&accel[1]);
        accel_f[2] = sensor_value_to_double(&accel[2]);

        gyro_f[0] = sensor_value_to_double(&gyro[0]);
        gyro_f[1] = sensor_value_to_double(&gyro[1]);
        gyro_f[2] = sensor_value_to_double(&gyro[2]);

        float qw, qx, qy, qz;
        run_madgwick_sample(
            gyro_f[0], gyro_f[1], gyro_f[2],
            accel_f[0], accel_f[1], accel_f[2],
            0.0f, 0.0f, 0.0f,   
            dt,
            &qw, &qx, &qy, &qz
        );

        float roll  = atan2f(2*(qw*qx + qy*qz), 1 - 2*(qx*qx + qy*qy)) * 180.0f / M_PI;
        float pitch = asinf(2*(qw*qy - qz*qx)) * 180.0f / M_PI;
        float yaw   = atan2f(2*(qw*qz + qx*qy), 1 - 2*(qy*qy + qz*qz)) * 180.0f / M_PI;

        k_mutex_lock(&attitude_mutex, K_FOREVER);
        current_attitude.roll  = roll;
        current_attitude.pitch = pitch;
        current_attitude.yaw   = yaw;
        k_mutex_unlock(&attitude_mutex);

        log_counter++;
        if (log_counter % 100 == 0) {  
            LOG_INF("Madgwick Q: qw=%.6f qx=%.6f qy=%.6f qz=%.6f", qw, qx, qy, qz);
            LOG_INF("Roll: %.2f, Pitch: %.2f, Yaw: %.2f", roll, pitch, yaw);
        }

        if (ESTIMATOR_PERIOD_MS > 0) {
            k_msleep(ESTIMATOR_PERIOD_MS);
        } else {
            k_usleep(ESTIMATOR_PERIOD_US);
        }
    }

    LOG_INF("Attitude estimator thread stopped");
}


int attitude_estimator_init(void)
{
    if (!device_is_ready(accel_dev)) {
        LOG_ERR("Accelerometer device is not ready");
        return -ENODEV;
    }
    if (!device_is_ready(gyro_dev)) {
        LOG_ERR("Gyroscope device is not ready");
        return -ENODEV;
    }

    k_mutex_init(&attitude_mutex);
    LOG_INF("Attitude estimator initialized (frequency: %d Hz)", ESTIMATOR_FREQUENCY);
    return 0;
}

int attitude_estimator_start(void)
{
    if (estimator_running) return -EALREADY;

    estimator_running = true;
    k_thread_create(&estimator_thread, estimator_stack,
                    K_THREAD_STACK_SIZEOF(estimator_stack),
                    attitude_estimator_thread,
                    NULL, NULL, NULL,
                    K_PRIO_COOP(7), 0, K_NO_WAIT);
    k_thread_name_set(&estimator_thread, "attitude_estimator");

    LOG_INF("Attitude estimator started");
    return 0;
}

int attitude_estimator_stop(void)
{
    if (!estimator_running) return -EALREADY;

    estimator_running = false;
    k_thread_join(&estimator_thread, K_FOREVER);

    LOG_INF("Attitude estimator stopped");
    return 0;
}

int attitude_estimator_get(struct attitude *attitude)
{
    if (!attitude) return -EINVAL;

    k_mutex_lock(&attitude_mutex, K_FOREVER);
    *attitude = current_attitude;
    k_mutex_unlock(&attitude_mutex);

    return 0;
}

// create control task to launch in main file
// creates shared memory for state and controller can read from that to get position
// set position to 0 for now since madgwick is giving attitude
// feed magwick into mpc model and put position and velocity? as 0 for now
```

## src/attitude_estimator_madgwick_control.c
```c
/*
 * SPDX-License-Identifier: Apache-2.0
 */

#include <zephyr/kernel.h>
#include <zephyr/device.h>
#include <zephyr/drivers/sensor.h>
#include <zephyr/logging/log.h>
#include <math.h>

#include "attitude_estimator.h"
#include "madgwick_wrapper.h"

LOG_MODULE_REGISTER(attitude_estimator, CONFIG_LOG_DEFAULT_LEVEL);

static struct attitude att_state = {0};
static struct k_mutex att_mutex;

static bool running = false;
static bool initialized = false;


#define ATT_THREAD_STACK 2048
#define ATT_THREAD_PRIO  5

K_THREAD_STACK_DEFINE(att_stack, ATT_THREAD_STACK);
static struct k_thread att_thread;

static const struct device *imu;

#define ATT_UPDATE_HZ 200
#define ATT_UPDATE_MS (1000 / ATT_UPDATE_HZ)

static void quaternion_to_rpy(float qw, float qx, float qy, float qz,
                              float *roll, float *pitch, float *yaw)
{
    *roll  = atan2f(2.0f*(qw*qx + qy*qz),
                    1.0f - 2.0f*(qx*qx + qy*qy));
    *pitch = asinf(2.0f*(qw*qy - qz*qx));
    *yaw   = atan2f(2.0f*(qw*qz + qx*qy),
                    1.0f - 2.0f*(qy*qy + qz*qz));
}

static void attitude_thread_fn(void *p1, void *p2, void *p3)
{
    imu = DEVICE_DT_GET_ANY(invensense_mpu6050);
    if (!imu || !device_is_ready(imu)) {
        LOG_ERR("IMU not found or not ready");
        running = false;
        return;
    }

    LOG_INF("Attitude estimator started at %d Hz", ATT_UPDATE_HZ);

    uint64_t last_log = 0;

    while (running) {

        sensor_sample_fetch(imu);

        struct sensor_value ax, ay, az;
        struct sensor_value gx, gy, gz;

        sensor_channel_get(imu, SENSOR_CHAN_ACCEL_X, &ax);
        sensor_channel_get(imu, SENSOR_CHAN_ACCEL_Y, &ay);
        sensor_channel_get(imu, SENSOR_CHAN_ACCEL_Z, &az);
        sensor_channel_get(imu, SENSOR_CHAN_GYRO_X,  &gx);
        sensor_channel_get(imu, SENSOR_CHAN_GYRO_Y,  &gy);
        sensor_channel_get(imu, SENSOR_CHAN_GYRO_Z,  &gz);

        float ax_f = sensor_value_to_double(&ax);
        float ay_f = sensor_value_to_double(&ay);
        float az_f = sensor_value_to_double(&az);
        float gx_f = sensor_value_to_double(&gx);
        float gy_f = sensor_value_to_double(&gy);
        float gz_f = sensor_value_to_double(&gz);

        float qw, qx, qy, qz;

        float dt = 1.0f / ATT_UPDATE_HZ;

        run_madgwick_sample(gx_f, gy_f, gz_f,
                            ax_f, ay_f, az_f,
                            0, 0, 0,       
                            dt,
                            &qw, &qx, &qy, &qz);

        float roll, pitch, yaw;
        quaternion_to_rpy(qw, qx, qy, qz, &roll, &pitch, &yaw);

        /* Save into shared state */
        k_mutex_lock(&att_mutex, K_FOREVER);
        att_state.roll  = roll;
        att_state.pitch = pitch;
        att_state.yaw   = yaw;
        k_mutex_unlock(&att_mutex);

        /* Log at 10 Hz */
        uint64_t now = k_uptime_get();
        if (now - last_log > 100) {
            last_log = now;
            LOG_INF("RPY: %.2f %.2f %.2f", roll, pitch, yaw);
        }

        k_msleep(ATT_UPDATE_MS);
    }

    LOG_INF("Attitude estimator stopped.");
}


int attitude_estimator_init(void)
{
    if (initialized)
        return 0;

    k_mutex_init(&att_mutex);
    initialized = true;
    return 0;
}

int attitude_estimator_start(void)
{
    if (!initialized)
        return -EINVAL;

    if (running)
        return 0;

    running = true;

    k_thread_create(&att_thread,
                    att_stack,
                    K_THREAD_STACK_SIZEOF(att_stack),
                    attitude_thread_fn,
                    NULL, NULL, NULL,
                    ATT_THREAD_PRIO,
                    0,
                    K_NO_WAIT);

    k_thread_name_set(&att_thread, "attitude_estimator");
    return 0;
}

int attitude_estimator_stop(void)
{
    if (!running)
        return 0;

    running = false;
    return 0;
}

int attitude_estimator_get(struct attitude *out)
{
    if (!initialized || !out)
        return -EINVAL;

    k_mutex_lock(&att_mutex, K_FOREVER);
    *out = att_state;
    k_mutex_unlock(&att_mutex);

    return 0;
}
```

## src/control_task.cpp
```c
// CURRENT VERSION

#include <zephyr/kernel.h>
#include <zephyr/logging/log.h>
#include <cstring>
#include <cstdint>

#include "attitude_estimator.h"

#include <admm.hpp>
#include <glob_opts.hpp>
#include <quadrotor_50hz_params_constrained.hpp>
#include "types_eigen.hpp"

LOG_MODULE_REGISTER(control_task, CONFIG_LOG_DEFAULT_LEVEL);

#define CONTROL_HZ 100
#define CONTROL_MS (1000 / CONTROL_HZ)
#define CONTROL_STACK_SIZE 4096
#define CONTROL_PRIORITY 6

K_THREAD_STACK_DEFINE(control_stack, CONTROL_STACK_SIZE);
static struct k_thread control_tid;


static TinySolver solver;
static TinyCache cache;
static TinyWorkspace work;
static TinySettings settings;

static void control_thread_fn(void *, void *, void *)
{
    LOG_INF("Control task started at %d Hz", CONTROL_HZ);

    solver.cache    = &cache;
    solver.work     = &work;
    solver.settings = &settings;
    tiny_init(&solver);

    tiny_VectorNx_init(&work.x);
    tiny_VectorNu_init(&work.u);

    cache.rho = rho_value;

    matsetv(cache.Kinf.data, Kinf_data, cache.Kinf.outer, cache.Kinf.inner);
    transpose(cache.Kinf.data, cache.KinfT.data, NINPUTS, NSTATES);
    matsetv(cache.Pinf.data, Pinf_data, cache.Pinf.outer, cache.Pinf.inner);
    transpose(cache.Pinf.data, cache.PinfT.data, NSTATES, NSTATES);
    matsetv(cache.Quu_inv.data, Quu_inv_data, cache.Quu_inv.outer, cache.Quu_inv.inner);
    matsetv(cache.AmBKt.data, AmBKt_data, cache.AmBKt.outer, cache.AmBKt.inner);
    transpose(cache.AmBKt.data, cache.AmBKtT.data, NSTATES, NSTATES);
    matsetv(cache.coeff_d2p.data, coeff_d2p_data, cache.coeff_d2p.outer, cache.coeff_d2p.inner);

    matsetv(work.Adyn.data, Adyn_data, work.Adyn.outer, work.Adyn.inner);
    transpose(work.Adyn.data, work.AdynT.data, NSTATES, NSTATES);
    matsetv(work.Bdyn.data, Bdyn_data, work.Bdyn.outer, work.Bdyn.inner);
    transpose(work.Bdyn.data, work.BdynT.data, NSTATES, NINPUTS);
    matsetv(work.Q.data, Q_data, work.Q.outer, work.Q.inner);
    matsetv(work.R.data, R_data, work.R.outer, work.R.inner);

    matset(work.u_min.data, -0.583f, work.u_min.outer, work.u_min.inner);
    matset(work.u_max.data, 0.417f, work.u_max.outer, work.u_max.inner);
    matset(work.x_min.data, -5.0f, work.x_min.outer, work.x_min.inner);
    matset(work.x_max.data, 5.0f, work.x_max.outer, work.x_max.inner);

    float Xref_origin[NSTATES] = {0};
    for (int j = 0; j < NHORIZON; j++) {
        matsetv(work.Xref.vector[j], Xref_origin, 1, NSTATES);
    }

    struct attitude att, prev_att = {0};
    attitude_estimator_get(&prev_att);

    float dt_s = 1.0f / (float)CONTROL_HZ;
    uint64_t last_time = k_uptime_get();

    while (true) {
        uint64_t t0 = k_uptime_get();

        if (attitude_estimator_get(&att) != 0) att = prev_att;

        float roll_rate  = (att.roll  - prev_att.roll)  / dt_s;
        float pitch_rate = (att.pitch - prev_att.pitch) / dt_s;
        float yaw_rate   = (att.yaw   - prev_att.yaw)   / dt_s;
        prev_att = att;

        float x[NSTATES] = {0};
        x[0] = att.roll;
        x[1] = att.pitch;
        x[2] = att.yaw;
        x[3] = roll_rate;
        x[4] = pitch_rate;
        x[5] = yaw_rate;

        memcpy(work.x.vector[0], x, NSTATES * sizeof(float));
        matset(work.y.data, 0.0f, work.y.outer, work.y.inner);
        matset(work.g.data, 0.0f, work.g.outer, work.g.inner);

        tiny_solve(&solver);

        float* u = work.u.vector[0];

        LOG_INF("att r=%.3f p=%.3f y=%.3f | u0=%.3f u1=%.3f u2=%.3f u3=%.3f",
                att.roll, att.pitch, att.yaw,
                u[0], u[1], u[2], u[3]);

        uint64_t elapsed = k_uptime_get() - t0;
        int64_t sleep_ms = (int64_t)CONTROL_MS - (int64_t)elapsed;
        if (sleep_ms > 0) k_msleep((uint32_t)sleep_ms);
        else k_yield();
    }
}


void control_task_start()
{
    k_thread_create(&control_tid, control_stack, K_THREAD_STACK_SIZEOF(control_stack),
                    control_thread_fn, nullptr, nullptr, nullptr,
                    CONTROL_PRIORITY, 0, K_NO_WAIT);
    k_thread_name_set(&control_tid, "control_task");
}
```

## src/control_task.h
```c
#pragma once

#ifdef __cplusplus
extern "C" {
#endif

void control_task_start(void);

#ifdef __cplusplus
}
#endif
```

## src/state.c
```c
#include "state.h"

struct fc_state shared_state = {
    .roll = 0,
    .pitch = 0,
    .yaw = 0,
    .px = 0,
    .py = 0,
    .pz = 0,
    .vx = 0,
    .vy = 0,
    .vz = 0
};

struct k_mutex state_mutex;
```

## src/state.h
```c
#pragma once

#include <zephyr/kernel.h>

struct fc_state {
    float roll;
    float pitch;
    float yaw;

    float px;
    float py;
    float pz;

    float vx;
    float vy;
    float vz;
};

extern struct fc_state shared_state;
extern struct k_mutex state_mutex;
```

## src/tinympc_wrapper.h
```c
#pragma once

#ifdef __cplusplus
extern "C" {
#endif

/**
 * tinympc_solve
 * @param x_in   pointer to state vector array; length STATE_LEN
 * @param u_out  pointer to output array; length U_LEN
 *
 * Implement this wrapper to call TinyMPC solver (tiny_init/tiny_solve etc.)
 * or for now return dummy safety outputs.
 */
#define STATE_LEN 12   
#define U_LEN 4      

void tinympc_solve(const float *x_in, float *u_out);

#ifdef __cplusplus
}
#endif
```
