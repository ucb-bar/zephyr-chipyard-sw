## CMakeLists.txt
```
# SPDX-License-Identifier: Apache-2.0

cmake_minimum_required(VERSION 3.20.0)

find_package(Zephyr REQUIRED HINTS $ENV{ZEPHYR_BASE})
project(hello_world)

# target_sources(app PRIVATE src/main.c)
target_sources(app PRIVATE src/main_zvfh.c)
```

## prj.conf
```kconfig
CONFIG_RISCV_ISA_EXT_ZFH=y
CONFIG_RISCV_ISA_EXT_ZVFH=y
CONFIG_RISCV_ISA_EXT_V=y
```

## src/main.c
```c
/*
 * Copyright (c) 2025 Dima Nikiforov
 *
 * SPDX-License-Identifier: Apache-2.0
 */

#include <stdio.h>
#include <stdint.h>
#include <inttypes.h>
#include <string.h>
#include <zephyr/sys/reboot.h>

/* ---- helpers to view raw 16-bit encodings ---- */
static inline uint16_t f16_bits(_Float16 x) {
    union { _Float16 f; uint16_t u; } v;
    v.f = x;
    return v.u;
}

#if defined(__BFLT16_MANT_DIG__) || defined(__FLT16_BF16__)
static inline uint16_t bf16_bits(__bf16 x) {
    union { __bf16 f; uint16_t u; } v;
    v.f = x;
    return v.u;
}
#endif

static void print_f16(const char *label, _Float16 x) {
    printf("%-24s = % .8f  (bits 0x%04" PRIx16 ")\n", label, (double)x, f16_bits(x));
}

#if defined(__BFLT16_MANT_DIG__) || defined(__FLT16_BF16__)
static void print_bf16(const char *label, __bf16 x) {
    float as_f = (float)x;
    printf("%-24s = % .8f  (bits 0x%04" PRIx16 ")\n", label, (double)as_f, bf16_bits(x));
}
#endif

/* ---- create a small runtime-only seed (not constant-foldable) ---- */
static __attribute__((noinline)) uint32_t runtime_seed(void) {
    /* Walk the board string via a volatile pointer so loads can't be elided/folded */
    volatile const char *vp = CONFIG_BOARD_TARGET;
    uint32_t h = 2166136261u;          /* FNV-ish */
    for (size_t i = 0; vp[i] != '\0'; ++i) {
        h ^= (uint8_t)vp[i];
        h *= 16777619u;
    }
    /* Mix in a stack address to avoid the compiler treating it as a pure function */
    uintptr_t spish = (uintptr_t)&vp;
    h ^= (uint32_t)spish;
    h ^= (uint32_t)(spish >> 11);
    return h ? h : 1u;
}

/* ---- FP16 dynamic arithmetic that must execute at runtime ---- */
static __attribute__((noinline)) _Float16 f16_dyn_mix(_Float16 a, _Float16 b) {
    volatile _Float16 buf[8];
    /* Fill with data derived from inputs so it can't be precomputed */
    for (int i = 0; i < 8; ++i) {
        /* (i+1) in denom prevents the compiler from recognizing trivial patterns */
        buf[i] = (a + (_Float16)(float)i) * (_Float16)0.5f - b / (_Float16)(float)(i + 1);
    }
    _Float16 s = (_Float16)0.0f;
    for (int i = 0; i < 8; ++i) {
        /* A couple of ops to exercise add/mul/div/FMA lowering paths */
        _Float16 t = (buf[i] * a) + (b / (_Float16)(float)(i + 2));
        buf[i] = t - (_Float16)0.0625f;
        s += buf[i];
    }
    return s;
}

#if defined(__BFLT16_MANT_DIG__) || defined(__FLT16_BF16__)
static __attribute__((noinline)) __bf16 bf16_dyn_mix(__bf16 a, __bf16 b) {
    volatile __bf16 buf[8];
    for (int i = 0; i < 8; ++i) {
        buf[i] = (__bf16)((float)a + (float)i) * (__bf16)0.5f - b / (__bf16)(float)(i + 1);
    }
    __bf16 s = (__bf16)0.0f;
    for (int i = 0; i < 8; ++i) {
        __bf16 t = (buf[i] * a) + (b / (__bf16)(float)(i + 2));
        buf[i] = t - (__bf16)0.0625f;
        s += buf[i];
    }
    return s;
}
#endif

int main(void)
{
    printf("Zephyr FP16/BF16 test on: %s\n", CONFIG_BOARD_TARGET);

#if defined(__FLT16_MANT_DIG__)
    _Static_assert(sizeof(_Float16) == 2, "_Float16 should be 2 bytes");

    /* --- simple, possibly foldable sanity prints --- */
    _Float16 a = (_Float16)1.5f, b = (_Float16)0.25f, c = (_Float16)(-2.0f);
    print_f16("a", a);
    print_f16("b", b);
    print_f16("c", c);
    print_f16("a + b", a + b);
    print_f16("a * b", a * b);
    print_f16("c / a", c / a);

    /* --- dynamic path that cannot be constant-folded --- */
    uint32_t seed = runtime_seed();
    /* Map seed to benign FP16 inputs in (0, 2) */
    _Float16 dx = (_Float16)((seed % 97u) / 97.0f + 0.125f);
    _Float16 dy = (_Float16)(((seed >> 7) % 53u) / 53.0f + 0.1875f);

    print_f16("dx (dyn)", dx);
    print_f16("dy (dyn)", dy);

    _Float16 s16 = f16_dyn_mix(dx, dy);
    print_f16("f16_dyn_mix sum", s16);

    /* epsilon probe with dynamic offset to force runtime evaluation */
    _Float16 one = (_Float16)1.0f;
    _Float16 eps = (_Float16)0x1p-10f; /* exact FP16 ulp at 1.0 */
    _Float16 jitter = (_Float16)((seed & 7u) * 0.0625f); /* {0, 1/16, 2/16, ...} */
    print_f16("1 + eps + jitter", one + eps + jitter);
#else
    printf("This toolchain does not support _Float16 (no __FLT16_MANT_DIG__).\n");
#endif

#if defined(__BFLT16_MANT_DIG__) || defined(__FLT16_BF16__)
    _Static_assert(sizeof(__bf16) == 2, "__bf16 should be 2 bytes");

    /* Map the same seed to BF16 inputs */
    uint32_t seed2 = runtime_seed() ^ 0x9E3779B9u;
    __bf16 bx = (__bf16)((seed2 % 97u) / 97.0f + 0.25f);
    __bf16 by = (__bf16)(((seed2 >> 5) % 61u) / 61.0f + 0.0625f);

    print_bf16("__bf16 bx (dyn)", bx);
    print_bf16("__bf16 by (dyn)", by);

    __bf16 s_bf16 = bf16_dyn_mix(bx, by);
    print_bf16("bf16_dyn_mix sum", s_bf16);

    /* Compare encodings for ~same numeric range */
    print_f16("as _Float16 ~bx", (_Float16)(float)bx);
    print_bf16("as __bf16  ~bx", bx);
#else
    printf("__bf16 not supported by this GCC/target.\n");
#endif

    /* End the sim */
    sys_reboot(SYS_REBOOT_COLD);
    return 0;
}
```

## src/main_zvfh.c
```c
/*
 * SPDX-License-Identifier: Apache-2.0
 * Minimal Zvfh test: _Float16 + RVV intrinsics
 */

#include <stdio.h>
#include <stdint.h>
#include <zephyr/sys/reboot.h>
#include <riscv_vector.h>

typedef _Float16 f16;

/* --- tiny runtime seed so the optimizer can't precompute everything --- */
static inline uint32_t runtime_seed(void) {
    volatile const char *vp = CONFIG_BOARD_TARGET;
    uint32_t h = 2166136261u;
    for (size_t i = 0; vp[i] != '\0'; ++i) { h ^= (uint8_t)vp[i]; h *= 16777619u; }
    h ^= (uint32_t)(uintptr_t)&vp;  /* mix stack addr to foil CSE */
    return h ? h : 1u;
}

/* read misa (to check 'V') */
static inline unsigned long read_csr_misa(void) {
    unsigned long x; __asm__ volatile("csrr %0, misa" : "=r"(x));
    return x;
}
#define MISA_EXT_BIT(ch) (1UL << ((ch) - 'A'))

/* simple driver: y = a*b + c, then y += alpha */
static void zvfh_fma_and_axpy(f16 *y, const f16 *a, const f16 *b, const f16 *c,
                              f16 alpha, size_t n)
{
    size_t i = 0;
    while (i < n) {
        size_t vl = __riscv_vsetvl_e16m1(n - i);

        /* loads */
        vfloat16m1_t va = __riscv_vle16_v_f16m1(&a[i], vl);
        vfloat16m1_t vb = __riscv_vle16_v_f16m1(&b[i], vl);
        vfloat16m1_t vc = __riscv_vle16_v_f16m1(&c[i], vl);

        /* vy = vc + va * vb  (fused) */
        vfloat16m1_t vy = __riscv_vfmacc_vv_f16m1(vc, va, vb, vl);

        /* vy = vy + alpha (vector-scalar add) */
        vy = __riscv_vfadd_vf_f16m1(vy, alpha, vl);

        /* store */
        __riscv_vse16_v_f16m1(&y[i], vy, vl);

        i += vl;
    }
}

int main(void)
{
    printf("Zephyr Zvfh intrinsics smoke test on: %s\n", CONFIG_BOARD_TARGET);

    /* Runtime check: require V (Zvfh rides on V). */
    unsigned long misa = read_csr_misa();
    if ((misa & MISA_EXT_BIT('V')) == 0) {
        printf("This hart does not advertise V in misa; skipping RVV test.\n");
        sys_reboot(SYS_REBOOT_COLD);
        return 0;
    }

    enum { N = 128 };
    static f16 a[N], b[N], c[N], y[N];

    /* Fill inputs with non-constant-foldable data */
    uint32_t seed = runtime_seed();
    for (int i = 0; i < N; ++i) {
        float s = 0.001f * (float)((seed ^ (0x9E3779B9u + i*2654435761u)) & 0x3FF);
        a[i] = (f16)(0.25f + s + 0.01f * (float)(i % 7));
        b[i] = (f16)(0.50f - s + 0.02f * (float)(i % 5));
        c[i] = (f16)(-0.10f + 0.03f * (float)(i % 3));
        y[i] = (f16)0.0f;
    }

    f16 alpha = (f16)0.125f;

    /* Do a couple of passes to exercise the intrinsics a bit */
    zvfh_fma_and_axpy(y, a, b, c, alpha, N);
    zvfh_fma_and_axpy(y, y, a, c, alpha, N);  /* re-use y as input to mix it up */

    /* Print a few sample results */
    for (int i = 0; i < 8; ++i) {
        printf("y[%d] = % .6f\n", i, (double)y[i]);
    }

    /* Done */
    sys_reboot(SYS_REBOOT_COLD);
    return 0;
}
```
