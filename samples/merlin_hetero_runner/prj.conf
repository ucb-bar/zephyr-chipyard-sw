## CMakeLists.txt
```
# merlin_hetero_runner — runs the same model in parallel on BOTH harts of the
# FireSim Shuttle bitstream (hart 0 = scalar/Gemmini, hart 1 = RVV/OPU).
#
# Each hart gets its own ISA-specific VMFB; both run independently via a
# per-hart pinned worker thread + a per-hart k_msgq/k_sem job queue.
# Init (VM instance, HAL device, parsed bytecode) happens ONCE at worker
# startup so the ~575 M setup cycles are amortized across N inferences.
#
# Parameters (-D...):
#   MERLIN_VMFB_H0    absolute path to .vmfb compiled for hart 0 (REQUIRED)
#   MERLIN_VMFB_H1    absolute path to .vmfb compiled for hart 1 (REQUIRED)
#   MERLIN_MODEL      mlp_wide | dronet | yolov8n (REQUIRED, both VMFBs must
#                     be the same model)
#   MERLIN_BACKEND_H0 scalar | rvv | opu | gemmini (default: scalar)
#   MERLIN_BACKEND_H1 scalar | rvv | opu | gemmini (default: rvv)
#   MERLIN_JOBS       total jobs to dispatch across both harts (default: 32)
#   MERLIN_CPU_FEATURES  IREE bare-metal feature bitmask (default: 0x11 = V+XOPU)

cmake_minimum_required(VERSION 3.20.0)

find_package(Zephyr REQUIRED HINTS $ENV{ZEPHYR_BASE})
project(merlin_hetero_runner)

# ----- required + defaulted parameters ----------------------------------
foreach(_var IN ITEMS MERLIN_VMFB_H0 MERLIN_VMFB_H1 MERLIN_MODEL)
  if(NOT DEFINED ${_var})
    message(FATAL_ERROR "${_var} must be set")
  endif()
endforeach()
foreach(_path IN ITEMS ${MERLIN_VMFB_H0} ${MERLIN_VMFB_H1})
  if(NOT EXISTS ${_path})
    message(FATAL_ERROR "Missing VMFB: ${_path}")
  endif()
endforeach()

if(MERLIN_MODEL STREQUAL "mlp_wide")
  set(MERLIN_MODEL_DEFINE MERLIN_MODEL_MLP_WIDE)
elseif(MERLIN_MODEL STREQUAL "dronet")
  set(MERLIN_MODEL_DEFINE MERLIN_MODEL_DRONET)
elseif(MERLIN_MODEL STREQUAL "dronet_with_intermediate")
  set(MERLIN_MODEL_DEFINE MERLIN_MODEL_DRONET_WITH_INTERMEDIATE)
elseif(MERLIN_MODEL STREQUAL "yolov8n")
  set(MERLIN_MODEL_DEFINE MERLIN_MODEL_YOLOV8N)
else()
  message(FATAL_ERROR "MERLIN_MODEL=${MERLIN_MODEL} invalid")
endif()

if(NOT DEFINED MERLIN_BACKEND_H0)
  set(MERLIN_BACKEND_H0 "scalar")
endif()
if(NOT DEFINED MERLIN_BACKEND_H1)
  set(MERLIN_BACKEND_H1 "rvv")
endif()
if(NOT DEFINED MERLIN_JOBS)
  set(MERLIN_JOBS 32)
endif()
if(NOT DEFINED MERLIN_CPU_FEATURES)
  set(MERLIN_CPU_FEATURES "0x11")
endif()

# Hart 0 is scalar/gemmini (no V); hart 1 is rvv/opu (V active).
set(MERLIN_NEEDS_VECTOR_H0 0)
if(MERLIN_BACKEND_H1 STREQUAL "rvv" OR MERLIN_BACKEND_H1 STREQUAL "opu")
  set(MERLIN_NEEDS_VECTOR_H1 1)
else()
  set(MERLIN_NEEDS_VECTOR_H1 0)
endif()

message(STATUS "merlin_hetero_runner config:")
message(STATUS "  MODEL              = ${MERLIN_MODEL}")
message(STATUS "  VMFB_H0            = ${MERLIN_VMFB_H0}  (backend ${MERLIN_BACKEND_H0})")
message(STATUS "  VMFB_H1            = ${MERLIN_VMFB_H1}  (backend ${MERLIN_BACKEND_H1})")
message(STATUS "  JOBS               = ${MERLIN_JOBS}")
message(STATUS "  CPU_FEATURES       = ${MERLIN_CPU_FEATURES}")

# ----- embed both VMFBs as C headers via xxd ----------------------------
find_program(XXD_EXECUTABLE xxd REQUIRED)

set(_H0_LOCAL  ${CMAKE_CURRENT_BINARY_DIR}/merlin_vmfb_h0.vmfb)
set(_H1_LOCAL  ${CMAKE_CURRENT_BINARY_DIR}/merlin_vmfb_h1.vmfb)
set(_H0_HEADER ${CMAKE_CURRENT_BINARY_DIR}/merlin_vmfb_h0.h)
set(_H1_HEADER ${CMAKE_CURRENT_BINARY_DIR}/merlin_vmfb_h1.h)

add_custom_command(
  OUTPUT ${_H0_LOCAL} ${_H0_HEADER}
  COMMAND ${CMAKE_COMMAND} -E copy_if_different ${MERLIN_VMFB_H0} ${_H0_LOCAL}
  COMMAND ${XXD_EXECUTABLE} -i -n merlin_vmfb_h0 merlin_vmfb_h0.vmfb > ${_H0_HEADER}
  DEPENDS ${MERLIN_VMFB_H0}
  WORKING_DIRECTORY ${CMAKE_CURRENT_BINARY_DIR}
  COMMENT "Embedding hart-0 VMFB ${MERLIN_VMFB_H0}"
  VERBATIM)
add_custom_command(
  OUTPUT ${_H1_LOCAL} ${_H1_HEADER}
  COMMAND ${CMAKE_COMMAND} -E copy_if_different ${MERLIN_VMFB_H1} ${_H1_LOCAL}
  COMMAND ${XXD_EXECUTABLE} -i -n merlin_vmfb_h1 merlin_vmfb_h1.vmfb > ${_H1_HEADER}
  DEPENDS ${MERLIN_VMFB_H1}
  WORKING_DIRECTORY ${CMAKE_CURRENT_BINARY_DIR}
  COMMENT "Embedding hart-1 VMFB ${MERLIN_VMFB_H1}"
  VERBATIM)
add_custom_target(merlin_vmfb_headers DEPENDS ${_H0_HEADER} ${_H1_HEADER})

# ----- application sources ----------------------------------------------
target_sources(app PRIVATE
  src/main.c
  src/hetero_worker.c
  src/device_stubs.c
  src/iree_thread_zephyr.c
  src/iree_futex_zephyr.c
  src/iree_picolibc_compat.c
)
add_dependencies(app merlin_vmfb_headers)

target_include_directories(app PRIVATE
  ${CMAKE_CURRENT_BINARY_DIR}
  ${CMAKE_CURRENT_LIST_DIR}/src
)

target_compile_definitions(app PRIVATE
  ${MERLIN_MODEL_DEFINE}
  MERLIN_BACKEND_H0="${MERLIN_BACKEND_H0}"
  MERLIN_BACKEND_H1="${MERLIN_BACKEND_H1}"
  MERLIN_NEEDS_VECTOR_H0=${MERLIN_NEEDS_VECTOR_H0}
  MERLIN_NEEDS_VECTOR_H1=${MERLIN_NEEDS_VECTOR_H1}
  MERLIN_JOBS=${MERLIN_JOBS}
)
# 2026-05-17: enable per-dispatch cycle profiling so [dc] o=N wg=...
# cyc=C lines have real values. This wraps every ELF call with
# rdcycle and accumulates into iree_merlin_cycles_per_ordinal[].
target_compile_definitions(merlin_iree INTERFACE MERLIN_PROFILE_CYCLES=1)

target_link_libraries(app PRIVATE merlin_iree)
target_compile_definitions(app PRIVATE
  IREE_BARE_METAL_CPU_DATA0=${MERLIN_CPU_FEATURES}
)
```

## prj.conf
```kconfig
# SMP configuration for FireSimGemminiAndOPUShuttleConfig (2 Shuttle tiles).
# Lessons 1-3 from docs/dev_blog/2026-05-13-zephyr-on-hetero-shuttle-firesim.md.
CONFIG_PRINTK=y
CONFIG_STDOUT_CONSOLE=y
CONFIG_THREAD_STACK_INFO=y
CONFIG_STACK_SENTINEL=y

CONFIG_MP_MAX_NUM_CPUS=2
CONFIG_SMP=y
CONFIG_SCHED_CPU_MASK=y
CONFIG_SCHED_CPU_MASK_PIN_ONLY=y
CONFIG_SCHED_DUMB=y

# Lesson 3: direct-putchar HTIF has an SMP race. Use the buffered+syscall path.
CONFIG_UART_HTIF_BUFFERED_OUTPUT=y
CONFIG_UART_HTIF_BUFFERED_OUTPUT_SIZE=256
CONFIG_UART_HTIF_SYSCALL_PRINT=y

# CONFIG_FPU_SHARING defaults to y when CONFIG_FPU=y. Its trap handler
# (z_riscv_fpu_trap) catches FP-illegal-instr traps AND incorrectly
# claims V-illegal-instr traps (the trap-entry path at isr.S:264 checks
# for opcode 0x57 = VECTOR and routes to is_fp when CONFIG_RISCV_ISA_EXT_V
# is set, but the FPU re-enable logic doesn't actually restore V state).
# Net effect: V illegal-instruction silently retries forever — the silent
# hang we observed on RVV/OPU after `bind[N] stored`. Turning off FPU
# sharing routes V traps through the standard fault path so we see the
# crash (then deal with VS=Off properly with set_vs_dirty() in the worker
# entry, which works for non-preempted threads).
CONFIG_FPU_SHARING=n

# Lesson 2 from 2026-05-13 dev blog: do NOT set CONFIG_RISCV_ISA_EXT_V=y.
# Even with the default LAZY mode the Zephyr boot path traps on hart 0
# (silent hang at "tsibridge_t::tick skipping tick" before Zephyr's
# "Booting Zephyr OS" banner — verified 2026-05-13). The lazy-V trap
# handler is gated on Zephyr seeing the thread as "V-allowed", but
# something earlier in arch-init touches V regs unconditionally.
#
# Workaround: per-hart VS=Dirty preamble (set_vs_dirty()) plus COOP
# scheduling on the worker thread. Limitation: the system timer tick
# IRQ still fires and Zephyr's trap-return restores a saved mstatus
# with VS=Off → V instructions re-trap. Without enabling V at Kconfig
# level, the only robust path is a custom illegal-instruction trap
# handler that promotes saved mstatus.MPV to Dirty and mrets to retry.
# Defer that to a follow-up; scalar+gemmini paths work today.

# IREE VM module init uses an 8KB inline VM stack; need headroom on main stack.
CONFIG_MAIN_STACK_SIZE=32768

# Libc: picolibc (Zephyr SDK default).
# The IREE archives in $MERLIN_ROOT/build/zephyr-vanilla-release/ reference
# newlib's _ctype_, _impure_ptr, __errno — picolibc doesn't have them.
# Rather than rebuild IREE against a different libc, we bridge via
# src/iree_picolibc_compat.c which provides stub definitions. Those
# references are only present from archive-symbol resolution; the actual
# code paths are dead under IREE_PLATFORM_GENERIC + IREE_ENABLE_THREADING=OFF
# + IREE_FILE_IO_ENABLE=0 and --gc-sections drops them at the final link.

# Let picolibc's libc.a provide malloc/free. CONFIG_COMMON_LIBC_MALLOC
# is defaulted on by something in the dep chain — explicitly disable to
# stop Zephyr's common malloc from colliding with picolibc's
# nano-malloc.c. Real __heap_start/__heap_end symbols are exported from
# src/iree_picolibc_compat.c so picolibc's sbrk has a working 4 MiB BSS
# heap.
CONFIG_COMMON_LIBC_MALLOC=n

# IREE + embedded VMFB + HAL buffers + per-model input/output tensors.
# 4 MiB covers yolov8n (700KB output) with plenty of slack.
CONFIG_HEAP_MEM_POOL_SIZE=4194304

# POSIX shim — IREE compiles cleanly under IREE_PLATFORM_GENERIC but the
# Zephyr-side glue assumes POSIX-like nullable wait/time primitives.
CONFIG_POSIX_API=y
CONFIG_MULTITHREADING=y
CONFIG_POSIX_THREADS=y

# Pull in the merlin-iree Zephyr module's static IREE runtime archives.
# The module Kconfig (chipyard zephyrproject/modules/merlin-iree/zephyr/Kconfig)
# gates archive import + the merlin_iree interface library on this option.
CONFIG_MERLIN_IREE=y
CONFIG_FPU=y
```

## src/main.c
```c
/*
 * merlin_hetero_runner — parallel async inferences across both Shuttle harts.
 *
 * Two pinned worker threads (hart 0 + hart 1), each owning its own
 * iree_vm_context + iree_hal_device built at startup. main() submits
 * MERLIN_JOBS inferences (round-robin across harts) to their per-hart
 * k_msgq, awaits completion via a per-job k_sem, and at the end dumps
 * per-job + per-hart cycle stats.
 *
 * Per-job cost in steady state ~= iree_vm_invoke + d2h + hash. The 575 M
 * setup cost is paid ONCE per hart at boot, NOT per job.
 *
 * SPDX-License-Identifier: Apache-2.0
 */
#include <stdio.h>
#include <stdint.h>
#include <stdlib.h>
#include <string.h>

#include <zephyr/kernel.h>
#include <zephyr/arch/cpu.h>
#include <zephyr/sys/printk.h>
#include <zephyr/sys/reboot.h>

#include "iree/base/api.h"

#include "model_info.h"
#include "hetero_worker.h"

/* Embedded VMFBs (one per hart's ISA). xxd emits:
 *   unsigned char merlin_vmfb_hX[]   = { ... };
 *   unsigned int  merlin_vmfb_hX_len = ...;
 */
#include "merlin_vmfb_h0.h"
#include "merlin_vmfb_h1.h"

#ifndef MERLIN_JOBS
#define MERLIN_JOBS 32
#endif
#ifndef MERLIN_BACKEND_H0
#define MERLIN_BACKEND_H0 "scalar"
#endif
#ifndef MERLIN_BACKEND_H1
#define MERLIN_BACKEND_H1 "rvv"
#endif
#ifndef MERLIN_NEEDS_VECTOR_H0
#define MERLIN_NEEDS_VECTOR_H0 0
#endif
#ifndef MERLIN_NEEDS_VECTOR_H1
#define MERLIN_NEEDS_VECTOR_H1 1
#endif

#if defined(MERLIN_MODEL_MLP_WIDE)
#define MERLIN_MODEL_NAME "mlp_wide"
#elif defined(MERLIN_MODEL_DRONET)
#define MERLIN_MODEL_NAME "dronet"
#elif defined(MERLIN_MODEL_YOLOV8N)
#define MERLIN_MODEL_NAME "yolov8n"
#else
#define MERLIN_MODEL_NAME "unknown"
#endif

#define HART_COUNT 2

static inline uint64_t rdmcycle_m(void) {
  uint64_t c;
  __asm__ __volatile__("csrr %0, mcycle" : "=r"(c));
  return c;
}

/* ---------- per-job result table ---------- */
typedef struct {
  uint64_t cycles;
  uint64_t hash;
  uint32_t hart_id;
  int32_t  rc;
} merlin_job_result_t;

static merlin_job_result_t g_job_results[MERLIN_JOBS];

/* Called by the worker via extern. */
void merlin_record_job_result(uint32_t job_id, uint64_t cycles, uint64_t hash,
                              int rc, uint32_t hart_id) {
  if (job_id < MERLIN_JOBS) {
    g_job_results[job_id].cycles = cycles;
    g_job_results[job_id].hash = hash;
    g_job_results[job_id].hart_id = hart_id;
    g_job_results[job_id].rc = rc;
  }
}

/* ---------- worker state + Zephyr resources ---------- */
static merlin_worker_state_t g_worker_state[HART_COUNT];
/* 2026-05-17 ROOT-CAUSE FIX (long-standing dronet × Gemmini hang):
 * IREE-generated dispatch ELFs allocate the matmul output buffer as a
 * stack `alloca` in the dispatch function's prologue. For dronet's
 * conv1 matmul (3136 × 32 i32), each dispatch invocation needs
 * 3136*32*4 = 401,408 bytes on the stack — TWICE that for the bias-add
 * temp + main output = ~800 KiB. The previous 96 KiB worker stack
 * silently overflowed and the dispatch hung after `[entry] o=12`,
 * which we mis-attributed to a Gemmini RoCC emission bug for many
 * hours (tried OS path, bulk LOOP_WS, per-tile LOOP_WS — all hung at
 * the same point because the hang is in the prologue, before our
 * matmul code runs). mlp_wide passes with 96 KiB because its 16×32
 * matmul output is only 2 KiB stack. yolov8n will need even more
 * headroom — bumping to 4 MiB covers every workload we currently
 * compile. */
#define MERLIN_WORKER_STACK_SIZE (4 * 1024 * 1024)
K_THREAD_STACK_ARRAY_DEFINE(g_worker_stack, HART_COUNT,
                            MERLIN_WORKER_STACK_SIZE);
static struct k_thread g_worker_thread[HART_COUNT];

#define MERLIN_MSGQ_CAPACITY 64  /* >= MERLIN_JOBS/HART_COUNT + slack */
K_MSGQ_DEFINE(g_job_msgq_h0, sizeof(merlin_job_t), MERLIN_MSGQ_CAPACITY, 8);
K_MSGQ_DEFINE(g_job_msgq_h1, sizeof(merlin_job_t), MERLIN_MSGQ_CAPACITY, 8);

static struct k_sem g_completion_sems[MERLIN_JOBS];

/* PHASE-D diagnostic: live progress marker. The merlin gemmini plugin
 * emits stores to this variable from inside dispatch ELFs (one store
 * before each (i0,j0,k0) outer tile call to spTiledMatmul, plus extra
 * stores between MVIN-D/MVIN-B/MVIN-A/COMPUTE/MVOUT sub-blocks of
 * spTiledMatmulOs). The address of this symbol must be hardcoded
 * into the plugin (since the dispatch ELF doesn't link Zephyr).
 *
 * After Zephyr is built, get the actual address via:
 *   riscv64-unknown-elf-nm zephyr.elf | grep merlin_progress_marker
 * and update the plugin's emitMarker function in
 * `compiler/src/merlin/Dialect/Gemmini/Transforms/LegalizeForLLVMExport.cpp`
 * to write to that address.
 *
 * A watchdog thread (started below from main) polls this marker
 * every 100ms and prints to UART so we get LIVE progress visible in
 * the FireSim uartlog. If the dispatch hangs, the last printed
 * marker value reveals the LAST (i0,j0,k0) tile that executed, and
 * the LAST sub-block within that tile.
 */
volatile uint64_t merlin_progress_marker = 0;

static struct k_thread g_watchdog_thread;
#define MERLIN_WATCHDOG_STACK_SIZE 4096
K_THREAD_STACK_DEFINE(g_watchdog_stack, MERLIN_WATCHDOG_STACK_SIZE);

static void merlin_watchdog_entry(void *a, void *b, void *c) {
  (void)a; (void)b; (void)c;
  uint64_t last = 0;
  uint32_t tick = 0;
  while (1) {
    uint64_t cur = merlin_progress_marker;
    if (cur != last) {
      printk("[mrk] %llx (tick=%u)\n",
             (unsigned long long)cur, (unsigned)tick);
      last = cur;
    }
    /* Periodic alive print every ~5s (50 ticks @ 100ms) — proves
     * the watchdog thread is being scheduled even if the marker
     * never changes. Distinguishes "marker never written" from
     * "watchdog never runs". */
    if ((tick % 50) == 0) {
      printk("[mrk-alive] tick=%u mrk=%llx\n",
             (unsigned)tick, (unsigned long long)cur);
    }
    tick++;
    k_sleep(K_MSEC(100));
  }
}

int main(void) {
  printf("=== merlin_hetero_runner ===\n");
  printf("model=%s jobs=%d hart0=%s hart1=%s\n",
         MERLIN_MODEL_NAME, MERLIN_JOBS,
         MERLIN_BACKEND_H0, MERLIN_BACKEND_H1);
  printf("vmfb_h0=%u bytes  vmfb_h1=%u bytes\n",
         (unsigned)merlin_vmfb_h0_len, (unsigned)merlin_vmfb_h1_len);

  /* ---- configure per-hart state ---- */
  g_worker_state[0] = (merlin_worker_state_t){
      .hart_id = 0,
      .needs_vector = MERLIN_NEEDS_VECTOR_H0,
      .backend_name = MERLIN_BACKEND_H0,
      .vmfb = {merlin_vmfb_h0, merlin_vmfb_h0_len},
      .job_msgq = &g_job_msgq_h0,
  };
  g_worker_state[1] = (merlin_worker_state_t){
      .hart_id = 1,
      .needs_vector = MERLIN_NEEDS_VECTOR_H1,
      .backend_name = MERLIN_BACKEND_H1,
      .vmfb = {merlin_vmfb_h1, merlin_vmfb_h1_len},
      .job_msgq = &g_job_msgq_h1,
  };
  k_sem_init(&g_worker_state[0].startup_sem, 0, 1);
  k_sem_init(&g_worker_state[1].startup_sem, 0, 1);

  /* ---- per-job completion sems ---- */
  for (int j = 0; j < MERLIN_JOBS; ++j) {
    k_sem_init(&g_completion_sems[j], 0, 1);
  }

  /* Enable the upstream merlin per-dispatch debug print
   * (embedded_elf_loader.c emits "[dn] o=N sym=S wg_count=X,Y,Z" on the
   * first workgroup of every dispatch). The last [dn] line printed
   * before UART silence pinpoints a hanging dispatch. */
  extern int iree_merlin_dispatch_debug_enabled;
  iree_merlin_dispatch_debug_enabled = 1;

  /* Phase-2 alignment debug: print binding pointer + alignment + length
   * per dispatch. Use to verify Zephyr's binding base pointers are sane
   * for a hanging dispatch (the Gemmini DMA needs 16-byte aligned
   * source addresses, and zero-length / NaN-pointer bindings would
   * otherwise produce a silent hang inside the dispatch). */
  extern int iree_merlin_binding_debug_enabled;
  iree_merlin_binding_debug_enabled = 1;

  /* (Watchdog thread DISABLED — the COOP-priority polling fought with
   * hart 1's worker thread and stalled OPU init at encoding_8 wg=21.
   * Keep the merlin_progress_marker symbol so the plugin's marker
   * stores remain harmless, but don't print live progress for now.) */

  /* ---- spawn pinned workers ---- */
  uint64_t spawn_t0 = rdmcycle_m();
  k_tid_t tids[HART_COUNT];
  for (int h = 0; h < HART_COUNT; ++h) {
    tids[h] = k_thread_create(
        &g_worker_thread[h], g_worker_stack[h], MERLIN_WORKER_STACK_SIZE,
        merlin_worker_entry, &g_worker_state[h], NULL, NULL,
        /*prio=*/K_PRIO_COOP(0), /*opts=*/0, /*delay=*/K_FOREVER);
    int pin_rc = k_thread_cpu_pin(tids[h], h);
    if (pin_rc != 0) {
      printf("[hetero] FAIL k_thread_cpu_pin hart %d rc=%d\n", h, pin_rc);
      sys_reboot(SYS_REBOOT_COLD);
      return 1;
    }
    k_thread_start(tids[h]);
  }

  /* ---- wait for both workers to finish init ---- */
  k_sem_take(&g_worker_state[0].startup_sem, K_FOREVER);
  k_sem_take(&g_worker_state[1].startup_sem, K_FOREVER);
  uint64_t init_t1 = rdmcycle_m();
  printf("[hetero] both harts initialized cycles=%llu  "
         "init_h0=%llu init_h1=%llu\n",
         (unsigned long long)(init_t1 - spawn_t0),
         (unsigned long long)g_worker_state[0].cycles_init,
         (unsigned long long)g_worker_state[1].cycles_init);

  /* (Watchdog spawn intentionally disabled — see comment at line 130 in
   * merlin_watchdog_entry. Spawning the watchdog appears to correlate
   * with the misaligned-load fault in iree_hal_elf_executable_issue_call
   * after dispatch_3 of mlp_wide × Gemmini on FireSim (s3 corrupted by
   * unknown mechanism). The plugin's emitMarker stores to BSS still
   * fire harmlessly even without the watchdog; recovering the marker
   * values is just not surfaced live anymore. We don't need it for
   * production paths now that the root-cause hang (stack overflow) is
   * understood and fixed via MERLIN_WORKER_STACK_SIZE = 4 MiB. */

  /* ---- submit MERLIN_JOBS jobs round-robin ---- */
  printf("[hetero] submitting %d jobs (round-robin)\n", MERLIN_JOBS);
  uint64_t submit_t0 = rdmcycle_m();
  for (int j = 0; j < MERLIN_JOBS; ++j) {
    merlin_job_t job = {
        .job_id = (uint32_t)j,
        .completion_sem = &g_completion_sems[j],
    };
    int target_hart = j % HART_COUNT;
    int rc = k_msgq_put(g_worker_state[target_hart].job_msgq,
                        &job, K_NO_WAIT);
    if (rc != 0) {
      printf("[hetero] FAIL k_msgq_put job %d hart %d rc=%d\n",
             j, target_hart, rc);
      sys_reboot(SYS_REBOOT_COLD);
      return 1;
    }
  }

  /* ---- wait for all completions ---- */
  for (int j = 0; j < MERLIN_JOBS; ++j) {
    k_sem_take(&g_completion_sems[j], K_FOREVER);
  }
  uint64_t submit_t1 = rdmcycle_m();
  uint64_t parallel_wall = submit_t1 - submit_t0;

  /* ---- send drain signals + join ---- */
  merlin_job_t drain = {.job_id = UINT32_MAX, .completion_sem = NULL};
  k_msgq_put(g_worker_state[0].job_msgq, &drain, K_NO_WAIT);
  k_msgq_put(g_worker_state[1].job_msgq, &drain, K_NO_WAIT);
  k_thread_join(tids[0], K_FOREVER);
  k_thread_join(tids[1], K_FOREVER);

  /* ---- dump per-job and per-hart stats ---- */
  printf("[hetero] === per-job log ===\n");
  uint64_t sum_h0 = 0, sum_h1 = 0;
  uint32_t n_h0 = 0, n_h1 = 0;
  int n_ok = 0;
  for (int j = 0; j < MERLIN_JOBS; ++j) {
    const merlin_job_result_t* r = &g_job_results[j];
    printf("[hetero] job=%d hart=%u cycles=%llu hash=0x%016llx rc=%d\n",
           j, (unsigned)r->hart_id,
           (unsigned long long)r->cycles,
           (unsigned long long)r->hash, r->rc);
    if (r->rc == 0) {
      n_ok++;
      if (r->hart_id == 0) { sum_h0 += r->cycles; n_h0++; }
      else                 { sum_h1 += r->cycles; n_h1++; }
    }
  }

  /* ---- per-dispatch cycle decomposition ---- */
  /* 2026-05-17: dump per-ordinal cycle accumulation so we can produce
   * a per-dispatch performance breakdown after the run. Output lines
   * look like:
   *   CYC, <ord>, <symbol>, <total_cycles>, <wg_count>
   * Parseable via tools/perf_decompose.py to produce a percentage
   * breakdown per (dispatch, accelerator). */
  extern void iree_merlin_dump_cycles(void);
  iree_merlin_dump_cycles();

  uint64_t sum_total = sum_h0 + sum_h1;
  printf("[hetero] === summary ===\n");
  printf("[hetero] jobs_ok=%d / %d\n", n_ok, MERLIN_JOBS);
  printf("[hetero] hart0 jobs=%u total_invoke_cycles=%llu  avg=%llu\n",
         n_h0, (unsigned long long)sum_h0,
         n_h0 ? (unsigned long long)(sum_h0 / n_h0) : 0ULL);
  printf("[hetero] hart1 jobs=%u total_invoke_cycles=%llu  avg=%llu\n",
         n_h1, (unsigned long long)sum_h1,
         n_h1 ? (unsigned long long)(sum_h1 / n_h1) : 0ULL);
  printf("[hetero] parallel_wall_cycles=%llu  serial_sum_cycles=%llu  "
         "speedup_x1000=%llu\n",
         (unsigned long long)parallel_wall,
         (unsigned long long)sum_total,
         parallel_wall ? (unsigned long long)((sum_total * 1000ULL) /
                                              parallel_wall) : 0ULL);
  printf("[hetero] init_h0=%llu init_h1=%llu  amortized_per_job_h0=%llu  "
         "amortized_per_job_h1=%llu\n",
         (unsigned long long)g_worker_state[0].cycles_init,
         (unsigned long long)g_worker_state[1].cycles_init,
         n_h0 ? (unsigned long long)(g_worker_state[0].cycles_init / n_h0)
              : 0ULL,
         n_h1 ? (unsigned long long)(g_worker_state[1].cycles_init / n_h1)
              : 0ULL);

  if (n_ok == MERLIN_JOBS) {
    printf(">>> MERLIN HETERO RUN PASSED <<<\n");
  } else {
    printf(">>> MERLIN HETERO RUN FAILED (%d/%d) <<<\n", n_ok, MERLIN_JOBS);
  }
  sys_reboot(SYS_REBOOT_COLD);
  return n_ok == MERLIN_JOBS ? 0 : 1;
}
```

## src/device_stubs.c
```c
/* Local-sync device factory + bytecode-module accessor.
 *
 * The IREE archives in this Zephyr build include both local-sync and
 * local-task HAL drivers. We instantiate the local-sync device here:
 *  - inline executor — no internal threading required from IREE
 *  - the iree_thread_zephyr.c + iree_futex_zephyr.c bridge files are still
 *    linked in for iree_slim_mutex / iree_notification on the bytecode-VM
 *    side (those use futex)
 *  - app-level multi-hart parallelism remains available: spawn one
 *    k_thread per Shuttle hart, each driving its own iree_vm_context.
 *
 * Switching to iree_hal_task_device_create would let IREE schedule
 * dispatch across multiple workers in a SINGLE inference, but requires a
 * non-stub proactor backend on Zephyr (the upstream stub vtable leaves
 * notification_signal/wait + relay methods as NULL, which the task HAL's
 * semaphore-init path calls during iree_vm_context_create — load access
 * fault). Real backend = separate workstream.
 */

#include <stdio.h>

#include <zephyr/sys/printk.h>

#include "iree/async/util/proactor_pool.h"
#include "iree/base/api.h"
#include "iree/hal/api.h"
#include "iree/hal/device_group.h"
#include "iree/hal/drivers/local_sync/sync_device.h"
#include "iree/hal/local/executable_loader.h"
#include "iree/hal/local/loaders/embedded_elf_loader.h"
/* hetero_runner variant: bytecode comes from per-worker state
 * (merlin_vmfb_h0/h1.h embedded in main.c), not from a single global
 * symbol. So load_bytecode_module_data() is omitted below. */

iree_status_t create_sample_device(iree_allocator_t host_allocator,
                                   iree_hal_device_t** out_device) {
  *out_device = NULL;
  printk("[bp] device: sync_params_init\n");

  iree_hal_sync_device_params_t params;
  iree_hal_sync_device_params_initialize(&params);

  iree_hal_device_create_params_t create_params =
      iree_hal_device_create_params_default();

  printk("[bp] device: proactor_pool_create\n");
  iree_async_proactor_pool_t* proactor_pool = NULL;
  iree_status_t pool_status = iree_async_proactor_pool_create(
      /*node_count=*/1, /*node_ids=*/NULL,
      iree_async_proactor_pool_options_default(), host_allocator,
      &proactor_pool);
  if (!iree_status_is_ok(pool_status)) {
    return pool_status;
  }
  create_params.proactor_pool = proactor_pool;
  printk("[bp] device: pool OK\n");

  iree_hal_executable_loader_t* loader = NULL;
  iree_status_t status = iree_hal_embedded_elf_loader_create(
      /*plugin_manager=*/NULL, host_allocator, &loader);
  if (!iree_status_is_ok(status)) {
    iree_async_proactor_pool_release(proactor_pool);
    return status;
  }

  iree_string_view_t identifier = iree_make_cstring_view("local-sync");

  printk("[bp] device: allocator_create_heap\n");
  iree_hal_allocator_t* device_allocator = NULL;
  status = iree_hal_allocator_create_heap(identifier, host_allocator,
                                          host_allocator, &device_allocator);
  if (iree_status_is_ok(status)) {
    printk("[bp] device: hal_sync_device_create\n");
    status = iree_hal_sync_device_create(
        identifier, &params, &create_params,
        /*loader_count=*/1, &loader, device_allocator, host_allocator,
        out_device);
    printk("[bp] device: sync_device_create rc=%d\n",
           (int)iree_status_code(status));
  }

  iree_hal_allocator_release(device_allocator);
  iree_hal_executable_loader_release(loader);
  iree_async_proactor_pool_release(proactor_pool);
  return status;
}

/* load_bytecode_module_data() intentionally not provided in hetero_runner;
 * each worker reads its own VMFB blob via merlin_worker_state_t.vmfb. */
```

## src/hetero_worker.c
```c
/*
 * hetero_worker.c — per-hart inference worker.
 *
 * Init once → consume jobs from msgq → invoke + hash + signal completion.
 *
 * SPDX-License-Identifier: Apache-2.0
 */
#include "hetero_worker.h"

#include <stdio.h>
#include <stdlib.h>
#include <string.h>

#include <zephyr/arch/cpu.h>
#include <zephyr/sys/printk.h>

#include "iree/base/api.h"
#include "iree/hal/api.h"
#include "iree/hal/device_group.h"
#include "iree/modules/hal/module.h"
#include "iree/vm/api.h"
#include "iree/vm/bytecode/module.h"

#include "model_info.h"

extern iree_status_t create_sample_device(iree_allocator_t host_allocator,
                                          iree_hal_device_t** out_device);

static inline uint64_t rdmcycle_w(void) {
  uint64_t c;
  __asm__ __volatile__("csrr %0, mcycle" : "=r"(c));
  return c;
}

static inline void set_vs_dirty_w(void) {
  unsigned long vs = (3UL << 9);
  __asm__ __volatile__("csrs mstatus, %0" :: "r"(vs));
}

/* FNV-1a 64 over a byte span. */
static uint64_t fnv1a64_w(const void* data, size_t len) {
  const uint8_t* p = data;
  uint64_t h = 0xcbf29ce484222325ULL;
  for (size_t i = 0; i < len; ++i) { h ^= p[i]; h *= 0x100000001b3ULL; }
  return h;
}

/* One-shot init: vm_instance, hal_device, hal_module, bytecode_module,
 * context, function resolve, pre-allocate zero-filled input.
 * Returns 0 on success. */
static int worker_init(merlin_worker_state_t* st) {
  iree_allocator_t host = iree_allocator_system();

  if (!iree_status_is_ok(iree_vm_instance_create(
          IREE_VM_TYPE_CAPACITY_DEFAULT, host, &st->vm_instance))) {
    printk("[hetero h%d] FAIL vm_instance_create\n", st->hart_id);
    return -1;
  }
  if (!iree_status_is_ok(
          iree_hal_module_register_all_types(st->vm_instance))) {
    printk("[hetero h%d] FAIL hal_register_types\n", st->hart_id);
    return -1;
  }

  if (!iree_status_is_ok(create_sample_device(host, &st->hal_device))) {
    printk("[hetero h%d] FAIL create_sample_device\n", st->hart_id);
    return -1;
  }
  if (!iree_status_is_ok(iree_hal_device_group_create_from_device(
          st->hal_device, host, &st->hal_device_group))) {
    printk("[hetero h%d] FAIL device_group_create\n", st->hart_id);
    return -1;
  }

  iree_vm_module_t* hal_module = NULL;
  if (!iree_status_is_ok(iree_hal_module_create(
          st->vm_instance, iree_hal_module_device_policy_default(),
          st->hal_device_group, IREE_HAL_MODULE_FLAG_SYNCHRONOUS,
          iree_hal_module_debug_sink_null(), host, &hal_module))) {
    printk("[hetero h%d] FAIL hal_module_create\n", st->hart_id);
    return -1;
  }

  iree_const_byte_span_t module_data = {
      .data = st->vmfb.data, .data_length = st->vmfb.length};
  iree_vm_module_t* bytecode_module = NULL;
  if (!iree_status_is_ok(iree_vm_bytecode_module_create(
          st->vm_instance, IREE_VM_BYTECODE_MODULE_FLAG_NONE, module_data,
          iree_allocator_null(), host, &bytecode_module))) {
    printk("[hetero h%d] FAIL bytecode_module_create\n", st->hart_id);
    return -1;
  }

  iree_vm_module_t* modules[] = {hal_module, bytecode_module};
  iree_status_t ctx_status = iree_vm_context_create_with_modules(
      st->vm_instance, IREE_VM_CONTEXT_FLAG_NONE, IREE_ARRAYSIZE(modules),
      &modules[0], host, &st->vm_context);
  if (!iree_status_is_ok(ctx_status)) {
    iree_status_code_t code = iree_status_code(ctx_status);
    char buf[512];
    iree_host_size_t buf_len = 0;
    iree_status_format(ctx_status, sizeof(buf), buf, &buf_len);
    buf[buf_len < sizeof(buf) ? buf_len : sizeof(buf) - 1] = '\0';
    printk("[hetero h%d] FAIL context_create code=%d msg=%s\n", st->hart_id,
           (int)code, buf);
    iree_status_ignore(ctx_status);
    return -1;
  }
  iree_vm_module_release(hal_module);
  iree_vm_module_release(bytecode_module);

  if (!iree_status_is_ok(iree_vm_context_resolve_function(
          st->vm_context,
          iree_make_cstring_view(MERLIN_ENTRY_FUNCTION_NAME),
          &st->entry_function))) {
    printk("[hetero h%d] FAIL resolve_function\n", st->hart_id);
    return -1;
  }

  /* Pre-allocate a deterministic non-zero input buffer view for input[0].
   * 2026-05-20: switched from calloc to a fp32 all-ones fill so that
   * activations entering the FC matmul are non-zero. With a zero input,
   * A·B = 0 regardless of B, and the Gemmini subspan-byte-offset bug is
   * masked (we can't distinguish correct-B from garbage-B). The dronet
   * input is f32 NCHW 1×3×112×112; we treat all inputs as f32 (matches
   * mlp_wide / dronet / dronet_with_intermediate / yolov8n in model_info.h)
   * and fill every element with 1.0f. */
  const merlin_tensor_spec_t* spec = &merlin_inputs[0];
  void* zero_buf = malloc(spec->byte_count);
  if (!zero_buf) {
    printk("[hetero h%d] FAIL malloc(%u) for input\n",
           st->hart_id, (unsigned)spec->byte_count);
    return -1;
  }
  {
    /* All inputs in this sample are fp32; fill with 1.0f. */
    float* fbuf = (float*)zero_buf;
    size_t nelem = spec->byte_count / sizeof(float);
    for (size_t i = 0; i < nelem; ++i) fbuf[i] = 1.0f;
  }
  iree_hal_buffer_params_t bparams = {
      .type = IREE_HAL_MEMORY_TYPE_DEVICE_LOCAL,
      .usage = IREE_HAL_BUFFER_USAGE_DEFAULT,
  };
  if (!iree_status_is_ok(iree_hal_buffer_view_allocate_buffer_copy(
          st->hal_device, iree_hal_device_allocator(st->hal_device),
          spec->rank, spec->shape, spec->element_type,
          IREE_HAL_ENCODING_TYPE_DENSE_ROW_MAJOR, bparams,
          iree_make_const_byte_span(zero_buf, spec->byte_count),
          &st->pre_input))) {
    free(zero_buf);
    printk("[hetero h%d] FAIL pre_input allocate\n", st->hart_id);
    return -1;
  }
  free(zero_buf);

  /* Pre-allocate input + output vm_lists ONCE. The input list is
   * permanently loaded with a retained ref to pre_input; the output
   * list is cleared (resize 0) between jobs. This eliminates ~6 heap
   * allocs/frees and 2 ref ops per dispatch. */
  if (!iree_status_is_ok(iree_vm_list_create(
          iree_vm_make_undefined_type_def(), MERLIN_INPUT_COUNT, host,
          &st->reusable_inputs))) {
    printk("[hetero h%d] FAIL reusable_inputs create\n", st->hart_id);
    return -1;
  }
  iree_hal_buffer_view_retain(st->pre_input);
  iree_vm_ref_t input_ref = iree_hal_buffer_view_move_ref(st->pre_input);
  if (!iree_status_is_ok(iree_vm_list_push_ref_move(st->reusable_inputs,
                                                    &input_ref))) {
    printk("[hetero h%d] FAIL push pre_input\n", st->hart_id);
    return -1;
  }
  if (!iree_status_is_ok(iree_vm_list_create(
          iree_vm_make_undefined_type_def(), MERLIN_OUTPUT_COUNT, host,
          &st->reusable_outputs))) {
    printk("[hetero h%d] FAIL reusable_outputs create\n", st->hart_id);
    return -1;
  }
  return 0;
}

/* One inference invocation — minimal-overhead steady state.
 *
 * Reuses pre-allocated input + output vm_lists (no heap alloc per call).
 * Hashes outputs only on the first job (job_seq==0); subsequent jobs are
 * byte-identical with zero-filled inputs so we skip d2h + hashing to keep
 * the steady-state dispatch loop tight.
 */
static int worker_invoke_once(merlin_worker_state_t* st, uint32_t job_seq,
                              uint64_t* out_cycles, uint64_t* out_hash) {
  unsigned int irq_key = 0;
  if (st->needs_vector) {
    set_vs_dirty_w();
    irq_key = irq_lock();
    set_vs_dirty_w();
  }

  uint64_t t0 = rdmcycle_w();
  iree_status_t s = iree_vm_invoke(st->vm_context, st->entry_function,
                                   IREE_VM_INVOCATION_FLAG_NONE,
                                   /*policy=*/NULL, st->reusable_inputs,
                                   st->reusable_outputs,
                                   iree_allocator_system());
  uint64_t t1 = rdmcycle_w();

  if (st->needs_vector) {
    irq_unlock(irq_key);
  }

  if (!iree_status_is_ok(s)) {
    iree_status_free(s);
    /* Reset outputs list even on failure so subsequent calls aren't
     * polluted. */
    iree_vm_list_clear(st->reusable_outputs);
    return -1;
  }

  uint64_t hash = 0;
  /* On job 0, walk outputs once to verify correctness via FNV-1a hash.
   * On jobs 1..N, skip — zero-filled inputs produce byte-identical
   * outputs (deterministic dispatch), and we already verified on job 0. */
  if (job_seq == 0) {
    hash = 0xcbf29ce484222325ULL;
    for (int i = 0; i < MERLIN_OUTPUT_COUNT; ++i) {
      iree_hal_buffer_view_t* bv =
          iree_vm_list_get_buffer_view_assign(st->reusable_outputs, i);
      if (!bv) { hash = 0; break; }
      const merlin_tensor_spec_t* spec = &merlin_outputs[i];
      void* host_buf = malloc(spec->byte_count);
      if (!host_buf) { hash = 0; break; }
      iree_status_t d2h_s = iree_hal_device_transfer_d2h(
          st->hal_device, iree_hal_buffer_view_buffer(bv), 0, host_buf,
          spec->byte_count, IREE_HAL_TRANSFER_BUFFER_FLAG_DEFAULT,
          iree_infinite_timeout());
      if (!iree_status_is_ok(d2h_s)) {
        iree_status_free(d2h_s);
        free(host_buf);
        hash = 0;
        break;
      }
      uint64_t h_i = fnv1a64_w(host_buf, spec->byte_count);
      /* 2026-05-19 diagnostic: print PER-OUTPUT hash to localize which
       * intermediate checkpoint first diverges from the ONNX-runtime
       * golden (see tools/diff_dronet_dispatches.py).                  */
      printk("[hetero h%d] out[%d] %s hash=0x%016llx bytes=%u\n",
             st->hart_id, i, spec->name, (unsigned long long)h_i,
             (unsigned)spec->byte_count);
      hash ^= h_i + 0x9e3779b97f4a7c15ULL + (hash << 6) + (hash >> 2);
      free(host_buf);
    }
    st->first_job_hash = hash;
  } else {
    /* Echo the job-0 hash so the per-job log shows a stable identifier
     * (we believe the output is byte-identical to job 0). */
    hash = st->first_job_hash;
  }

  /* Clear output list so the next invoke starts clean. The buffer
   * views are dropped; the underlying buffers are freed by ref count.
   * This is O(MERLIN_OUTPUT_COUNT), no heap alloc. */
  iree_vm_list_clear(st->reusable_outputs);

  *out_cycles = t1 - t0;
  *out_hash = hash;
  return 0;
}

void merlin_worker_entry(void* state, void* arg2, void* arg3) {
  (void)arg2;
  (void)arg3;
  merlin_worker_state_t* st = (merlin_worker_state_t*)state;
  int hart_now = arch_curr_cpu()->id;
  printk("[hetero h%d] worker on hart %d (expected %d), backend=%s\n",
         st->hart_id, hart_now, st->hart_id, st->backend_name);
  if (hart_now != st->hart_id) {
    printk("[hetero h%d] WARN wrong hart\n", st->hart_id);
  }

  if (st->needs_vector) set_vs_dirty_w();

  /* One-shot init. Measure for the per-hart phase summary. */
  uint64_t init_t0 = rdmcycle_w();
  if (worker_init(st) != 0) {
    /* Mark failure by leaving startup_sem ungiven; main will time out. */
    return;
  }
  uint64_t init_t1 = rdmcycle_w();
  st->cycles_init = init_t1 - init_t0;
  st->cycles_min_invoke = UINT64_MAX;
  printk("[hetero h%d] init done cycles=%llu\n",
         st->hart_id, (unsigned long long)st->cycles_init);
  k_sem_give(&st->startup_sem);

  /* Job loop. A job_id of UINT32_MAX is the shutdown sentinel. */
  for (;;) {
    merlin_job_t job;
    int rc = k_msgq_get(st->job_msgq, &job, K_FOREVER);
    if (rc != 0) continue;
    if (job.job_id == UINT32_MAX) {
      /* Drain signal; cleanup and exit. */
      break;
    }

    uint64_t cyc = 0, hash = 0;
    /* st->completed_jobs is the per-worker job sequence (0-based);
     * worker_invoke_once uses this to decide whether to hash outputs. */
    int inv_rc = worker_invoke_once(st, st->completed_jobs, &cyc, &hash);
    job.out_cycles = cyc;
    job.out_hash = hash;
    job.out_rc = inv_rc;
    job.hart_id = (uint32_t)st->hart_id;

    if (inv_rc == 0) {
      st->cycles_total_invoke += cyc;
      st->completed_jobs += 1;
      if (cyc < st->cycles_min_invoke) st->cycles_min_invoke = cyc;
      if (cyc > st->cycles_max_invoke) st->cycles_max_invoke = cyc;
    }

    /* Signal main. The job descriptor was passed by value; we report
     * back via the completion_sem and a shared in-memory result table
     * indexed by job_id (filled by main from the worker's view of the
     * job struct via the sem-take side; here we just signal). */
    if (job.completion_sem) {
      /* Stash the worker's view into a global result table for main
       * to read after sem_take. We can't write back into the caller's
       * stack-allocated job_t directly via the msgq (it was copied). */
      extern void merlin_record_job_result(uint32_t job_id,
                                           uint64_t cycles,
                                           uint64_t hash, int rc,
                                           uint32_t hart_id);
      merlin_record_job_result(job.job_id, cyc, hash, inv_rc,
                               (uint32_t)st->hart_id);
      k_sem_give(job.completion_sem);
    }
  }

  /* Per-worker cleanup. Releases happen in reverse order of acquisition;
   * however since we run to shutdown anyway, leaking is acceptable in
   * this bare-metal sample. */
}
```

## src/hetero_worker.h
```c
/*
 * hetero_worker.h — per-hart worker state for merlin_hetero_runner.
 *
 * Each worker thread:
 *   1) creates ONE iree_hal_device + iree_vm_context at startup (amortizes
 *      the ~575 M cycle setup cost),
 *   2) blocks on its own k_msgq for incoming jobs,
 *   3) reuses a pre-allocated zero-filled input across jobs.
 *
 * Per-job overhead in steady state = iree_vm_invoke + d2h + fnv1a only.
 *
 * SPDX-License-Identifier: Apache-2.0
 */
#ifndef MERLIN_HETERO_WORKER_H_
#define MERLIN_HETERO_WORKER_H_

#include <stdint.h>
#include <zephyr/kernel.h>

#include "iree/base/api.h"
#include "iree/hal/api.h"
#include "iree/vm/api.h"

/* One submitted inference. Main fills (job_id, completion_sem); worker
 * fills (cycles, hash, rc) before signalling the sem. */
typedef struct merlin_job {
  uint32_t job_id;
  uint32_t hart_id;        /* which hart actually ran it (for verification) */
  uint64_t out_cycles;
  uint64_t out_hash;
  int32_t  out_rc;
  int32_t  _pad;
  struct k_sem* completion_sem;
} merlin_job_t;

/* VMFB descriptor: pointer + length to xxd-embedded blob. */
typedef struct merlin_vmfb_blob {
  const uint8_t* data;
  uint32_t length;
} merlin_vmfb_blob_t;

/* Per-hart worker. Populated by main before k_thread_start; mutated by the
 * worker thread thereafter (do NOT touch from main while the worker is
 * live except via the msgq / completion_sem channel). */
typedef struct merlin_worker_state {
  /* configured by main */
  int hart_id;
  int needs_vector;       /* 1 if backend uses RVV/OPU → mstatus.VS=Dirty */
  const char* backend_name;
  merlin_vmfb_blob_t vmfb;
  struct k_msgq* job_msgq;
  struct k_sem startup_sem;  /* given by worker once init complete */

  /* owned by worker after init */
  iree_vm_instance_t* vm_instance;
  iree_hal_device_t* hal_device;
  iree_hal_device_group_t* hal_device_group;
  iree_vm_context_t* vm_context;
  iree_vm_function_t entry_function;
  iree_hal_buffer_view_t* pre_input;   /* zero-filled, reused per job */
  iree_vm_list_t* reusable_inputs;     /* preloaded with pre_input, never reset */
  iree_vm_list_t* reusable_outputs;    /* cleared between jobs */
  uint64_t first_job_hash;             /* hashed on job 0 only; subsequent jobs
                                          should be byte-identical and we skip
                                          d2h+hash to save ~10kcycles per job */

  /* steady-state stats (rolling) */
  uint64_t cycles_init;          /* boot/HAL/module init cost on this hart */
  uint64_t cycles_total_invoke;  /* sum of per-job invoke cycles */
  uint64_t cycles_min_invoke;
  uint64_t cycles_max_invoke;
  uint32_t completed_jobs;
} merlin_worker_state_t;

/* Worker thread entry. Pass &merlin_worker_state_t* via the first arg. */
void merlin_worker_entry(void* state, void* arg2, void* arg3);

#endif  /* MERLIN_HETERO_WORKER_H_ */
```

## src/iree_futex_zephyr.c
```c
// Copyright 2026 The IREE Authors
//
// Licensed under the Apache License v2.0 with LLVM Exceptions.
// See https://llvm.org/LICENSE.txt for license information.
// SPDX-License-Identifier: Apache-2.0 WITH LLVM-exception
//
// Zephyr emulation of the iree_futex_* API.
//
// Zephyr has no kernel futex syscall, so we provide a userspace emulation
// backed by a fixed-size pool of (k_mutex, k_condvar) bucket pairs hashed by
// the futex word's address. The implementation mirrors the classic
// "park-on-condvar with double-check inside the mutex" pattern used by
// other lock-free libraries on platforms without native futex support.
//
// Lost-wakeup avoidance:
//   - iree_futex_wait acquires the bucket mutex, re-reads *address, and
//     only descends into k_condvar_wait if it still equals expected_value.
//     k_condvar_wait atomically releases the mutex and waits.
//   - iree_futex_wake acquires the bucket mutex (so it cannot race the
//     read in wait), then signals/broadcasts. After release, woken waiters
//     reacquire the mutex and re-check *address.
//
// Bucket-pool size is set high enough that contention is rare; collisions
// produce spurious wakes (waiters re-check and possibly wait again),
// which is correct but slightly less efficient.

#include "iree/base/target_platform.h"

#if defined(IREE_PLATFORM_ZEPHYR)

#include <stdatomic.h>
#include <stdint.h>

#include <zephyr/kernel.h>

#include "iree/base/threading/futex.h"

#ifndef IREE_FUTEX_ZEPHYR_BUCKET_COUNT
// Must be a power of two so the hash reduction is a single mask.
#define IREE_FUTEX_ZEPHYR_BUCKET_COUNT 32
#endif

typedef struct {
  struct k_mutex lock;
  struct k_condvar cv;
} iree_futex_zephyr_bucket_t;

static iree_futex_zephyr_bucket_t
    iree_futex_zephyr_buckets[IREE_FUTEX_ZEPHYR_BUCKET_COUNT];
static atomic_int iree_futex_zephyr_initialized = 0;

static void iree_futex_zephyr_ensure_initialized(void) {
  // Double-checked init. The first thread to flip the flag from 0 -> 1 does
  // the bucket init; subsequent threads pick up the published state.
  int expected = 0;
  if (atomic_compare_exchange_strong(&iree_futex_zephyr_initialized, &expected,
                                     1)) {
    for (int i = 0; i < IREE_FUTEX_ZEPHYR_BUCKET_COUNT; ++i) {
      k_mutex_init(&iree_futex_zephyr_buckets[i].lock);
      k_condvar_init(&iree_futex_zephyr_buckets[i].cv);
    }
    atomic_store(&iree_futex_zephyr_initialized, 2);
  } else {
    // Wait for the racing initializer to finish publishing.
    while (atomic_load(&iree_futex_zephyr_initialized) != 2) {
      k_yield();
    }
  }
}

static iree_futex_zephyr_bucket_t* iree_futex_zephyr_bucket_for(void* address) {
  // FNV-style folding of the address bits. The bucket count is a power of
  // two so the final mask is cheap.
  uintptr_t a = (uintptr_t)address;
  uintptr_t h = a ^ (a >> 17) ^ (a >> 31);
  return &iree_futex_zephyr_buckets[h & (IREE_FUTEX_ZEPHYR_BUCKET_COUNT - 1)];
}

// Convert IREE absolute-deadline (nanoseconds since epoch) to a Zephyr
// k_timeout_t. IREE_TIME_INFINITE_FUTURE maps to K_FOREVER.
static k_timeout_t iree_futex_zephyr_timeout(iree_time_t deadline_ns) {
  if (deadline_ns == IREE_TIME_INFINITE_FUTURE) return K_FOREVER;
  // Compute relative timeout from current uptime in nanoseconds.
  int64_t now_ns = (int64_t)k_uptime_get() * 1000000LL;
  int64_t rel_ns = (int64_t)deadline_ns - now_ns;
  if (rel_ns <= 0) return K_NO_WAIT;
  return K_NSEC(rel_ns);
}

iree_status_code_t iree_futex_wait_impl_zephyr(void* address,
                                               uint32_t expected_value,
                                               iree_time_t deadline_ns) {
  iree_futex_zephyr_ensure_initialized();
  iree_futex_zephyr_bucket_t* b = iree_futex_zephyr_bucket_for(address);
  k_mutex_lock(&b->lock, K_FOREVER);

  // Double-check inside the bucket lock so we don't miss a concurrent wake.
  uint32_t observed = atomic_load((_Atomic uint32_t*)address);
  if (observed != expected_value) {
    k_mutex_unlock(&b->lock);
    return IREE_STATUS_UNAVAILABLE;
  }

  int rc = k_condvar_wait(&b->cv, &b->lock,
                          iree_futex_zephyr_timeout(deadline_ns));
  k_mutex_unlock(&b->lock);

  if (rc == -EAGAIN) return IREE_STATUS_DEADLINE_EXCEEDED;
  return IREE_STATUS_OK;
}

void iree_futex_wake_impl_zephyr(void* address, int32_t count) {
  iree_futex_zephyr_ensure_initialized();
  iree_futex_zephyr_bucket_t* b = iree_futex_zephyr_bucket_for(address);
  k_mutex_lock(&b->lock, K_FOREVER);
  if (count >= IREE_ALL_WAITERS || count > 1) {
    k_condvar_broadcast(&b->cv);
  } else if (count == 1) {
    k_condvar_signal(&b->cv);
  }
  k_mutex_unlock(&b->lock);
}

#endif  // IREE_PLATFORM_ZEPHYR
```
