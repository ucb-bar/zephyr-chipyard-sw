## CMakeLists.txt
```
# merlin_model_runner — runs a pre-compiled Merlin VMFB on a FireSim Shuttle
# hart and reports an output hash + cycle count.
#
# Parameters (-D...):
#   MERLIN_VMFB           absolute path to the .vmfb to embed (REQUIRED)
#   MERLIN_MODEL          mlp_wide | dronet | yolov8n (REQUIRED)
#   MERLIN_BACKEND        scalar | rvv | opu | gemmini (log-only string)
#   MERLIN_HART           0 or 1 (defaults to 0)
#   MERLIN_CPU_FEATURES   IREE bare-metal feature bitmask, e.g. 0x11 for OPU
#                         (defaults to 0x01 = RVV only)
#
# IREE runtime is pulled in via the `merlin-iree` Zephyr module that ships
# in chipyard's zephyrproject (matching the convention scripts/zephyr_e2e.sh
# uses). Prereq: `./merlin build --profile zephyr` populates
# $MERLIN_ROOT/build/zephyr-vanilla-release/ before this sample is built.
#
# West invocation:
#   west build -p -b chipyard_riscv64/rocketchip_virt_riscv64 \
#       samples/merlin_model_runner \
#       --build-dir <build> \
#       -- -DZEPHYR_EXTRA_MODULES=$CHIPYARD_ROOT/software/zephyrproject/modules/merlin-iree \
#          -DMERLIN_BUILD_DIR=$MERLIN_ROOT/build/zephyr-vanilla-release \
#          -DMERLIN_IREE_HEADERS_DIR=$MERLIN_ROOT/third_party/iree_bar/runtime/src \
#          -DMERLIN_VMFB=<path>.vmfb \
#          -DMERLIN_MODEL=<name> -DMERLIN_BACKEND=<name> -DMERLIN_HART=<0|1> \
#          -DMERLIN_CPU_FEATURES=<hex>

cmake_minimum_required(VERSION 3.20.0)

find_package(Zephyr REQUIRED HINTS $ENV{ZEPHYR_BASE})
project(merlin_model_runner)

# ----- required + defaulted parameters ----------------------------------
if(NOT DEFINED MERLIN_VMFB)
  message(FATAL_ERROR "MERLIN_VMFB must be set (path to compiled .vmfb)")
endif()
if(NOT EXISTS ${MERLIN_VMFB})
  message(FATAL_ERROR "MERLIN_VMFB does not exist: ${MERLIN_VMFB}")
endif()

if(NOT DEFINED MERLIN_MODEL)
  message(FATAL_ERROR
    "MERLIN_MODEL must be set (one of: mlp_wide, dronet, yolov8n)")
endif()
if(MERLIN_MODEL STREQUAL "tiny_matmul")
  set(MERLIN_MODEL_DEFINE MERLIN_MODEL_TINY_MATMUL)
elseif(MERLIN_MODEL STREQUAL "mlp_wide")
  set(MERLIN_MODEL_DEFINE MERLIN_MODEL_MLP_WIDE)
elseif(MERLIN_MODEL STREQUAL "dronet")
  set(MERLIN_MODEL_DEFINE MERLIN_MODEL_DRONET)
elseif(MERLIN_MODEL STREQUAL "yolov8n")
  set(MERLIN_MODEL_DEFINE MERLIN_MODEL_YOLOV8N)
else()
  message(FATAL_ERROR
    "MERLIN_MODEL=${MERLIN_MODEL} invalid; must be tiny_matmul|mlp_wide|dronet|yolov8n")
endif()

if(NOT DEFINED MERLIN_BACKEND)
  set(MERLIN_BACKEND "unknown")
endif()
if(NOT DEFINED MERLIN_HART)
  set(MERLIN_HART 0)
endif()
if(NOT DEFINED MERLIN_CPU_FEATURES)
  set(MERLIN_CPU_FEATURES "0x01")
endif()

# rvv/opu backends need mstatus.VS=Dirty per lesson 4 of the 2026-05-13 blog.
if(MERLIN_BACKEND STREQUAL "rvv" OR MERLIN_BACKEND STREQUAL "opu")
  set(MERLIN_NEEDS_VECTOR 1)
else()
  set(MERLIN_NEEDS_VECTOR 0)
endif()

message(STATUS "merlin_model_runner config:")
message(STATUS "  MERLIN_VMFB          = ${MERLIN_VMFB}")
message(STATUS "  MERLIN_MODEL         = ${MERLIN_MODEL} (-> ${MERLIN_MODEL_DEFINE})")
message(STATUS "  MERLIN_BACKEND       = ${MERLIN_BACKEND}")
message(STATUS "  MERLIN_HART          = ${MERLIN_HART}")
message(STATUS "  MERLIN_CPU_FEATURES  = ${MERLIN_CPU_FEATURES}")
message(STATUS "  MERLIN_NEEDS_VECTOR  = ${MERLIN_NEEDS_VECTOR}")

# ----- embed VMFB as a C header via xxd ---------------------------------
find_program(XXD_EXECUTABLE xxd REQUIRED)

set(MERLIN_VMFB_LOCAL  ${CMAKE_CURRENT_BINARY_DIR}/merlin_model.vmfb)
set(MERLIN_VMFB_HEADER ${CMAKE_CURRENT_BINARY_DIR}/merlin_vmfb.h)

add_custom_command(
  OUTPUT ${MERLIN_VMFB_LOCAL} ${MERLIN_VMFB_HEADER}
  COMMAND ${CMAKE_COMMAND} -E copy_if_different ${MERLIN_VMFB} ${MERLIN_VMFB_LOCAL}
  COMMAND ${XXD_EXECUTABLE} -i -n merlin_vmfb merlin_model.vmfb > ${MERLIN_VMFB_HEADER}
  DEPENDS ${MERLIN_VMFB}
  WORKING_DIRECTORY ${CMAKE_CURRENT_BINARY_DIR}
  COMMENT "Embedding VMFB ${MERLIN_VMFB} -> merlin_vmfb.h"
  VERBATIM)
add_custom_target(merlin_vmfb_header DEPENDS ${MERLIN_VMFB_HEADER})

# ----- application sources ----------------------------------------------
# iree_thread_zephyr.c / iree_futex_zephyr.c provide the implementations
# of iree_thread_* / iree_futex_*_impl_zephyr referenced by the IREE
# archives (which were built with IREE_PLATFORM_ZEPHYR + threading=ON
# but without Zephyr's kernel headers). Linked at the final app link.
target_sources(app PRIVATE
  src/main.c
  src/device_stubs.c
  src/iree_thread_zephyr.c     # iree_thread_* -> k_thread_*
  src/iree_futex_zephyr.c      # iree_futex_*  -> k_mutex+k_condvar bucket pool
  src/iree_picolibc_compat.c   # newlib -> picolibc symbol bridge
)
add_dependencies(app merlin_vmfb_header)

target_include_directories(app PRIVATE
  ${CMAKE_CURRENT_BINARY_DIR}    # for generated merlin_vmfb.h
  ${CMAKE_CURRENT_LIST_DIR}/src  # for model_info.h
)

target_compile_definitions(app PRIVATE
  ${MERLIN_MODEL_DEFINE}
  MERLIN_BACKEND="${MERLIN_BACKEND}"
  MERLIN_HART=${MERLIN_HART}
  MERLIN_NEEDS_VECTOR=${MERLIN_NEEDS_VECTOR}
)

# 2026-05-22: enable per-dispatch cycle profiling. This wraps every ELF
# call in embedded_elf_loader.c with rdcycle, accumulates into
# iree_merlin_cycles_per_ordinal[]. iree_merlin_dump_cycles() is then
# invoked from main.c to emit `CYC, ord, sym, total_cycles, wg_count`
# lines we can parse offline into a per-dispatch profile table.
# The merlin_hetero_runner sample already had this; merlin_model_runner
# did not.
target_compile_definitions(merlin_iree INTERFACE MERLIN_PROFILE_CYCLES=1)

# Per-dispatch Gemmini hardware counter profiling. Opt-in to match the
# runtime archive build (see iree_bar runtime CMakeLists.txt for the
# MERLIN_GEMMINI_COUNTERS option). Enable with
# `west build -- -DMERLIN_GEMMINI_COUNTERS=ON`.
if(MERLIN_GEMMINI_COUNTERS)
  target_compile_definitions(merlin_iree INTERFACE MERLIN_PROFILE_COUNTERS=1)
endif()

# ----- merlin-iree Zephyr module (provides IREE static runtime) ---------
# The merlin-iree Kconfig option is auto-enabled by our prj.conf
# (CONFIG_MERLIN_IREE=y). The module CMakeLists imports the IREE static
# archives from $MERLIN_BUILD_DIR (or $MERLIN_INSTALL_DIR), exposes them as
# the `merlin_iree` interface library, and sets the necessary
# IREE_PLATFORM_GENERIC / IREE_FILE_IO_ENABLE / IREE_WAIT_UNTIL_FN /
# atomics-shim defines on the consumer. No ExternalProject build, no
# duplicated IREE compilation.
target_link_libraries(app PRIVATE merlin_iree)

# IREE_BARE_METAL_CPU_DATA0 must be visible to consumer code too (the
# inline ukernel dispatcher reads it from cpu_data). The merlin-iree
# archives are pre-baked with whatever bitmask `./merlin build --profile
# zephyr` was invoked with; setting it here matches that baseline.
target_compile_definitions(app PRIVATE
  IREE_BARE_METAL_CPU_DATA0=${MERLIN_CPU_FEATURES}
)
```

## sample.yaml
```
sample:
  name: Merlin VMFB runner for FireSim Shuttle (Gemmini/OPU/RVV/scalar)
common:
  tags: chipyard merlin iree
  harness: console
  harness_config:
    fixture: fixture_1
tests:
  sample.chipyard.merlin_model_runner:
    platform_allow: spike_riscv64/rocketchip_virt_riscv64
```

## prj.conf
```kconfig
# SMP configuration for FireSimGemminiAndOPUShuttleConfig (2 Shuttle tiles).
# Lessons 1-3 from docs/dev_blog/2026-05-13-zephyr-on-hetero-shuttle-firesim.md.
CONFIG_PRINTK=y
CONFIG_STDOUT_CONSOLE=y
# 2026-05-24: STACK_SENTINEL + THREAD_STACK_INFO add a canary check at
# every thread-switch and reserve a tracking struct per thread. Debug
# aids only — disabled for profile-clean runs. Re-enable if we hit a
# stack-overflow regression and need the canary diagnostic.
CONFIG_THREAD_STACK_INFO=n
CONFIG_STACK_SENTINEL=n

CONFIG_MP_MAX_NUM_CPUS=2
CONFIG_SMP=y
CONFIG_SCHED_CPU_MASK=y
CONFIG_SCHED_CPU_MASK_PIN_ONLY=y
CONFIG_SCHED_DUMB=y

# Lesson 3: direct-putchar HTIF has an SMP race. Use the buffered+syscall path.
CONFIG_UART_HTIF_BUFFERED_OUTPUT=y
CONFIG_UART_HTIF_BUFFERED_OUTPUT_SIZE=256
CONFIG_UART_HTIF_SYSCALL_PRINT=y

# CONFIG_FPU_SHARING defaults to y when CONFIG_FPU=y. Its trap handler
# (z_riscv_fpu_trap) catches FP-illegal-instr traps AND incorrectly
# claims V-illegal-instr traps. Turning off FPU sharing routes V traps
# through the standard fault path so we see the crash (then deal with
# VS=Off properly with set_vs_dirty() in the worker entry, which works
# for non-preempted threads).
CONFIG_FPU_SHARING=n

# Do NOT set CONFIG_RISCV_ISA_EXT_V=y here.
#
# 2026-06-02: bumped the Zephyr submodule to saturn-fork-wip (which
# adds arch/riscv/core/v.c with decoupled V/F save-restore + native
# RISCV_V_KERNEL_ONLY Kconfig) and tried enabling V properly:
#   Variant A (V=y, LAZY=n, FPU_SHARING=y, V_KERNEL_ONLY=y):
#     dronet -0.5% bit-perfect ✓, mlp_wide +3.7% bit-perfect ✓,
#     yolov8n BIT-PERFECT FAILED (hash 0x9351d8a30bab3ddc).
#   Variant B (V=y, LAZY=n, FPU_SHARING=n, V_KERNEL_ONLY=y):
#     yolov8n BIT-PERFECT FAILED with a DIFFERENT wrong hash
#     (0xce3cecd5a07215b9).
# Two different wrong hashes confirms timing-dependent state corruption
# from v.c's V-state save/restore on context switch — likely a v-reg
# save/restore bug that only surfaces under yolov8n's high
# preemption-point count (1.7B cycles, 297+ dispatches). dronet and
# mlp_wide are too short to trigger it.
#
# Workaround until v.c is debugged: keep V disabled at Kconfig and
# use the set_vs_dirty() preamble + irq_lock around iree_vm_invoke.
# Worker thread on hart 1 never gets preempted during dispatch →
# v-regs and m-regs stay consistent within one model invoke.

# IREE VM module init uses an 8KB inline VM stack; need headroom on main stack.
CONFIG_MAIN_STACK_SIZE=32768

# Libc: picolibc (Zephyr SDK default).
# The IREE archives in $MERLIN_ROOT/build/zephyr-vanilla-release/ reference
# newlib's _ctype_, _impure_ptr, __errno — picolibc doesn't have them.
# Rather than rebuild IREE against a different libc, we bridge via
# src/iree_picolibc_compat.c which provides stub definitions. Those
# references are only present from archive-symbol resolution; the actual
# code paths are dead under IREE_PLATFORM_GENERIC + IREE_ENABLE_THREADING=OFF
# + IREE_FILE_IO_ENABLE=0 and --gc-sections drops them at the final link.

# Let picolibc's libc.a provide malloc/free. CONFIG_COMMON_LIBC_MALLOC
# is defaulted on by something in the dep chain — explicitly disable to
# stop Zephyr's common malloc from colliding with picolibc's
# nano-malloc.c. Real __heap_start/__heap_end symbols are exported from
# src/iree_picolibc_compat.c so picolibc's sbrk has a working 4 MiB BSS
# heap.
CONFIG_COMMON_LIBC_MALLOC=n

# IREE + embedded VMFB + HAL buffers + per-model input/output tensors.
# 2026-05-22: bumped to 64 MiB. yolov8n's 9.35 MB Gemmini VMFB expands to
# ~20 MB of loaded dispatch ELFs + intermediate buffers and tripped
# RESOURCE_EXHAUSTED in iree_hal_executable_create with 4 MiB. The chipyard
# SoC has 256 MiB SRAM at 0x80000000 so 64 MiB is well within budget.
CONFIG_HEAP_MEM_POOL_SIZE=67108864

# POSIX shim — IREE compiles cleanly under IREE_PLATFORM_GENERIC but the
# Zephyr-side glue assumes POSIX-like nullable wait/time primitives.
CONFIG_POSIX_API=y
CONFIG_MULTITHREADING=y
CONFIG_POSIX_THREADS=y

# Pull in the merlin-iree Zephyr module's static IREE runtime archives.
# The module Kconfig (chipyard zephyrproject/modules/merlin-iree/zephyr/Kconfig)
# gates archive import + the merlin_iree interface library on this option.
CONFIG_MERLIN_IREE=y
CONFIG_FPU=y
```

## src/main.c
```c
/*
 * merlin_model_runner: load a Merlin-compiled VMFB on a FireSim Shuttle hart,
 * run the model on zero-filled input, hash the output, print cycle counts.
 *
 * Configured at build time:
 *   -DMERLIN_MODEL_<NAME>   (one of MLP_WIDE / DRONET / YOLOV8N)
 *   -DMERLIN_BACKEND="<str>"   (scalar | rvv | opu | gemmini, log-only)
 *   -DMERLIN_HART=<0|1>     (hart to pin onto)
 *   -DMERLIN_NEEDS_VECTOR=<0|1>  (if 1, set mstatus.VS=Dirty before invoking)
 *
 * The embedded VMFB is supplied via merlin_vmfb.h (generated by `xxd -i`).
 * Background:
 *   - SMP setup (DT overlay, prj.conf) follows samples/gemmini_opu_test/.
 *   - mstatus.VS=Dirty preamble per lesson 4 of
 *     docs/dev_blog/2026-05-13-zephyr-on-hetero-shuttle-firesim.md.
 *   - IREE call sequence mirrors samples/iree/simple_embedding/.
 *
 * SPDX-License-Identifier: Apache-2.0
 */

#include <stdio.h>
#include <stdint.h>
#include <stddef.h>
#include <stdlib.h>
#include <string.h>

#include <zephyr/kernel.h>
#include <zephyr/arch/cpu.h>
#include <zephyr/sys/printk.h>
#include <zephyr/sys/reboot.h>

#include "iree/base/api.h"
#include "iree/hal/api.h"
#include "iree/hal/device_group.h"
#include "iree/hal/local/loaders/merlin_gemmini_counter.h"
#include "iree/modules/hal/module.h"
#include "iree/vm/api.h"
#include "iree/vm/bytecode/module.h"

#include "model_info.h"

#ifndef MERLIN_BACKEND
#define MERLIN_BACKEND "unknown"
#endif
#ifndef MERLIN_HART
#define MERLIN_HART 0
#endif
#ifndef MERLIN_NEEDS_VECTOR
#define MERLIN_NEEDS_VECTOR 0
#endif
#if defined(MERLIN_MODEL_MLP_WIDE)
#define MERLIN_MODEL_NAME "mlp_wide"
#elif defined(MERLIN_MODEL_DRONET)
#define MERLIN_MODEL_NAME "dronet"
#elif defined(MERLIN_MODEL_YOLOV8N)
#define MERLIN_MODEL_NAME "yolov8n"
#else
#define MERLIN_MODEL_NAME "unknown"
#endif

/* Provided by device_stubs.c. */
extern iree_status_t create_sample_device(iree_allocator_t host_allocator,
                                          iree_hal_device_t** out_device);
extern const iree_const_byte_span_t load_bytecode_module_data(void);

/* ---------- helpers ---------- */

static inline uint64_t rdmcycle(void) {
  uint64_t c;
  __asm__ __volatile__("csrr %0, mcycle\n" : "=r"(c));
  return c;
}

/* ---------- phase instrumentation ----------
 * Capture rdmcycle at well-defined boundaries so we can show how the
 * inference wall splits across (Zephyr boot, IREE module init, HAL device
 * setup, dispatch execution, output teardown). Stamps go into a static
 * array; we print one batched summary at end-of-main so the HTIF UART
 * cost (~30 Mcycles/line) shows up exactly once and doesn't pollute the
 * deltas being measured.
 *
 * Boundary stamps (added BEFORE the named operation completes; delta to
 * the next stamp is the operation's cost):
 */
typedef enum {
  PHASE_MAIN_ENTRY,            /* 0  → boot+zephyr_init */
  PHASE_WORKER_STARTED,        /* 1  → spawn+pin overhead */
  PHASE_RUN_INFERENCE_ENTRY,   /* 2  */
  PHASE_VM_INSTANCE_CREATED,   /* 3  */
  PHASE_DEVICE_CREATED,        /* 4  */
  PHASE_DEVICE_GROUP_CREATED,  /* 5  */
  PHASE_HAL_MODULE_CREATED,    /* 6  */
  PHASE_BYTECODE_MODULE_CREATED, /* 7 */
  PHASE_CONTEXT_CREATED,       /* 8  */
  PHASE_FUNCTION_RESOLVED,     /* 9  */
  PHASE_INPUTS_BUILT,          /* 10 */
  PHASE_OUTPUTS_LIST_CREATED,  /* 11 */
  PHASE_INVOKE_T0,             /* 12 → entire IREE bytecode invoke + dispatches */
  PHASE_INVOKE_T1,             /* 13 */
  PHASE_OUTPUTS_HASHED,        /* 14 → d2h + fnv1a hashing */
  PHASE_RUN_INFERENCE_EXIT,    /* 15 */
  PHASE_MAIN_EXIT,             /* 16 */
  PHASE__COUNT,
} merlin_phase_t;

static const char* const k_phase_name[PHASE__COUNT] = {
    "main_entry", "worker_started", "run_inference_entry",
    "vm_instance_created", "device_created", "device_group_created",
    "hal_module_created", "bytecode_module_created", "context_created",
    "function_resolved", "inputs_built", "outputs_list_created",
    "invoke_t0", "invoke_t1", "outputs_hashed", "run_inference_exit",
    "main_exit",
};

static uint64_t g_phase_stamp[PHASE__COUNT];

static inline void merlin_phase_stamp(merlin_phase_t p) {
  g_phase_stamp[p] = rdmcycle();
}

static void merlin_phase_dump(void) {
  /* Print one line per BOUNDARY-TO-BOUNDARY delta plus the absolute
   * timestamps (so a parser can verify monotonicity). One batched output
   * block; this paid for itself once via HTIF UART. */
  printf("[phase] === Merlin phase summary ===\n");
  for (int i = 0; i < PHASE__COUNT; ++i) {
    if (g_phase_stamp[i] == 0 && i != PHASE_MAIN_ENTRY) continue;
    uint64_t delta = 0;
    if (i > 0 && g_phase_stamp[i] > 0 && g_phase_stamp[i - 1] > 0) {
      delta = g_phase_stamp[i] - g_phase_stamp[i - 1];
    }
    printf("[phase] %2d %-26s abs=%llu delta_from_prev=%llu\n",
           i, k_phase_name[i],
           (unsigned long long)g_phase_stamp[i],
           (unsigned long long)delta);
  }
  /* Highlight the inference itself separately. */
  uint64_t inv = g_phase_stamp[PHASE_INVOKE_T1] - g_phase_stamp[PHASE_INVOKE_T0];
  uint64_t total = g_phase_stamp[PHASE_MAIN_EXIT] - g_phase_stamp[PHASE_MAIN_ENTRY];
  printf("[phase] invoke_cycles=%llu  main_cycles=%llu  invoke_frac=%llu/1000\n",
         (unsigned long long)inv, (unsigned long long)total,
         total ? (unsigned long long)((inv * 1000ULL) / total) : 0ULL);
}

/* Per-dispatch cycle log fed by embedded_elf_loader.c. Captured during
 * inference into static memory (no HTIF per-dispatch). Dumped once here. */
typedef struct {
  uint32_t ordinal;
  uint32_t wg_x;
  uint32_t wg_y;
  uint32_t wg_z;
  uint64_t cycles;
  int32_t ret;
  int32_t _pad;
} merlin_dispatch_log_entry_t;

extern merlin_dispatch_log_entry_t merlin_dispatch_log[];
extern uint32_t merlin_dispatch_log_count;

static void merlin_dispatch_dump(void) {
  printf("[disp] === per-dispatch cycle log (n=%u) ===\n",
         (unsigned)merlin_dispatch_log_count);
  uint64_t sum = 0;
  for (uint32_t i = 0; i < merlin_dispatch_log_count; ++i) {
    const merlin_dispatch_log_entry_t* e = &merlin_dispatch_log[i];
    printf("[disp] ord=%u wg=(%u,%u,%u) cycles=%llu ret=%d\n",
           (unsigned)e->ordinal,
           (unsigned)e->wg_x, (unsigned)e->wg_y, (unsigned)e->wg_z,
           (unsigned long long)e->cycles, (int)e->ret);
    sum += e->cycles;
  }
  printf("[disp] dispatch_cycles_total=%llu\n", (unsigned long long)sum);
}

/* FNV-1a 64-bit over a byte span; deterministic across backends so we can
 * cross-check output identity. */
static uint64_t fnv1a64(const void* data, size_t len) {
  const uint8_t* p = (const uint8_t*)data;
  uint64_t h = 0xcbf29ce484222325ULL;
  for (size_t i = 0; i < len; ++i) {
    h ^= (uint64_t)p[i];
    h *= 0x100000001b3ULL;
  }
  return h;
}

static inline void set_vs_dirty(void) {
  /* lesson 4: enable mstatus.VS so per-hart vector ops don't trap when the
   * Zephyr global config has CONFIG_RISCV_ISA_EXT_V=n.
   *
   * lesson 5 (2026-05-25): ALSO set mstatus.XS=Dirty. Zephyr's reset.S sets
   * FS and VS but NOT XS. Non-LOOP_WS Gemmini opcodes (MVIN/MVOUT/...) appear
   * to bypass the XS gate, but LOOP_WS opcodes (used by the Phase-8 bulk
   * matmul path) require XS=Dirty or the FireSim Shuttle Gemmini hangs.
   * Verified via zephyr_gemmini_canonical_test which calls gemmini-rocc-tests
   * tiled_matmul_auto(WS) — works at 2803 cycles for 64x64x64 with XS=Dirty,
   * hangs forever without.
   */
  unsigned long bits = (3UL << 9) | (3UL << 15);  /* VS=Dirty | XS=Dirty */
  __asm__ __volatile__("csrs mstatus, %0" :: "r"(bits));
}

#define IREE_CHECK(expr, what)                                            \
  do {                                                                    \
    iree_status_t _s = (expr);                                            \
    if (!iree_status_is_ok(_s)) {                                         \
      printf("[merlin] FAIL at %s\n", (what));                            \
      iree_status_fprint(stderr, _s);                                     \
      iree_status_free(_s);                                               \
      return -1;                                                          \
    }                                                                     \
  } while (0)

/* ---------- run one inference ---------- */

static int run_inference(uint64_t* out_cycles, uint64_t* out_hash) {
  merlin_phase_stamp(PHASE_RUN_INFERENCE_ENTRY);
  /* 2026-05-23: dispatch_debug stays OFF for fast profiling — per-call
   * UART prints ([dn]/[dc]/[entry]/[bcontent]/[bprobe]/[binding]) saturate
   * FireSim's slow buffered HTIF and dominate wall time (yolov8n × scalar
   * was 2h25min model + 30min dispatch-log dump in the chatty variant).
   * Symbol names are still captured silently into iree_merlin_sym_per_ordinal[]
   * by the loader and emitted once at end via iree_merlin_dump_cycles(). */
  iree_allocator_t host_allocator = iree_allocator_system();

  iree_vm_instance_t* instance = NULL;
  IREE_CHECK(iree_vm_instance_create(IREE_VM_TYPE_CAPACITY_DEFAULT,
                                     host_allocator, &instance),
             "vm_instance_create");
  IREE_CHECK(iree_hal_module_register_all_types(instance),
             "hal_register_types");
  printk("[rinf] B vm_instance ok\n");
  merlin_phase_stamp(PHASE_VM_INSTANCE_CREATED);

  iree_hal_device_t* device = NULL;
  IREE_CHECK(create_sample_device(host_allocator, &device),
             "create_sample_device");
  printk("[rinf] C device ok\n");
  merlin_phase_stamp(PHASE_DEVICE_CREATED);

  iree_hal_device_group_t* device_group = NULL;
  IREE_CHECK(iree_hal_device_group_create_from_device(
                 device, host_allocator, &device_group),
             "device_group_create_from_device");
  printk("[rinf] D device_group ok\n");
  merlin_phase_stamp(PHASE_DEVICE_GROUP_CREATED);

  iree_vm_module_t* hal_module = NULL;
  IREE_CHECK(iree_hal_module_create(
                 instance, iree_hal_module_device_policy_default(),
                 device_group, IREE_HAL_MODULE_FLAG_SYNCHRONOUS,
                 iree_hal_module_debug_sink_null(), host_allocator,
                 &hal_module),
             "hal_module_create");
  printk("[rinf] E hal_module ok\n");
  merlin_phase_stamp(PHASE_HAL_MODULE_CREATED);

  const iree_const_byte_span_t module_data = load_bytecode_module_data();
  printk("[rinf] F module_data size=%zu\n", module_data.data_length);

  iree_vm_module_t* bytecode_module = NULL;
  IREE_CHECK(iree_vm_bytecode_module_create(
                 instance, IREE_VM_BYTECODE_MODULE_FLAG_NONE, module_data,
                 iree_allocator_null(), host_allocator, &bytecode_module),
             "vm_bytecode_module_create");
  printk("[rinf] G bytecode_module ok\n");
  merlin_phase_stamp(PHASE_BYTECODE_MODULE_CREATED);

  iree_vm_context_t* context = NULL;
  iree_vm_module_t* modules[] = {hal_module, bytecode_module};
  IREE_CHECK(iree_vm_context_create_with_modules(
                 instance, IREE_VM_CONTEXT_FLAG_NONE, IREE_ARRAYSIZE(modules),
                 &modules[0], host_allocator, &context),
             "vm_context_create");
  printk("[rinf] H context ok\n");
  merlin_phase_stamp(PHASE_CONTEXT_CREATED);
  iree_vm_module_release(hal_module);
  iree_vm_module_release(bytecode_module);

  iree_vm_function_t main_function;
/* [bp] startup print stripped 2026-05-23 */
  IREE_CHECK(iree_vm_context_resolve_function(
                 context, iree_make_cstring_view(MERLIN_ENTRY_FUNCTION_NAME),
                 &main_function),
             "resolve_function");
  printk("[rinf] I function resolved\n");
  merlin_phase_stamp(PHASE_FUNCTION_RESOLVED);

  /* Build inputs: one or more zero-filled tensors per merlin_inputs[]. */
  iree_vm_list_t* inputs = NULL;
  IREE_CHECK(iree_vm_list_create(iree_vm_make_undefined_type_def(),
                                 MERLIN_INPUT_COUNT, host_allocator, &inputs),
             "inputs_list_create");

  for (int i = 0; i < MERLIN_INPUT_COUNT; ++i) {
    const merlin_tensor_spec_t* spec = &merlin_inputs[i];
    void* zero_buf = calloc(1, spec->byte_count);
    if (!zero_buf) {
      printf("[merlin] FAIL: calloc(%zu) for input %d\n",
             spec->byte_count, i);
      return -1;
    }
    iree_hal_buffer_view_t* bv = NULL;
    iree_status_t s = iree_hal_buffer_view_allocate_buffer_copy(
        device, iree_hal_device_allocator(device), spec->rank, spec->shape,
        spec->element_type, IREE_HAL_ENCODING_TYPE_DENSE_ROW_MAJOR,
        (iree_hal_buffer_params_t){
            .type = IREE_HAL_MEMORY_TYPE_DEVICE_LOCAL,
            .usage = IREE_HAL_BUFFER_USAGE_DEFAULT,
        },
        iree_make_const_byte_span(zero_buf, spec->byte_count), &bv);
    free(zero_buf);
    if (!iree_status_is_ok(s)) {
      printf("[merlin] FAIL upload input %d\n", i);
      iree_status_fprint(stderr, s);
      iree_status_free(s);
      return -1;
    }
    iree_vm_ref_t ref = iree_hal_buffer_view_move_ref(bv);
    IREE_CHECK(iree_vm_list_push_ref_move(inputs, &ref), "push_input");
  }
  merlin_phase_stamp(PHASE_INPUTS_BUILT);

  iree_vm_list_t* outputs = NULL;
  IREE_CHECK(iree_vm_list_create(iree_vm_make_undefined_type_def(),
                                 MERLIN_OUTPUT_COUNT, host_allocator,
                                 &outputs),
             "outputs_list_create");
  merlin_phase_stamp(PHASE_OUTPUTS_LIST_CREATED);

/* invoking print stripped 2026-05-23 */
  /* 2026-05-24: always irq_lock during invoke, not only for RVV paths.
   * Zephyr's tick timer fires at CONFIG_SYS_CLOCK_TICKS_PER_SEC and each
   * ISR + context-switch adds a few kcycles of jitter to the measured
   * cycle count. The worker thread is cooperatively scheduled and the
   * fence rw,rw in embedded_elf_loader handles all Gemmini DMA coherency,
   * so suppressing ticks is safe for all backends. set_vs_dirty() is also
   * harmless on non-V configs (the VS bits are WARL no-ops there). */
  set_vs_dirty();
  unsigned int irq_key = irq_lock();
  set_vs_dirty();  /* re-arm after irq_lock in case it touched mstatus */
  printk("[rinf] J pre invoke\n");
  uint64_t t0 = rdmcycle();
  merlin_phase_stamp(PHASE_INVOKE_T0);
  iree_status_t invoke_status =
      iree_vm_invoke(context, main_function, IREE_VM_INVOCATION_FLAG_NONE,
                     /*policy=*/NULL, inputs, outputs, host_allocator);
  uint64_t t1 = rdmcycle();
  merlin_phase_stamp(PHASE_INVOKE_T1);
  irq_unlock(irq_key);
  printk("[rinf] K post invoke ok=%d\n", iree_status_is_ok(invoke_status));
  if (!iree_status_is_ok(invoke_status)) {
    printf("[merlin] FAIL vm_invoke\n");
    iree_status_fprint(stderr, invoke_status);
    iree_status_free(invoke_status);
    return -1;
  }
  *out_cycles = t1 - t0;

  /* Pull every output back to the host, accumulate one rolling FNV-1a hash. */
  uint64_t hash = 0xcbf29ce484222325ULL;
  for (int i = 0; i < MERLIN_OUTPUT_COUNT; ++i) {
    iree_hal_buffer_view_t* bv =
        iree_vm_list_get_buffer_view_assign(outputs, i);
    if (!bv) {
      printf("[merlin] FAIL: missing output %d\n", i);
      return -1;
    }
    const merlin_tensor_spec_t* spec = &merlin_outputs[i];
    void* host_buf = malloc(spec->byte_count);
    if (!host_buf) {
      printf("[merlin] FAIL: malloc(%zu) for output %d\n",
             spec->byte_count, i);
      return -1;
    }
    iree_status_t s = iree_hal_device_transfer_d2h(
        device, iree_hal_buffer_view_buffer(bv), 0, host_buf,
        spec->byte_count, IREE_HAL_TRANSFER_BUFFER_FLAG_DEFAULT,
        iree_infinite_timeout());
    if (!iree_status_is_ok(s)) {
      free(host_buf);
      printf("[merlin] FAIL d2h transfer output %d\n", i);
      iree_status_fprint(stderr, s);
      iree_status_free(s);
      return -1;
    }
    /* Mix per-output FNV-1a into the running hash. */
    uint64_t h_i = fnv1a64(host_buf, spec->byte_count);
    hash ^= h_i + 0x9e3779b97f4a7c15ULL + (hash << 6) + (hash >> 2);
    free(host_buf);
  }
  *out_hash = hash;
  merlin_phase_stamp(PHASE_OUTPUTS_HASHED);

  iree_vm_list_release(inputs);
  iree_vm_list_release(outputs);
  iree_hal_device_group_release(device_group);
  iree_hal_device_release(device);
  iree_vm_context_release(context);
  iree_vm_instance_release(instance);
  merlin_phase_stamp(PHASE_RUN_INFERENCE_EXIT);
  return 0;
}

/* ---------- entry ---------- */

/* Result handed back from the worker thread to main. */
typedef struct {
  uint64_t cycles;
  uint64_t hash;
  int rc;
} merlin_worker_result_t;

static merlin_worker_result_t g_worker_result;

/* Worker thread entry: runs the actual IREE inference on the target hart.
 * Zephyr's k_thread_cpu_pin only works on threads created (and not yet
 * started) via k_thread_create; the main cooperative thread on the boot
 * hart cannot be migrated. So for hart 1 backends (rvv, opu) we spawn a
 * pinned worker; for hart 0 backends (scalar, gemmini) main itself is
 * already on hart 0 and could run inline, but going through the worker
 * unconditionally keeps the code path uniform. */
static void merlin_worker_entry(void *a, void *b, void *c) {
  (void)a; (void)b; (void)c;
  int hart_now = arch_curr_cpu()->id;
  if (hart_now != MERLIN_HART) {
    printk("[merlin] WARN: worker landed on wrong hart\n");
  }
  /* lesson 4+5 (2026-05-25): enable mstatus.VS=Dirty for vector backends
   * AND mstatus.XS=Dirty for gemmini LOOP_WS opcodes. set_vs_dirty() sets
   * both bits — call unconditionally; clearing VS for non-V backends is
   * harmless. */
  set_vs_dirty();
  /* Program Gemmini's 8-counter panel before any dispatch runs.
   * Header expands to a no-op shim when MERLIN_PROFILE_COUNTERS is
   * unset, so this is safe to call unconditionally. */
  merlin_gemmini_counter_panel_init();
  g_worker_result.rc = run_inference(&g_worker_result.cycles,
                                     &g_worker_result.hash);
}

/* 2026-05-22: bumped from 64 KiB to 4 MiB. IREE's dispatch_2 for dronet's
 * matmul_3136x32x27 emits ~401 KiB of stack allocas in the prologue (M=3136
 * × bookkeeping for the outer-M tile loop). With 64 KiB the worker thread
 * blows the stack inside the dispatch ELF and Zephyr hangs in fault path.
 * See project_dronet_gemmini_resolved_stack_overflow.md for the original
 * diagnosis. 4 MiB has headroom for yolov8n's larger conv-stack dispatches
 * too. */
#define MERLIN_WORKER_STACK_SIZE (4 * 1024 * 1024)
K_THREAD_STACK_DEFINE(merlin_worker_stack, MERLIN_WORKER_STACK_SIZE);
static struct k_thread merlin_worker_thread;

int main(void) {
  merlin_phase_stamp(PHASE_MAIN_ENTRY);
/* banner print stripped 2026-05-23 */
  printf("model=%s backend=%s hart=%d needs_vector=%d\n",
         MERLIN_MODEL_NAME, MERLIN_BACKEND, MERLIN_HART, MERLIN_NEEDS_VECTOR);

  /* Spawn a worker thread pinned to MERLIN_HART. cpu_pin must be set
   * BEFORE k_thread_start; create-suspended via K_FOREVER + start lets us
   * do that. SCHED_CPU_MASK + SCHED_CPU_MASK_PIN_ONLY are enabled in
   * prj.conf. */
  /* Cooperative priority — Zephyr won't context-switch this thread away
   * unless it explicitly yields/blocks. Critical for the V backend on
   * hart 1: mstatus.VS=Dirty is set once at thread entry; a preempting
   * scheduler would save/restore mstatus per the thread's CONFIG view
   * (which doesn't know about V on hart 1), clearing VS. With COOP, the
   * worker holds the hart for the duration of the IREE invocation. */
  k_tid_t worker = k_thread_create(
      &merlin_worker_thread, merlin_worker_stack, MERLIN_WORKER_STACK_SIZE,
      merlin_worker_entry, NULL, NULL, NULL,
      /*prio=*/K_PRIO_COOP(0), /*opts=*/0, /*delay=*/K_FOREVER);
  int pin_rc = k_thread_cpu_pin(worker, MERLIN_HART);
  if (pin_rc != 0) {
    printf("[merlin] FAIL: k_thread_cpu_pin returned %d\n", pin_rc);
    sys_reboot(SYS_REBOOT_COLD);
    return 1;
  }
  merlin_phase_stamp(PHASE_WORKER_STARTED);
  k_thread_start(worker);
  k_thread_join(worker, K_FOREVER);
  merlin_phase_stamp(PHASE_MAIN_EXIT);

  /* Single line, machine-parseable, sorts well in a CSV. */
  printf("[merlin] result model=%s backend=%s hart=%d cycles=%llu hash=0x%016llx rc=%d\n",
         MERLIN_MODEL_NAME, MERLIN_BACKEND, MERLIN_HART,
         (unsigned long long)g_worker_result.cycles,
         (unsigned long long)g_worker_result.hash, g_worker_result.rc);

  /* 2026-05-23: emit one compact CYC line per dispatch ordinal by walking
   * the loader's per-ordinal accumulators directly. iree_merlin_dump_cycles()
   * in the archive crashes on Zephyr (fprintf(stdout) -> unaligned load on
   * picolibc-without-init); doing it from main.c via plain printf goes
   * through our fprintf shim cleanly. */
  extern uint64_t iree_merlin_cycles_per_ordinal[];
  extern uint64_t iree_merlin_wg_count_per_ordinal[];
  extern const char *iree_merlin_sym_per_ordinal[];
  extern uint32_t iree_merlin_max_ordinal_seen;
  printf("CYC, begin\n");
  for (uint32_t o = 0; o <= iree_merlin_max_ordinal_seen && o < 1024; ++o) {
    uint64_t wg = iree_merlin_wg_count_per_ordinal[o];
    if (wg == 0) continue;
    const char *sym = iree_merlin_sym_per_ordinal[o];
    if (!sym) sym = "(unknown)";
    printf("CYC, %u, %s, %llu, %llu\n", (unsigned)o, sym,
           (unsigned long long)iree_merlin_cycles_per_ordinal[o],
           (unsigned long long)wg);
  }
  printf("CYC, end\n");

#if defined(MERLIN_PROFILE_COUNTERS) && MERLIN_PROFILE_COUNTERS
  /* Per-dispatch Gemmini hardware counter dump. 8 slots per ordinal;
   * panel programmed at worker startup. parse_counters.py decodes the
   * slot index to event name. */
  extern uint64_t iree_merlin_counters_per_ordinal[][8];
  printf("COUNTER, begin\n");
  for (uint32_t o = 0; o <= iree_merlin_max_ordinal_seen && o < 1024; ++o) {
    if (iree_merlin_wg_count_per_ordinal[o] == 0) continue;
    const char *sym = iree_merlin_sym_per_ordinal[o];
    if (!sym) sym = "(unknown)";
    printf("COUNTER, %u, %s", (unsigned)o, sym);
    for (int s = 0; s < 8; ++s) {
      printf(", %llu", (unsigned long long)iree_merlin_counters_per_ordinal[o][s]);
    }
    printf("\n");
  }
  printf("COUNTER, end\n");
#endif

  if (g_worker_result.rc == 0) {
    printf(">>> MERLIN MODEL RUN PASSED <<<\n");
  } else {
    printf(">>> MERLIN MODEL RUN FAILED <<<\n");
  }
  sys_reboot(SYS_REBOOT_COLD);
  return g_worker_result.rc == 0 ? 0 : 1;
}
```

## src/device_stubs.c
```c
/* Local-sync device factory + bytecode-module accessor.
 *
 * The IREE archives in this Zephyr build include both local-sync and
 * local-task HAL drivers. We instantiate the local-sync device here:
 *  - inline executor — no internal threading required from IREE
 *  - the iree_thread_zephyr.c + iree_futex_zephyr.c bridge files are still
 *    linked in for iree_slim_mutex / iree_notification on the bytecode-VM
 *    side (those use futex)
 *  - app-level multi-hart parallelism remains available: spawn one
 *    k_thread per Shuttle hart, each driving its own iree_vm_context.
 *
 * Switching to iree_hal_task_device_create would let IREE schedule
 * dispatch across multiple workers in a SINGLE inference, but requires a
 * non-stub proactor backend on Zephyr (the upstream stub vtable leaves
 * notification_signal/wait + relay methods as NULL, which the task HAL's
 * semaphore-init path calls during iree_vm_context_create — load access
 * fault). Real backend = separate workstream.
 */

#include <stdio.h>

#include <zephyr/sys/printk.h>

#include "iree/async/util/proactor_pool.h"
#include "iree/base/api.h"
#include "iree/hal/api.h"
#include "iree/hal/device_group.h"
#include "iree/hal/drivers/local_sync/sync_device.h"
#include "iree/hal/local/executable_loader.h"
#include "iree/hal/local/loaders/embedded_elf_loader.h"
#include "merlin_vmfb.h"

iree_status_t create_sample_device(iree_allocator_t host_allocator,
                                   iree_hal_device_t** out_device) {
  /* 2026-05-23: [bp] device startup prints stripped — UART noise during
   * device setup. Failure path still surfaces via the iree_status return. */
  *out_device = NULL;

  iree_hal_sync_device_params_t params;
  iree_hal_sync_device_params_initialize(&params);

  iree_hal_device_create_params_t create_params =
      iree_hal_device_create_params_default();

  iree_async_proactor_pool_t* proactor_pool = NULL;
  iree_status_t pool_status = iree_async_proactor_pool_create(
      /*node_count=*/1, /*node_ids=*/NULL,
      iree_async_proactor_pool_options_default(), host_allocator,
      &proactor_pool);
  if (!iree_status_is_ok(pool_status)) {
    return pool_status;
  }
  create_params.proactor_pool = proactor_pool;

  iree_hal_executable_loader_t* loader = NULL;
  iree_status_t status = iree_hal_embedded_elf_loader_create(
      /*plugin_manager=*/NULL, host_allocator, &loader);
  if (!iree_status_is_ok(status)) {
    iree_async_proactor_pool_release(proactor_pool);
    return status;
  }

  iree_string_view_t identifier = iree_make_cstring_view("local-sync");

  iree_hal_allocator_t* device_allocator = NULL;
  status = iree_hal_allocator_create_heap(identifier, host_allocator,
                                          host_allocator, &device_allocator);
  if (iree_status_is_ok(status)) {
    status = iree_hal_sync_device_create(
        identifier, &params, &create_params,
        /*loader_count=*/1, &loader, device_allocator, host_allocator,
        out_device);
  }

  iree_hal_allocator_release(device_allocator);
  iree_hal_executable_loader_release(loader);
  iree_async_proactor_pool_release(proactor_pool);
  return status;
}

const iree_const_byte_span_t load_bytecode_module_data(void) {
  return iree_make_const_byte_span(merlin_vmfb, merlin_vmfb_len);
}
```

## src/iree_picolibc_compat.c
```c
/*
 * iree_picolibc_compat.c — bridge newlib symbol references emitted by the
 * IREE static archives (built by riscv_firesim.toolchain.cmake against
 * chipyard's riscv-tools NEWLIB sysroot) into the picolibc-based Zephyr
 * SDK environment.
 *
 * IREE archives reference: _ctype_, _impure_ptr, __errno, iree_thread_create,
 * iree_thread_release, plus picolibc's sbrk wants __heap_start/__heap_end.
 *
 * None of these references is reachable on the IREE_PLATFORM_GENERIC +
 * IREE_ENABLE_THREADING=OFF + IREE_FILE_IO_ENABLE=0 code paths we exercise
 * (no stdio, no async, no scratch-allocator sbrk), but the linker pulls
 * them in via archive symbol resolution. Providing dummies here lets the
 * unused code be GC'd by --gc-sections at the final ELF link step. If any
 * of these are actually called at runtime, IREE itself is misconfigured.
 *
 * SPDX-License-Identifier: Apache-2.0
 */

#include <errno.h>
#include <stdarg.h>
#include <stddef.h>
#include <stdint.h>
#include <stdio.h>

#include <zephyr/sys/printk.h>

/* ---- newlib stdio reentrancy struct (_reent) ---------------------------
 * IREE's stdio paths reference `_impure_ptr->...`. We provide a large
 * opaque buffer so any field accesses land in valid memory; the buffer
 * is BSS-zeroed so any field read returns 0/NULL. */
__attribute__((aligned(8))) static char _iree_compat_reent[4096];
void *_impure_ptr = _iree_compat_reent;

/* ---- newlib ctype table -----------------------------------------------
 * `_ctype_` is a 257-byte table in newlib; index -1 is the EOF slot,
 * 0..255 are character flags. We zero-fill — `isalpha(c)` etc. will
 * return false for every character, which is benign for the parse paths
 * that pull this reference in. */
static const char _iree_compat_ctype_table[257] = {0};
const char *_ctype_ = &_iree_compat_ctype_table[1];

/* ---- newlib errno indirection ------------------------------------------
 * Newlib stdio uses `*__errno() = X` to set errno; picolibc has plain
 * `errno`. Bridge by returning &errno (Zephyr/picolibc's thread-local). */
int *__errno(void) {
  return &errno;
}

/* ---- fprintf shim ------------------------------------------------------
 * IREE compiled against chipyard newlib calls fprintf(stderr, ...) for
 * status / diag prints. Newlib's fprintf dereferences `_impure_ptr->_stdout`
 * et al. — our `_impure_ptr` stub is zero-filled so those FILE* are NULL
 * and fprintf load-faults on the first field access.
 *
 * Override fprintf to route through Zephyr's printk (which doesn't need
 * a FILE* and goes directly to the console driver). The FILE* arg is
 * ignored — IREE only ever passes stdout/stderr equivalents.
 *
 * The function lives in our app object file, so the linker resolves the
 * fprintf undef-ref in IREE archives to this implementation before
 * picolibc's libc.a is searched. */
int fprintf(FILE *stream, const char *fmt, ...) {
  (void)stream;
  va_list ap;
  va_start(ap, fmt);
  vprintk(fmt, ap);
  va_end(ap);
  return 0;
}

/* Same for the stderr-rooted iree_status_fprint internal helpers if they
 * end up referencing fputs / fputc directly. */
int fputs(const char *s, FILE *stream) {
  (void)stream;
  printk("%s", s);
  return 0;
}

int fputc(int c, FILE *stream) {
  (void)stream;
  printk("%c", c);
  return c;
}

/* fflush shim — newlib's fflush reads `stream->_seek` at offset 0x18 and
 * jumps through it; with our zero-filled _impure_ptr that's a NULL deref.
 * Since fprintf/fputs/fputc above already go through printk synchronously,
 * fflush is a no-op. */
int fflush(FILE *stream) {
  (void)stream;
  return 0;
}

/* ---- iree async/threading stubs ----------------------------------------
 * No longer needed: real iree_thread_create / iree_thread_release impls
 * are provided by src/iree_thread_zephyr.c (k_thread-backed). Same for
 * iree_thread_join / yield / id / priority overrides / affinity. */

/* ---- heap boundary symbols --------------------------------------------
 * Picolibc's libc_picolib_picosbrk.c uses __heap_start / __heap_end as
 * the BSS heap bounds (treated as `extern char __heap_start[]` and
 * accessed by address). Define them via inline asm so they end up as
 * real linker symbols bracketing a BSS region — picolibc's malloc
 * then has a working sbrk-backed heap and we avoid the multiple-defn
 * conflict that CONFIG_COMMON_LIBC_MALLOC=y triggers with picolibc's
 * own nano-malloc.
 *
 * 2026-05-22: bumped from 4 MiB to 64 MiB. Note this is SEPARATE from
 * CONFIG_HEAP_MEM_POOL_SIZE (= Zephyr's k_heap kernel heap). IREE's
 * `iree_allocator_libc()` calls libc malloc which goes through picolibc
 * sbrk, which uses these symbols. yolov8n's 9.35 MB Gemmini VMFB
 * expands to ~20 MB of loaded dispatch ELFs and tripped
 * RESOURCE_EXHAUSTED in iree_hal_executable_create with 4 MiB. The
 * chipyard SoC has 256 MiB SRAM at 0x80000000 so 64 MiB is well within
 * budget. */
__asm__(
    ".section .bss.iree_heap, \"aw\", @nobits\n"
    ".balign 16\n"
    ".global __heap_start\n"
    ".global __heap_end\n"
    "__heap_start:\n"
    ".space 64 * 1024 * 1024\n"
    "__heap_end:\n"
    ".previous\n"
);
```

## src/model_info.h
```c
/* Per-model shape / dtype / entry-function metadata.
 *
 * Selected at CMake configure time via -DMERLIN_MODEL=<name>, which sets
 * the MERLIN_MODEL_<NAME> preprocessor define. Source MLIRs were sampled
 * from /scratch2/agustin/merlin/models/*.q.int8.mlir; inputs/outputs are
 * all f32 even though the model is quantized internally (QDQ pattern). */

#ifndef MERLIN_MODEL_INFO_H_
#define MERLIN_MODEL_INFO_H_

#include <stddef.h>
#include <stdint.h>
#include "iree/hal/api.h"

typedef struct merlin_tensor_spec {
  const char* name;
  iree_hal_element_type_t element_type;
  int rank;
  const iree_hal_dim_t* shape;   /* length = rank */
  size_t element_count;          /* product of shape */
  size_t byte_count;             /* element_count * sizeof(element) */
} merlin_tensor_spec_t;

/* ----- tiny_matmul (single 16x16x16 i8xi8xi32 matmul, no QDQ) -----
 * func.func @main_graph(%arg0: tensor<16x16xi8>) -> tensor<16x16xi32> */
#if defined(MERLIN_MODEL_TINY_MATMUL)
#define MERLIN_ENTRY_FUNCTION_NAME "module.main_graph"
#define MERLIN_INPUT_COUNT 1
#define MERLIN_OUTPUT_COUNT 1
static const iree_hal_dim_t merlin_in0_shape[]  = {16, 16};
static const iree_hal_dim_t merlin_out0_shape[] = {16, 16};
static const merlin_tensor_spec_t merlin_inputs[] = {
  {"arg0", IREE_HAL_ELEMENT_TYPE_INT_8, 2, merlin_in0_shape, 16*16, 16*16*1},
};
static const merlin_tensor_spec_t merlin_outputs[] = {
  {"out0", IREE_HAL_ELEMENT_TYPE_INT_32, 2, merlin_out0_shape, 16*16, 16*16*4},
};

/* ----- mlp_wide -----
 * func.func @main_graph(%arg0: !torch.vtensor<[16,16],f32>)
 *   -> !torch.vtensor<[16,16],f32>                                         */
#elif defined(MERLIN_MODEL_MLP_WIDE)
#define MERLIN_ENTRY_FUNCTION_NAME "module.main_graph"
#define MERLIN_INPUT_COUNT 1
#define MERLIN_OUTPUT_COUNT 1
static const iree_hal_dim_t merlin_in0_shape[]  = {16, 16};
static const iree_hal_dim_t merlin_out0_shape[] = {16, 16};
static const merlin_tensor_spec_t merlin_inputs[] = {
  {"arg0", IREE_HAL_ELEMENT_TYPE_FLOAT_32, 2, merlin_in0_shape, 16*16, 16*16*4},
};
static const merlin_tensor_spec_t merlin_outputs[] = {
  {"out0", IREE_HAL_ELEMENT_TYPE_FLOAT_32, 2, merlin_out0_shape, 16*16, 16*16*4},
};

/* ----- dronet -----
 * func.func @dronet(%arg0: !torch.vtensor<[1,3,112,112],f32>)
 *   -> (!torch.vtensor<[1,1],f32>, !torch.vtensor<[1,1],f32>)              */
#elif defined(MERLIN_MODEL_DRONET)
#define MERLIN_ENTRY_FUNCTION_NAME "module.dronet"
#define MERLIN_INPUT_COUNT 1
#define MERLIN_OUTPUT_COUNT 2
static const iree_hal_dim_t merlin_in0_shape[]  = {1, 3, 112, 112};
static const iree_hal_dim_t merlin_out0_shape[] = {1, 1};
static const iree_hal_dim_t merlin_out1_shape[] = {1, 1};
static const merlin_tensor_spec_t merlin_inputs[] = {
  {"arg0", IREE_HAL_ELEMENT_TYPE_FLOAT_32, 4, merlin_in0_shape,
   1*3*112*112, 1*3*112*112*4},
};
static const merlin_tensor_spec_t merlin_outputs[] = {
  {"steer", IREE_HAL_ELEMENT_TYPE_FLOAT_32, 2, merlin_out0_shape, 1, 4},
  {"coll",  IREE_HAL_ELEMENT_TYPE_FLOAT_32, 2, merlin_out1_shape, 1, 4},
};

/* ----- yolov8n -----
 * func.func @main_graph(%arg0: !torch.vtensor<[1,3,320,320],f32>)
 *   -> !torch.vtensor<[1,84,2100],f32>                                     */
#elif defined(MERLIN_MODEL_YOLOV8N)
#define MERLIN_ENTRY_FUNCTION_NAME "module.main_graph"
#define MERLIN_INPUT_COUNT 1
#define MERLIN_OUTPUT_COUNT 1
static const iree_hal_dim_t merlin_in0_shape[]  = {1, 3, 320, 320};
static const iree_hal_dim_t merlin_out0_shape[] = {1, 84, 2100};
static const merlin_tensor_spec_t merlin_inputs[] = {
  {"arg0", IREE_HAL_ELEMENT_TYPE_FLOAT_32, 4, merlin_in0_shape,
   1*3*320*320, 1*3*320*320*4},
};
static const merlin_tensor_spec_t merlin_outputs[] = {
  {"out0", IREE_HAL_ELEMENT_TYPE_FLOAT_32, 3, merlin_out0_shape,
   1*84*2100, 1*84*2100*4},
};

#else
#error "Define one of MERLIN_MODEL_MLP_WIDE / MERLIN_MODEL_DRONET / MERLIN_MODEL_YOLOV8N (set via -DMERLIN_MODEL=<name>)"
#endif

#endif  /* MERLIN_MODEL_INFO_H_ */
```
