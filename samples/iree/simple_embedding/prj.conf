## CMakeLists.txt
```
cmake_minimum_required(VERSION 3.20.0)

find_package(Zephyr REQUIRED HINTS $ENV{ZEPHYR_BASE})
project(iree_simple_embedding)

# XPURT repo root (four levels up from this CMakeLists.txt).
set(XPURT_ROOT ${CMAKE_CURRENT_LIST_DIR}/../../../..)

# IREE runtime headers from the merlin third_party checkout.
set(IREE_RUNTIME_INCLUDE_DIR
    ${XPURT_ROOT}/merlin/third_party/iree_bar/runtime/src)

option(IREE_BUILD_RUNTIME_WITH_WEST "Build IREE runtime as part of west build" ON)

set(IREE_SRC_DIR ${XPURT_ROOT}/merlin/third_party/iree_bar)
set(MERLIN_ZEPHYR_STANDALONE_CMAKE ${XPURT_ROOT}/merlin/zephyr-rt/CMakeLists_standalone.cmake)
set(IREE_COMPILE_EXE
    ${XPURT_ROOT}/merlin/build/host-vanilla-release/install/bin/iree-compile)
set(SIMPLE_EMBEDDING_TEST_MLIR
    ${XPURT_ROOT}/merlin/third_party/iree_bar/samples/simple_embedding/simple_embedding_test.mlir)
set(SIMPLE_EMBEDDING_VMFB
    ${CMAKE_CURRENT_LIST_DIR}/src/model.vmfb)
set(SIMPLE_EMBEDDING_VMFB_HEADER
    ${CMAKE_CURRENT_LIST_DIR}/src/model_vmfb.h)

find_program(XXD_EXECUTABLE xxd REQUIRED)

#
# VMFB codegen knobs
# ------------------
option(IREE_ENABLE_RISCV_VECTOR "Compile VMFB with RISC-V Vector extension (+v)" OFF)
if(IREE_ENABLE_RISCV_VECTOR)
  set(IREE_RISCV_CPU_FEATURES "+m,+a,+f,+d,+c,+v,+zvl128b")
  # Keep a fixed vector width for deterministic codegen.
  set(IREE_RISCV_VECTOR_WIDTH_FLAG "--iree-llvmcpu-target-vector-width-in-bytes=16")
else()
  set(IREE_RISCV_CPU_FEATURES "+m,+a,+f,+d,+c")
  set(IREE_RISCV_VECTOR_WIDTH_FLAG "")
endif()

if(NOT EXISTS ${IREE_COMPILE_EXE})
  message(FATAL_ERROR
    "Missing iree-compile at ${IREE_COMPILE_EXE}. "
    "Build host tools first: python3 tools/build.py --target host --config release")
endif()

add_custom_command(
  OUTPUT
    ${SIMPLE_EMBEDDING_VMFB}
    ${SIMPLE_EMBEDDING_VMFB_HEADER}
  COMMAND
    ${IREE_COMPILE_EXE}
    ${SIMPLE_EMBEDDING_TEST_MLIR}
    --iree-hal-target-device=local
    --iree-hal-local-target-device-backends=llvm-cpu
    --iree-llvmcpu-target-triple=riscv64-unknown-elf
    --iree-llvmcpu-target-cpu-features=${IREE_RISCV_CPU_FEATURES}
    --iree-llvmcpu-target-abi=lp64d
    ${IREE_RISCV_VECTOR_WIDTH_FLAG}
    --iree-vm-bytecode-module-strip-source-map=true
    --iree-vm-emit-polyglot-zip=false
    -o ${SIMPLE_EMBEDDING_VMFB}
  COMMAND
    ${XXD_EXECUTABLE} -i model.vmfb > model_vmfb.h
  DEPENDS
    ${SIMPLE_EMBEDDING_TEST_MLIR}
    ${IREE_COMPILE_EXE}
  WORKING_DIRECTORY
    ${CMAKE_CURRENT_LIST_DIR}/src
  COMMENT
    "Generating embedded VMFB and C header for simple_embedding"
  VERBATIM
)

add_custom_target(iree_simple_embedding_vmfb
  DEPENDS
    ${SIMPLE_EMBEDDING_VMFB}
    ${SIMPLE_EMBEDDING_VMFB_HEADER}
)

target_sources(app PRIVATE
  src/simple_embedding.c
  src/simple_embedding_zephyr_stubs.c
)
add_dependencies(app iree_simple_embedding_vmfb)

target_include_directories(app PRIVATE
  ${IREE_RUNTIME_INCLUDE_DIR}
)

# Build IREE as a generic bare-metal-style platform when used under Zephyr.
target_compile_definitions(app PRIVATE
  IREE_PLATFORM_GENERIC=1
  IREE_ALLOCATOR_SYSTEM_CTL=iree_allocator_libc_ctl
)

if(IREE_BUILD_RUNTIME_WITH_WEST)
  include(ExternalProject)

  # Build IREE runtime in a sub-build so it uses Zephyr's toolchain settings.
  # Outputs are then linked into the Zephyr app.
  set(IREE_SUBBUILD_DIR ${CMAKE_BINARY_DIR}/iree_runtime_subbuild)
  set(IREE_HOST_BIN_DIR
      ${XPURT_ROOT}/merlin/build/host-vanilla-release/install/bin)
  set(IREE_ZEPHYR_COMPAT_HEADER
      ${CMAKE_CURRENT_LIST_DIR}/src/iree_zephyr_compat.h)
  # Explicit ISA/ABI flags to match spike_riscv64 Zephyr builds.
  # The ExternalProject configure does not inherit app target compile options.
  set(IREE_SUBBUILD_ARCH_FLAGS
      "-march=rv64imafdc_zicsr_zifencei -mabi=lp64d -mcmodel=medany")
  # Preserve Zephyr-selected ISA/ABI flags (e.g. -march/-mabi) for the
  # ExternalProject sub-build. Without this, GCC may default to rv32, causing
  # ELFCLASS32 vs ELFCLASS64 link incompatibilities.
  set(IREE_SUBBUILD_C_FLAGS
      "${CMAKE_C_FLAGS} ${IREE_SUBBUILD_ARCH_FLAGS} -DIREE_PLATFORM_GENERIC=1 -Wno-error=format -include ${IREE_ZEPHYR_COMPAT_HEADER}")
  set(IREE_SUBBUILD_CXX_FLAGS
      "${CMAKE_CXX_FLAGS} ${IREE_SUBBUILD_ARCH_FLAGS} -DIREE_PLATFORM_GENERIC=1 -Wno-error=format -include ${IREE_ZEPHYR_COMPAT_HEADER}")
  set(IREE_RUNTIME_LIB
      ${IREE_SUBBUILD_DIR}/runtime/src/iree/runtime/libzephyr_iree_runtime_standalone.a)
  set(IREE_FLATCC_LIB
      ${IREE_SUBBUILD_DIR}/build_tools/third_party/flatcc/libflatcc_parsing.a)

  ExternalProject_Add(iree_runtime_ep
    SOURCE_DIR ${IREE_SRC_DIR}
    BINARY_DIR ${IREE_SUBBUILD_DIR}
    CMAKE_ARGS
      -G Ninja
      -DCMAKE_BUILD_TYPE=Release
      -DCMAKE_DISABLE_FIND_PACKAGE_CUDAToolkit=ON
      -DCMAKE_SYSTEM_NAME=Generic
      -DCMAKE_SYSTEM_PROCESSOR=riscv64
      -DCMAKE_C_COMPILER=${CMAKE_C_COMPILER}
      -DCMAKE_CXX_COMPILER=${CMAKE_CXX_COMPILER}
      -DCMAKE_ASM_COMPILER=${CMAKE_ASM_COMPILER}
      -DCMAKE_AR=${CMAKE_AR}
      -DCMAKE_RANLIB=${CMAKE_RANLIB}
      -DCMAKE_STRIP=${CMAKE_STRIP}
      -DCMAKE_C_FLAGS=${IREE_SUBBUILD_C_FLAGS}
      -DCMAKE_CXX_FLAGS=${IREE_SUBBUILD_CXX_FLAGS}
      -DMERLIN_XPU_RT_STANDALONE_CMAKE=${MERLIN_ZEPHYR_STANDALONE_CMAKE}
      -DMERLIN_BUILD_SPACEMITX60=OFF
      -DMERLIN_BUILD_SATURN_OPU=OFF
      -DIREE_ARCH=riscv_64
      -DIREE_HOST_BIN_DIR=${IREE_HOST_BIN_DIR}
      -DIREE_BUILD_COMPILER=OFF
      -DIREE_BUILD_SAMPLES=OFF
      -DIREE_BUILD_TESTS=OFF
      -DIREE_BUILD_WARNINGS_AS_ERRORS=OFF
      -DIREE_ENABLE_COMPILER_WARNINGS=OFF
      -DIREE_BUILD_BINDINGS_TFLITE=OFF
      -DIREE_BUILD_BINDINGS_TFLITE_JAVA=OFF
      -DIREE_ENABLE_THREADING=OFF
      -DIREE_HAL_DRIVER_LOCAL_SYNC=ON
      -DIREE_HAL_DRIVER_DEFAULTS=OFF
      -DIREE_HAL_EXECUTABLE_LOADER_DEFAULTS=OFF
      -DIREE_HAL_EXECUTABLE_LOADER_EMBEDDED_ELF=ON
      -DIREE_HAL_EXECUTABLE_PLUGIN_DEFAULTS=OFF
      -DIREE_HAL_EXECUTABLE_PLUGIN_EMBEDDED_ELF=ON
    BUILD_COMMAND ${CMAKE_COMMAND} --build ${IREE_SUBBUILD_DIR} --target zephyr_iree_runtime_standalone -v
    INSTALL_COMMAND ""
    BUILD_BYPRODUCTS
      ${IREE_RUNTIME_LIB}
      ${IREE_FLATCC_LIB}
  )

  add_library(iree_runtime_standalone STATIC IMPORTED GLOBAL)
  set_target_properties(iree_runtime_standalone PROPERTIES IMPORTED_LOCATION ${IREE_RUNTIME_LIB})
  add_dependencies(iree_runtime_standalone iree_runtime_ep)

  add_library(iree_flatcc_parsing STATIC IMPORTED GLOBAL)
  set_target_properties(iree_flatcc_parsing PROPERTIES IMPORTED_LOCATION ${IREE_FLATCC_LIB})
  add_dependencies(iree_flatcc_parsing iree_runtime_ep)

  target_link_libraries(app PRIVATE
    iree_runtime_standalone
    iree_flatcc_parsing
  )
else()
  # Prebuilt standalone IREE runtime archive for Zephyr (manual build).
  set(IREE_ZEPHYR_RUNTIME_LIB
      ${XPURT_ROOT}/merlin/build-iree-zephyr-runtime-zephyr/runtime/src/iree/runtime/libzephyr_iree_runtime_standalone.a)
  set(IREE_FLATCC_RUNTIME_LIB
      ${XPURT_ROOT}/merlin/build-iree-zephyr-runtime-zephyr/build_tools/third_party/flatcc/libflatcc_parsing.a)
  target_link_libraries(app PRIVATE
    ${IREE_ZEPHYR_RUNTIME_LIB}
    ${IREE_FLATCC_RUNTIME_LIB}
  )
endif()
```

## prj.conf
```kconfig
CONFIG_PRINTK=y
CONFIG_STDOUT_CONSOLE=y

# IREE VM module initialization uses an 8KB inline VM stack buffer on the C
# stack (see IREE_VM_STACK_DEFAULT_SIZE). 8KB main stack is too tight and can
# silently corrupt memory, showing up later as heap faults during __init.
CONFIG_MAIN_STACK_SIZE=32768

# Catch stack overflows earlier (helps confirm/deny stack corruption hypotheses).
CONFIG_THREAD_STACK_INFO=y
CONFIG_STACK_SENTINEL=y

# IREE + embedded VMFB + HAL buffers require non-trivial heap usage.
# Make heap explicit (similar to the xnnpack sample).
CONFIG_HEAP_MEM_POOL_SIZE=1048576
CONFIG_COMMON_LIBC_MALLOC=y

# Enable POSIX APIs/threads in case linked components expect pthread symbols.
CONFIG_POSIX_API=y
CONFIG_MULTITHREADING=y
CONFIG_POSIX_THREADS=y
```

## src/iree_zephyr_compat.h
```c
#ifndef IREE_ZEPHYR_COMPAT_H_
#define IREE_ZEPHYR_COMPAT_H_

// Force IREE runtime internals into a minimal generic mode that is compatible
// with Zephyr cross builds from an ExternalProject sub-build.
#define IREE_SYNCHRONIZATION_DISABLE_UNSAFE 1
#define IREE_FILE_IO_ENABLE 0
#define IREE_WAIT_UNTIL_FN sizeof

// Generic platform time fallback used by iree/base/internal/time.c.
#define IREE_TIME_NOW_FN return 0;

#endif  // IREE_ZEPHYR_COMPAT_H_
```

## src/simple_embedding.c
```c
// Simple embedding sample adapted from the FireSim bare-metal example.
// NOTE: This expects IREE runtime headers and libraries to be available
// on the include path and link line.

#include <stdio.h>
#include <stdint.h>
#include <stdlib.h>
#include <zephyr/sys/reboot.h>

#include "iree/base/api.h"
#include "iree/hal/api.h"
#include "iree/modules/hal/module.h"
#include "iree/vm/api.h"
#include "iree/vm/bytecode/module.h"

#define L_TRACE_ENCODER_BASE_ADDRESS 0x3000000

// NOTE: The trace encoder is a platform-specific MMIO device. Under Spike (and
// many Zephyr targets) this address may be unmapped and will fault if touched.
// Enable explicitly only when running on a platform that provides the device.
#ifndef L_TRACE_ENCODER_ENABLE
#define L_TRACE_ENCODER_ENABLE 0
#endif

// Debug helpers. We fflush() so output isn't lost if Spike aborts abruptly.
#define DBG_PRINTF(...)         \
  do {                          \
    printf(__VA_ARGS__);        \
    fflush(stdout);             \
  } while (0)
#define DBG_FPRINTF(...)        \
  do {                          \
    fprintf(stderr, __VA_ARGS__); \
    fflush(stderr);             \
  } while (0)

static iree_status_t DebugPrintStatus(iree_status_t status, const char* what) {
  if (iree_status_is_ok(status)) return status;
  DBG_FPRINTF("\n[Run] IREE call failed at: %s\n", what);
  iree_status_fprint(stderr, status);
  DBG_FPRINTF("\n");
  return status;
}

#define IREE_RETURN_IF_ERROR_DBG(expr, what) \
  IREE_RETURN_IF_ERROR(DebugPrintStatus((expr), (what)))

typedef struct {
  volatile uint32_t TR_TE_CTRL;
  volatile uint32_t TR_TE_INFO;
  volatile uint32_t TR_TE_BUBBLE[6];
  volatile uint32_t TR_TE_TARGET;
  volatile uint32_t TR_TE_BRANCH_MODE;
} LTraceEncoderType;

static inline void l_trace_encoder_start(uint32_t hart_id) {
#if L_TRACE_ENCODER_ENABLE
  uintptr_t base_addr = (uintptr_t)L_TRACE_ENCODER_BASE_ADDRESS;
  LTraceEncoderType* encoder =
      (LTraceEncoderType*)(base_addr + (hart_id * 0x1000));
  encoder->TR_TE_CTRL |= (0x1 << 1);
#else
  (void)hart_id;
#endif
}

static inline void l_trace_encoder_stop(uint32_t hart_id) {
#if L_TRACE_ENCODER_ENABLE
  uintptr_t base_addr = (uintptr_t)L_TRACE_ENCODER_BASE_ADDRESS;
  LTraceEncoderType* encoder =
      (LTraceEncoderType*)(base_addr + (hart_id * 0x1000));
  encoder->TR_TE_CTRL &= ~(0x1 << 1);
#else
  (void)hart_id;
#endif
}

// Provided by the platform-specific IREE HAL backend.
extern iree_status_t create_sample_device(iree_allocator_t host_allocator,
                                          iree_hal_device_t** out_device);
extern const iree_const_byte_span_t load_bytecode_module_data(void);

static iree_status_t Run(void) {
  DBG_PRINTF("[Run] enter\n");
  // Use the runtime-provided system allocator.
  iree_allocator_t host_allocator = iree_allocator_system();

  iree_vm_instance_t* instance = NULL;
  DBG_PRINTF("[Run] creating vm instance...\n");
  IREE_RETURN_IF_ERROR_DBG(
      iree_vm_instance_create(IREE_VM_TYPE_CAPACITY_DEFAULT, host_allocator,
                              &instance),
      "iree_vm_instance_create");
  DBG_PRINTF("[Run] vm instance = %p\n", (void*)instance);

  DBG_PRINTF("[Run] registering HAL module types...\n");
  IREE_RETURN_IF_ERROR_DBG(iree_hal_module_register_all_types(instance),
                           "iree_hal_module_register_all_types");

  iree_hal_device_t* device = NULL;
  DBG_PRINTF("[Run] creating sample device...\n");
  IREE_RETURN_IF_ERROR_DBG(create_sample_device(host_allocator, &device),
                           "create_sample_device");
  DBG_PRINTF("[Run] device = %p\n", (void*)device);

  iree_vm_module_t* hal_module = NULL;
  DBG_PRINTF("[Run] creating HAL module...\n");
  IREE_RETURN_IF_ERROR_DBG(
      iree_hal_module_create(instance, iree_hal_module_device_policy_default(),
                             /*device_count=*/1, &device,
                             IREE_HAL_MODULE_FLAG_SYNCHRONOUS,
                             iree_hal_module_debug_sink_null(), host_allocator,
                             &hal_module),
      "iree_hal_module_create");
  DBG_PRINTF("[Run] hal_module = %p\n", (void*)hal_module);

  DBG_PRINTF("[Run] loading bytecode module data...\n");
  const iree_const_byte_span_t module_data = load_bytecode_module_data();
  DBG_PRINTF("[Run] module_data: ptr=%p size=%zu\n", (void*)module_data.data,
             (size_t)module_data.data_length);

  iree_vm_module_t* bytecode_module = NULL;
  DBG_PRINTF("[Run] creating bytecode module...\n");
  IREE_RETURN_IF_ERROR_DBG(
      iree_vm_bytecode_module_create(instance, module_data,
                                     iree_allocator_null(), host_allocator,
                                     &bytecode_module),
      "iree_vm_bytecode_module_create");
  DBG_PRINTF("[Run] bytecode_module = %p\n", (void*)bytecode_module);

  iree_vm_context_t* context = NULL;
  iree_vm_module_t* modules[] = {hal_module, bytecode_module};
  DBG_PRINTF("[Run] creating vm context with modules...\n");
  IREE_RETURN_IF_ERROR_DBG(
      iree_vm_context_create_with_modules(
          instance, IREE_VM_CONTEXT_FLAG_NONE, IREE_ARRAYSIZE(modules),
          &modules[0], host_allocator, &context),
      "iree_vm_context_create_with_modules");
  DBG_PRINTF("[Run] context = %p\n", (void*)context);
  iree_vm_module_release(hal_module);
  iree_vm_module_release(bytecode_module);

  const char kMainFunctionName[] = "module.vanilla_matmul_large";
  iree_vm_function_t main_function;
  DBG_PRINTF("[Run] resolving function: %s\n", kMainFunctionName);
  IREE_RETURN_IF_ERROR_DBG(
      iree_vm_context_resolve_function(
          context, iree_make_cstring_view(kMainFunctionName), &main_function),
      "iree_vm_context_resolve_function");
  DBG_PRINTF("[Run] function resolved\n");

  const int kDim = 128;
  const int kCount = kDim * kDim;

  DBG_PRINTF("[Run] allocating host input buffers (kCount=%d)...\n", kCount);
  int8_t* kInt8_4 = (int8_t*)malloc(kCount * sizeof(int8_t));
  int8_t* kInt8_2 = (int8_t*)malloc(kCount * sizeof(int8_t));
  int32_t* kInt32_Zero = (int32_t*)malloc(kCount * sizeof(int32_t));
  DBG_PRINTF("[Run] mallocs: kInt8_4=%p kInt8_2=%p kInt32_Zero=%p\n",
             (void*)kInt8_4, (void*)kInt8_2, (void*)kInt32_Zero);

  if (!kInt8_4 || !kInt8_2 || !kInt32_Zero) {
    return iree_make_status(IREE_STATUS_RESOURCE_EXHAUSTED,
                            "buffer allocation failed");
  }

  DBG_PRINTF("[Run] initializing host inputs...\n");
  for (int i = 0; i < kCount; ++i) {
    kInt8_4[i] = 4;
    kInt8_2[i] = 2;
    kInt32_Zero[i] = 0;
  }

  iree_hal_dim_t shape[2] = {kDim, kDim};
  DBG_PRINTF("[Run] tensor shape = [%d, %d]\n", kDim, kDim);

  iree_hal_buffer_view_t* arg0_buffer_view = NULL;
  iree_hal_buffer_view_t* arg1_buffer_view = NULL;
  iree_hal_buffer_view_t* arg2_buffer_view = NULL;

  DBG_PRINTF("[Run] uploading arg0...\n");
  IREE_RETURN_IF_ERROR_DBG(
      iree_hal_buffer_view_allocate_buffer_copy(
          device, iree_hal_device_allocator(device), IREE_ARRAYSIZE(shape),
          shape, IREE_HAL_ELEMENT_TYPE_SINT_8,
          IREE_HAL_ENCODING_TYPE_DENSE_ROW_MAJOR,
          (iree_hal_buffer_params_t){
              .type = IREE_HAL_MEMORY_TYPE_DEVICE_LOCAL,
              .usage = IREE_HAL_BUFFER_USAGE_DEFAULT,
          },
          iree_make_const_byte_span(kInt8_4, kCount * sizeof(int8_t)),
          &arg0_buffer_view),
      "iree_hal_buffer_view_allocate_buffer_copy(arg0)");
  DBG_PRINTF("[Run] arg0_buffer_view = %p\n", (void*)arg0_buffer_view);

  DBG_PRINTF("[Run] uploading arg1...\n");
  IREE_RETURN_IF_ERROR_DBG(
      iree_hal_buffer_view_allocate_buffer_copy(
          device, iree_hal_device_allocator(device), IREE_ARRAYSIZE(shape),
          shape, IREE_HAL_ELEMENT_TYPE_SINT_8,
          IREE_HAL_ENCODING_TYPE_DENSE_ROW_MAJOR,
          (iree_hal_buffer_params_t){
              .type = IREE_HAL_MEMORY_TYPE_DEVICE_LOCAL,
              .usage = IREE_HAL_BUFFER_USAGE_DEFAULT,
          },
          iree_make_const_byte_span(kInt8_2, kCount * sizeof(int8_t)),
          &arg1_buffer_view),
      "iree_hal_buffer_view_allocate_buffer_copy(arg1)");
  DBG_PRINTF("[Run] arg1_buffer_view = %p\n", (void*)arg1_buffer_view);

  DBG_PRINTF("[Run] uploading arg2...\n");
  IREE_RETURN_IF_ERROR_DBG(
      iree_hal_buffer_view_allocate_buffer_copy(
          device, iree_hal_device_allocator(device), IREE_ARRAYSIZE(shape),
          shape, IREE_HAL_ELEMENT_TYPE_SINT_32,
          IREE_HAL_ENCODING_TYPE_DENSE_ROW_MAJOR,
          (iree_hal_buffer_params_t){
              .type = IREE_HAL_MEMORY_TYPE_DEVICE_LOCAL,
              .usage = IREE_HAL_BUFFER_USAGE_DEFAULT,
          },
          iree_make_const_byte_span(kInt32_Zero, kCount * sizeof(int32_t)),
          &arg2_buffer_view),
      "iree_hal_buffer_view_allocate_buffer_copy(arg2)");
  DBG_PRINTF("[Run] arg2_buffer_view = %p\n", (void*)arg2_buffer_view);

  iree_vm_list_t* inputs = NULL;
  DBG_PRINTF("[Run] creating inputs list...\n");
  IREE_RETURN_IF_ERROR_DBG(
      iree_vm_list_create(iree_vm_make_undefined_type_def(),
                          /*capacity=*/3, host_allocator, &inputs),
      "iree_vm_list_create(inputs)");
  DBG_PRINTF("[Run] inputs = %p\n", (void*)inputs);

  iree_vm_ref_t arg0_ref = iree_hal_buffer_view_move_ref(arg0_buffer_view);
  iree_vm_ref_t arg1_ref = iree_hal_buffer_view_move_ref(arg1_buffer_view);
  iree_vm_ref_t arg2_ref = iree_hal_buffer_view_move_ref(arg2_buffer_view);

  DBG_PRINTF("[Run] pushing input refs...\n");
  IREE_RETURN_IF_ERROR_DBG(iree_vm_list_push_ref_move(inputs, &arg0_ref),
                           "iree_vm_list_push_ref_move(arg0)");
  IREE_RETURN_IF_ERROR_DBG(iree_vm_list_push_ref_move(inputs, &arg1_ref),
                           "iree_vm_list_push_ref_move(arg1)");
  IREE_RETURN_IF_ERROR_DBG(iree_vm_list_push_ref_move(inputs, &arg2_ref),
                           "iree_vm_list_push_ref_move(arg2)");

  iree_vm_list_t* outputs = NULL;
  DBG_PRINTF("[Run] creating outputs list...\n");
  IREE_RETURN_IF_ERROR_DBG(
      iree_vm_list_create(iree_vm_make_undefined_type_def(),
                          /*capacity=*/1, host_allocator, &outputs),
      "iree_vm_list_create(outputs)");
  DBG_PRINTF("[Run] outputs = %p\n", (void*)outputs);

  DBG_PRINTF("[Run] invoking 128x128 matmul...\n");
  IREE_RETURN_IF_ERROR_DBG(
      iree_vm_invoke(context, main_function, IREE_VM_INVOCATION_FLAG_NONE,
                     /*policy=*/NULL, inputs, outputs, host_allocator),
      "iree_vm_invoke");
  DBG_PRINTF("[Run] invocation complete\n");

  iree_hal_buffer_view_t* ret_buffer_view =
      iree_vm_list_get_buffer_view_assign(outputs, 0);
  if (ret_buffer_view == NULL) {
    return iree_make_status(IREE_STATUS_NOT_FOUND,
                            "can't find return buffer view");
  }
  DBG_PRINTF("[Run] ret_buffer_view = %p\n", (void*)ret_buffer_view);

  DBG_PRINTF("[Run] allocating host results buffer...\n");
  int32_t* results = (int32_t*)malloc(kCount * sizeof(int32_t));
  if (!results) {
    return iree_make_status(IREE_STATUS_RESOURCE_EXHAUSTED,
                            "results buffer allocation failed");
  }
  DBG_PRINTF("[Run] results = %p\n", (void*)results);

  DBG_PRINTF("[Run] transferring results device->host (%zu bytes)...\n",
             (size_t)(kCount * sizeof(int32_t)));
  IREE_RETURN_IF_ERROR_DBG(
      iree_hal_device_transfer_d2h(
          device, iree_hal_buffer_view_buffer(ret_buffer_view), 0, results,
          kCount * sizeof(int32_t), IREE_HAL_TRANSFER_BUFFER_FLAG_DEFAULT,
          iree_infinite_timeout()),
      "iree_hal_device_transfer_d2h");
  DBG_PRINTF("[Run] transfer complete\n");

  DBG_PRINTF("[Run] validating results...\n");
  int errors = 0;
  for (iree_host_size_t i = 0; i < kCount; ++i) {
    if (results[i] != 1024) {
      if (errors < 10) {
        printf("Mismatch at %d: Expected 1024, got %d\n", (int)i, results[i]);
      }
      errors++;
    }
  }

  if (errors > 0) {
    printf("Total errors: %d\n", errors);
    return iree_make_status(IREE_STATUS_UNKNOWN, "result mismatches");
  }

  free(kInt8_4);
  free(kInt8_2);
  free(kInt32_Zero);
  free(results);
  iree_vm_list_release(inputs);
  iree_vm_list_release(outputs);
  iree_hal_device_release(device);
  iree_vm_context_release(context);
  iree_vm_instance_release(instance);
  DBG_PRINTF("[Run] exit ok\n");
  return iree_ok_status();
}

int main(void) {
  // Optional trace hooks kept to mirror the FireSim example.
  // l_trace_encoder_start(0);

  printf("simple_embedding started\n");
  const iree_status_t result = Run();
  if (!iree_status_is_ok(result)) {
    iree_status_fprint(stderr, result);
    iree_status_free(result);
    return 1;
  }
  printf("simple_embedding done\n");

  // Only touch trace encoder MMIO when explicitly enabled.
  if (L_TRACE_ENCODER_ENABLE) {
    l_trace_encoder_stop(0);
    printf("Trace Stopped.\n");
  }
	sys_reboot(SYS_REBOOT_COLD);
  return 0;
}
```

## src/simple_embedding_zephyr_stubs.c
```c
#include "iree/base/api.h"
#include "iree/hal/api.h"
#include "iree/hal/drivers/local_sync/sync_device.h"
#include "iree/hal/local/executable_loader.h"
#include "iree/hal/local/loaders/embedded_elf_loader.h"
#include "model_vmfb.h"

iree_status_t create_sample_device(iree_allocator_t host_allocator,
                                   iree_hal_device_t** out_device) {
  iree_hal_sync_device_params_t params;
  iree_hal_sync_device_params_initialize(&params);

  iree_hal_executable_loader_t* loader = NULL;
  IREE_RETURN_IF_ERROR(iree_hal_embedded_elf_loader_create(
      /*plugin_manager=*/NULL, host_allocator, &loader));

  iree_string_view_t identifier = iree_make_cstring_view("local-sync");

  iree_hal_allocator_t* device_allocator = NULL;
  iree_status_t status = iree_hal_allocator_create_heap(
      identifier, host_allocator, host_allocator, &device_allocator);
  if (iree_status_is_ok(status)) {
    status = iree_hal_sync_device_create(
        identifier, &params, /*loader_count=*/1, &loader, device_allocator,
        host_allocator, out_device);
  }

  iree_hal_allocator_release(device_allocator);
  iree_hal_executable_loader_release(loader);
  return status;
}

const iree_const_byte_span_t load_bytecode_module_data(void) {
  return iree_make_const_byte_span(model_vmfb, model_vmfb_len);
}
```
