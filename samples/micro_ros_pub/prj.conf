## CMakeLists.txt
```
# SPDX-License-Identifier: Apache-2.0
#
# Skeleton micro-ROS sample for spike_riscv64 / chipyard_riscv64.
# Step 3 of bring-up: validate that libmicroros.a + microros_transports
# compile and link cleanly into a Zephyr image. main() makes no micro-ROS
# API calls yet — that comes once the HTIF custom transport is in place.

cmake_minimum_required(VERSION 3.20.0)

list(APPEND ZEPHYR_EXTRA_MODULES
    ${CMAKE_CURRENT_SOURCE_DIR}/../../third-party/micro_ros_zephyr_module/modules/libmicroros)

find_package(Zephyr REQUIRED HINTS $ENV{ZEPHYR_BASE})
project(micro_ros_pub)

# shims.c provides isatty() — referenced by libmicroros (rcutils logging) but
# not surfaced by this SDK + picolibc combo. See zephyr_sdk_compat.h in the
# libmicroros submodule for context.
target_sources(app PRIVATE
    src/main.c
    src/shims.c)
```

## prj.conf
```kconfig
# Skeleton micro-ROS link test for spike_riscv64.
# Goal at this step: produce a linked .elf — no transport actually runs.

CONFIG_MICROROS=y
CONFIG_APP_LINK_WITH_MICROROS=y
CONFIG_MICROROS_TRANSPORT_SERIAL=y
CONFIG_MICROROS_SERIAL_PORT="0"

# Stack/heap room for rcl/rclc allocations once we wire them up in step 4.
CONFIG_MAIN_STACK_SIZE=16384
CONFIG_HEAP_MEM_POOL_SIZE=131072

# POSIX clock — rcl/rclc need it.
CONFIG_POSIX_API=y

CONFIG_LOG=y
CONFIG_SERIAL=y

# Note on libc: the spike_riscv64 board defaults to picolibc (per the repo's
# toolchain layout). The upstream micro-ROS module was tested with newlib;
# we'll find out at link/runtime if picolibc is sufficient and force newlib
# (CONFIG_PICOLIBC=n + CONFIG_NEWLIB_LIBC=y) only if needed.
```

## src/main.c
```c
/*
 * SPDX-License-Identifier: Apache-2.0
 *
 * Skeleton: link-only validation of libmicroros + microros_transports.
 * No micro-ROS API is invoked yet.
 */

#include <zephyr/kernel.h>
#include <zephyr/sys/printk.h>

int main(void)
{
	printk("micro_ros_pub skeleton: linked OK\n");
	return 0;
}
```
