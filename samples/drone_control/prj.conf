## CMakeLists.txt
```
# SPDX-License-Identifier: Apache-2.0

cmake_minimum_required(VERSION 3.20.0)

find_package(Zephyr REQUIRED HINTS $ENV{ZEPHYR_BASE})
project(drone_control)


if(RISCV_VECTOR)
  set(USE_CPU OFF CACHE BOOL "Enable RISCV Scalar support")
  set(USE_RVV ON CACHE BOOL "Enable RVV support")
  set(USE_HANDOPT ON CACHE BOOL "Enable manual optimizations")
else()
  set(USE_CPU ON CACHE BOOL "Enable RISCV Scalar support")
  set(USE_RVV OFF CACHE BOOL "Enable RVV support")
  set(USE_HANDOPT OFF CACHE BOOL "Enable manual optimizations")
endif()



set(MEASURE_CYCLES OFF CACHE BOOL "Automatically Append Cycle Logging")
set(USE_TYPE "float32" CACHE STRING "Set floating point type for TinyMPC dependencies")

# Build the matlib dependency.
include(${CMAKE_CURRENT_SOURCE_DIR}/tinympc/external/matlib/matlib_header.cmake)


# Your main application sources.
target_sources(app PRIVATE src/main_mt_binary.cpp ${CMAKE_CURRENT_SOURCE_DIR}/tinympc/external/admm/src/admm_rvv.cpp)
# target_sources(app PRIVATE src/main_test_binary.cpp ${CMAKE_CURRENT_SOURCE_DIR}/tinympc/external/admm/src/admm_rvv.cpp)
# target_sources(app PRIVATE src/main_tracking.cpp ${CMAKE_CURRENT_SOURCE_DIR}/tinympc/external/admm/src/admm_rvv.cpp)

# Include directories for admm and matlib headers.
target_include_directories(app PRIVATE
  ${CMAKE_CURRENT_SOURCE_DIR}/tinympc/external/admm/include
  ${CMAKE_CURRENT_SOURCE_DIR}/tinympc/external/matlib/include
  ${CMAKE_CURRENT_SOURCE_DIR}/tinympc/include
  ${CMAKE_CURRENT_SOURCE_DIR}/tinympc/examples 
)

# Link the admm library into your Zephyr app.
target_link_libraries(app PRIVATE)
```

## prj.conf
```kconfig
CONFIG_CPP=y
CONFIG_REQUIRES_FULL_LIBCPP=n
CONFIG_MAIN_STACK_SIZE=4096

CONFIG_SMP=y
CONFIG_POSIX_API=y
CONFIG_MULTITHREADING=y
# CONFIG_MP_MAX_NUM_CPUS=8

CONFIG_SCHED_CPU_MASK=y
CONFIG_SCHED_CPU_MASK_PIN_ONLY=y
CONFIG_SCHED_DUMB=y

CONFIG_PICOLIBC=y
CONFIG_COMMON_LIBC_MALLOC=y
CONFIG_RISCV_ISA_EXT_V=y
CONFIG_RISCV_VECTOR_MAX_LEN=512

CONFIG_UART_CONSOLE=y
CONFIG_BOOT_BANNER=n

CONFIG_TIMING_FUNCTIONS=y
```

## src/main_mt_binary.cpp
```c
// /*
//  * Copyright (c) 2025, Dima Nikiforov <vnikiforov@berkeley.edu>
//  *
//  * SPDX-License-Identifier: Apache-2.0
//  */



// #include <zephyr/kernel.h>
// #include <zephyr/device.h>
// #include <zephyr/drivers/uart.h>
// #include <zephyr/timing/timing.h>
// #include <zephyr/sys/atomic.h>
// #include <string.h>
// #include "admm.hpp"
// #include "problem_data/quadrotor_50hz_params_constrained.hpp"
// // #include "problem_data/quadrotor_50hz_params_custom.hpp"
// // #include "problem_data/quadrotor_50hz_params_wide.hpp"
// // #include "problem_data/quadrotor_50hz_params_hawk.hpp"
// // #include "problem_data/quadrotor_50hz_params_racer.hpp"
// // #include "problem_data/quadrotor_50hz_params_custom_tweak.hpp"
// // #include "problem_data/quadrotor_50hz_params.hpp"
// #include "glob_opts.hpp"

// #define NUM_DRONES    4
// #define STACK_SIZE    (8192*2)
// #define NSTATES       12
// #define NACTIONS      4

// /* 4-byte header marker */
// #define HDR0 0xDE
// #define HDR1 0xAD
// #define HDR2 0xBE
// #define HDR3 0xEF
// static const uint8_t HEADER[4] = { HDR0, HDR1, HDR2, HDR3 };

// /* Zephyr/UART */
// static const struct device *uart0 = DEVICE_DT_GET(DT_NODELABEL(uart0));
// static struct k_mutex      uart_mutex;

// /* TinyMPC globals */
// TinyCache    caches[NUM_DRONES];
// TinyWorkspace works[NUM_DRONES];
// TinySettings  settings[NUM_DRONES];
// TinySolver    solvers[NUM_DRONES];

// K_THREAD_STACK_ARRAY_DEFINE(drone_stacks, NUM_DRONES, STACK_SIZE);
// struct k_thread drone_threads[NUM_DRONES];
// k_tid_t drone_thread_ids[NUM_DRONES];

// /* Task state + flag */
// struct DroneTask {
//     float    obs[NSTATES];
//     atomic_t new_state;
// };
// static struct DroneTask drone_tasks[NUM_DRONES];

// /* Helper: send binary response [HEADER][id][4 floats] */
// static void send_response(uint8_t id, float *u, uint32_t ns)
// {
//     k_mutex_lock(&uart_mutex, K_FOREVER);
//     for (int i = 0; i < 4; i++) {
//         uart_poll_out(uart0, HEADER[i]);
//     }
//     uart_poll_out(uart0, id);
//     for (int j = 0; j < NACTIONS; j++) {
//         uint8_t *pb = (uint8_t *)&u[j];
//         for (int b = 0; b < sizeof(float); b++) {
//             uart_poll_out(uart0, pb[b]);
//         }
//     }
//     /* 4-byte int32 ns (little-endian) */
//     uint8_t *ns_bytes = (uint8_t *)&ns;
//     for (int b = 0; b < sizeof(ns); b++) uart_poll_out(uart0, ns_bytes[b]);
//     k_mutex_unlock(&uart_mutex);
// }

// /* MPC worker thread: solve only on new state */
// void drone_worker(void *id_ptr, void *, void *)
// {
//     int id = (int)(uintptr_t)id_ptr;
//     enable_vector_operations();

//     /* TinyMPC init */
//     TinySolver    *solver = &solvers[id];
//     TinyCache     *cache  = &caches[id];
//     TinyWorkspace *work   = &works[id];
//     TinySettings  *setting= &settings[id];

//     solver->cache    = cache;
//     solver->work     = work;
//     solver->settings = setting;
//     tiny_init(solver);

//     init_VectorNx(&work->x1);
//     init_VectorNx(&work->x2);
//     init_VectorNx(&work->x3);
//     init_VectorNu(&work->u1);
//     init_VectorNu(&work->u2);

//     cache->rho = rho_value;
//     matsetv(cache->Kinf.data, Kinf_data, cache->Kinf.outer, cache->Kinf.inner);
//     transpose(cache->Kinf.data, cache->KinfT.data, NINPUTS, NSTATES);
//     matsetv(cache->Pinf.data, Pinf_data, cache->Pinf.outer, cache->Pinf.inner);
//     transpose(cache->Pinf.data, cache->PinfT.data, NSTATES, NSTATES);
//     matsetv(cache->Quu_inv.data, Quu_inv_data, cache->Quu_inv.outer, cache->Quu_inv.inner);
//     matsetv(cache->AmBKt.data, AmBKt_data, cache->AmBKt.outer, cache->AmBKt.inner);
//     transpose(cache->AmBKt.data, cache->AmBKtT.data, NSTATES, NSTATES);
//     matsetv(cache->coeff_d2p.data, coeff_d2p_data, cache->coeff_d2p.outer, cache->coeff_d2p.inner);

//     matsetv(work->Adyn.data, Adyn_data, work->Adyn.outer, work->Adyn.inner);
//     transpose(work->Adyn.data, work->AdynT.data, NSTATES, NSTATES);
//     matsetv(work->Bdyn.data, Bdyn_data, work->Bdyn.outer, work->Bdyn.inner);
//     transpose(work->Bdyn.data, work->BdynT.data, NSTATES, NINPUTS);
//     matsetv(work->Q.data, Q_data, work->Q.outer, work->Q.inner);
//     matsetv(work->R.data, R_data, work->R.outer, work->R.inner);

//     matset(work->u_min.data, -0.583, work->u_min.outer, work->u_min.inner);
//     matset(work->u_max.data, 1 - 0.583, work->u_max.outer, work->u_max.inner);

//     // HAWK
//     // matset(work->u_min.data, -0.0625, work->u_min.outer, work->u_min.inner);
//     // matset(work->u_max.data, 1 - 0.0625, work->u_max.outer, work->u_max.inner);

//     // // RACER
//     // matset(work->u_min.data, -0.2398f,
//     //    work->u_min.outer, work->u_min.inner);
//     // matset(work->u_max.data,  0.7602f,
//     //    work->u_max.outer, work->u_max.inner);

//     matset(work->x_min.data, -5, work->x_min.outer, work->x_min.inner);
//     matset(work->x_max.data, 5, work->x_max.outer, work->x_max.inner);

//     float Xref_origin[NSTATES] = {0};
//     for (int j = 0; j < NHORIZON; j++) {
//         matsetv(work->Xref.vector[j], Xref_origin, 1, NSTATES);
//     }

//     /* Worker loop: wait for new_state event */
//     float current_state[NSTATES];
//     // send_response((uint8_t)id, work->u.vector[0]);

//     volatile timing_t start_counter, end_counter;
//     uint64_t cycles;
//     uint32_t ns;
//     while (1) {
//         /* spin until a new state arrives */
//         // DISABLE fow power meas
//         while (atomic_cas(&drone_tasks[id].new_state, 1, 0) != 1) {
//             // k_yield();
//         }
//         /* copy fresh state */
//         memcpy(current_state, drone_tasks[id].obs, sizeof(current_state));

//         /* solve and send */
//         matsetv(work->x.vector[0], current_state, 1, NSTATES);
//         matset(work->y.data, 0.0, work->y.outer, work->y.inner);
//         matset(work->g.data, 0.0, work->g.outer, work->g.inner);

//         start_counter = timing_counter_get();
//         tiny_solve(solver);
//         end_counter = timing_counter_get();
        
//         cycles = timing_cycles_get(&start_counter, &end_counter);
//         ns = (uint32_t) timing_cycles_to_ns(cycles);

//         float u_out[NACTIONS];
//         for (int i = 0; i < NACTIONS; i++) {
//             u_out[i] = work->u.vector[0][i];
//         }
//         send_response((uint8_t)id, u_out, ns);
//     }
// }

//     unsigned long start_rd, end_rd, cycles_rd;

// /* Spawn worker threads (suspended), then pin, then start */
// static void spawn_drone_workers(void)
// {
//     for (int i = 0; i < NUM_DRONES; i++) {
//         atomic_set(&drone_tasks[i].new_state, 0);
//         drone_thread_ids[i] = k_thread_create(
//             &drone_threads[i], drone_stacks[i], STACK_SIZE,
//             drone_worker, (void *)(uintptr_t)i, NULL, NULL,
//             K_PRIO_PREEMPT(1), 0, K_FOREVER);
//         k_thread_cpu_pin(drone_thread_ids[i], (i + 5) % CONFIG_MP_MAX_NUM_CPUS);
//     }
//     for (int i = 0; i < NUM_DRONES; i++) {
//         k_thread_start(drone_thread_ids[i]);
//     }
// }

// int main(void)
// {
//     if (!device_is_ready(uart0)) {
//         return -1;
//     }
//     k_mutex_init(&uart_mutex);
//     enable_vector_operations();
//     //initialize atomics
//     for (int i = 0; i < NUM_DRONES; i++) {
//         atomic_set(&drone_tasks[i].new_state, 0);
//     }
//     spawn_drone_workers();

//     size_t match_idx = 0;
//     uint8_t rx;

//     float dummy_actions[NACTIONS] = {0.0f, 1.0f, 2.0f, 3.0f};

//     while (1) {
//         /* sync header */
//         while (match_idx < sizeof(HEADER)) {
//             if (uart_poll_in(uart0, &rx) == 0) {
//                 match_idx = (rx == HEADER[match_idx]) ? match_idx + 1
//                            : ((rx == HEADER[0]) ? 1 : 0);
//             }
//         }
//         /* read num_drones */
//         uint8_t num_drones;
//         while (uart_poll_in(uart0, &rx) != 0) {}
//         num_drones = rx;
//         if (num_drones > NUM_DRONES) {
//             size_t skip = (size_t)num_drones * NSTATES * sizeof(float);
//             for (size_t i = 0; i < skip; i++) {
//                 while (uart_poll_in(uart0, &rx) != 0) {}
//             }
//             match_idx = 0;
//             continue;
//         }
//         /* read and asynchronously store states */
//         for (uint8_t id = 0; id < num_drones; id++) {
//             for (int j = 0; j < NSTATES; j++) {
//                 float value;
//                 uint8_t *pv = (uint8_t *)&value;
//                 for (int b = 0; b < sizeof(float); b++) {
//                     while (uart_poll_in(uart0, &rx) != 0) {}
//                     pv[b] = rx;
//                 }
//                 drone_tasks[id].obs[j] = value;
//             }
//             atomic_set(&drone_tasks[id].new_state, 1);
//         }
//         match_idx = 0;
//     }

//     return 0;
// }


/*
 * Copyright (c) 2025, Dima Nikiforov <vnikiforov@berkeley.edu>
 *
 * SPDX-License-Identifier: Apache-2.0
 */

#include <zephyr/kernel.h>
#include <zephyr/device.h>
#ifndef CONFIG_BOARD_SPIKE_RISCV64
#include <zephyr/drivers/uart.h>
#endif
#include <zephyr/timing/timing.h>
#include <zephyr/sys/atomic.h>
#include <string.h>
#include "admm.hpp"
#include "problem_data/quadrotor_50hz_params_constrained.hpp"
#include "glob_opts.hpp"

#define NUM_DRONES    4
#define STACK_SIZE    (8192*2)
#define NSTATES       12
#define NACTIONS      4

#define HDR0 0xDE
#define HDR1 0xAD
#define HDR2 0xBE
#define HDR3 0xEF
static const uint8_t HEADER[4] = { HDR0, HDR1, HDR2, HDR3 };

#ifndef CONFIG_BOARD_SPIKE_RISCV64
static const struct device *uart0 = DEVICE_DT_GET(DT_NODELABEL(uart0));
static struct k_mutex      uart_mutex;
#endif

TinyCache    caches[NUM_DRONES];
TinyWorkspace works[NUM_DRONES];
TinySettings  settings[NUM_DRONES];
TinySolver    solvers[NUM_DRONES];

K_THREAD_STACK_ARRAY_DEFINE(drone_stacks, NUM_DRONES, STACK_SIZE);
struct k_thread drone_threads[NUM_DRONES];
k_tid_t drone_thread_ids[NUM_DRONES];

struct DroneTask {
    float    obs[NSTATES];
    atomic_t new_state;
};
static struct DroneTask drone_tasks[NUM_DRONES];

static void send_response(uint8_t id, float *u, uint32_t ns)
{
#ifndef CONFIG_BOARD_SPIKE_RISCV64
    k_mutex_lock(&uart_mutex, K_FOREVER);
    for (int i = 0; i < 4; i++) uart_poll_out(uart0, HEADER[i]);
    uart_poll_out(uart0, id);
    for (int j = 0; j < NACTIONS; j++) {
        uint8_t *pb = (uint8_t *)&u[j];
        for (int b = 0; b < (int)sizeof(float); b++) uart_poll_out(uart0, pb[b]);
    }
    uint8_t *ns_bytes = (uint8_t *)&ns;
    for (int b = 0; b < (int)sizeof(ns); b++) uart_poll_out(uart0, ns_bytes[b]);
    k_mutex_unlock(&uart_mutex);
#else
    printk("id=%d ns=%u u=[%.3f %.3f %.3f %.3f]\n",
           id, ns, (double)u[0], (double)u[1], (double)u[2], (double)u[3]);
#endif
}

void drone_worker(void *id_ptr, void *, void *)
{
    int id = (int)(uintptr_t)id_ptr;
    enable_vector_operations();

    TinySolver    *solver  = &solvers[id];
    TinyCache     *cache   = &caches[id];
    TinyWorkspace *work    = &works[id];
    TinySettings  *setting = &settings[id];

    solver->cache    = cache;
    solver->work     = work;
    solver->settings = setting;
    tiny_init(solver);

    init_VectorNx(&work->x1);
    init_VectorNx(&work->x2);
    init_VectorNx(&work->x3);
    init_VectorNu(&work->u1);
    init_VectorNu(&work->u2);

    cache->rho = rho_value;
    matsetv(cache->Kinf.data, Kinf_data, cache->Kinf.outer, cache->Kinf.inner);
    transpose(cache->Kinf.data, cache->KinfT.data, NINPUTS, NSTATES);
    matsetv(cache->Pinf.data, Pinf_data, cache->Pinf.outer, cache->Pinf.inner);
    transpose(cache->Pinf.data, cache->PinfT.data, NSTATES, NSTATES);
    matsetv(cache->Quu_inv.data, Quu_inv_data, cache->Quu_inv.outer, cache->Quu_inv.inner);
    matsetv(cache->AmBKt.data, AmBKt_data, cache->AmBKt.outer, cache->AmBKt.inner);
    transpose(cache->AmBKt.data, cache->AmBKtT.data, NSTATES, NSTATES);
    matsetv(cache->coeff_d2p.data, coeff_d2p_data, cache->coeff_d2p.outer, cache->coeff_d2p.inner);

    matsetv(work->Adyn.data, Adyn_data, work->Adyn.outer, work->Adyn.inner);
    transpose(work->Adyn.data, work->AdynT.data, NSTATES, NSTATES);
    matsetv(work->Bdyn.data, Bdyn_data, work->Bdyn.outer, work->Bdyn.inner);
    transpose(work->Bdyn.data, work->BdynT.data, NSTATES, NINPUTS);
    matsetv(work->Q.data, Q_data, work->Q.outer, work->Q.inner);
    matsetv(work->R.data, R_data, work->R.outer, work->R.inner);

    matset(work->u_min.data, -0.583, work->u_min.outer, work->u_min.inner);
    matset(work->u_max.data, 1 - 0.583, work->u_max.outer, work->u_max.inner);
    matset(work->x_min.data, -5, work->x_min.outer, work->x_min.inner);
    matset(work->x_max.data, 5, work->x_max.outer, work->x_max.inner);

    float Xref_origin[NSTATES] = {0};
    for (int j = 0; j < NHORIZON; j++) {
        matsetv(work->Xref.vector[j], Xref_origin, 1, NSTATES);
    }

    float current_state[NSTATES];
    volatile timing_t start_counter, end_counter;
    uint64_t cycles;
    uint32_t ns;

    while (1) {
        while (atomic_cas(&drone_tasks[id].new_state, 1, 0) != 1) {}
        memcpy(current_state, drone_tasks[id].obs, sizeof(current_state));

        matsetv(work->x.vector[0], current_state, 1, NSTATES);
        matset(work->y.data, 0.0, work->y.outer, work->y.inner);
        matset(work->g.data, 0.0, work->g.outer, work->g.inner);

        start_counter = timing_counter_get();
        tiny_solve(solver);
        end_counter = timing_counter_get();

        cycles = timing_cycles_get(&start_counter, &end_counter);
        ns = (uint32_t) timing_cycles_to_ns(cycles);

        float u_out[NACTIONS];
        for (int i = 0; i < NACTIONS; i++) {
            u_out[i] = work->u.vector[0][i];
        }
        send_response((uint8_t)id, u_out, ns);
    }
}

unsigned long start_rd, end_rd, cycles_rd;

static void spawn_drone_workers(void)
{
    for (int i = 0; i < NUM_DRONES; i++) {
        atomic_set(&drone_tasks[i].new_state, 0);
        drone_thread_ids[i] = k_thread_create(
            &drone_threads[i], drone_stacks[i], STACK_SIZE,
            drone_worker, (void *)(uintptr_t)i, NULL, NULL,
            K_PRIO_PREEMPT(1), 0, K_FOREVER);
#ifndef CONFIG_BOARD_SPIKE_RISCV64
        k_thread_cpu_pin(drone_thread_ids[i], (i + 5) % CONFIG_MP_MAX_NUM_CPUS);
#endif
    }
    for (int i = 0; i < NUM_DRONES; i++) {
        k_thread_start(drone_thread_ids[i]);
    }
}

int main(void)
{
#ifndef CONFIG_BOARD_SPIKE_RISCV64
    if (!device_is_ready(uart0)) return -1;
    k_mutex_init(&uart_mutex);
#endif
    enable_vector_operations();
    for (int i = 0; i < NUM_DRONES; i++) {
        atomic_set(&drone_tasks[i].new_state, 0);
    }
    spawn_drone_workers();

#ifndef CONFIG_BOARD_SPIKE_RISCV64
    size_t match_idx = 0;
    uint8_t rx;
    while (1) {
        while (match_idx < sizeof(HEADER)) {
            if (uart_poll_in(uart0, &rx) == 0) {
                match_idx = (rx == HEADER[match_idx]) ? match_idx + 1
                           : ((rx == HEADER[0]) ? 1 : 0);
            }
        }
        uint8_t num_drones;
        while (uart_poll_in(uart0, &rx) != 0) {}
        num_drones = rx;
        if (num_drones > NUM_DRONES) {
            size_t skip = (size_t)num_drones * NSTATES * sizeof(float);
            for (size_t i = 0; i < skip; i++) {
                while (uart_poll_in(uart0, &rx) != 0) {}
            }
            match_idx = 0;
            continue;
        }
        for (uint8_t id = 0; id < num_drones; id++) {
            for (int j = 0; j < NSTATES; j++) {
                float value;
                uint8_t *pv = (uint8_t *)&value;
                for (int b = 0; b < (int)sizeof(float); b++) {
                    while (uart_poll_in(uart0, &rx) != 0) {}
                    pv[b] = rx;
                }
                drone_tasks[id].obs[j] = value;
            }
            atomic_set(&drone_tasks[id].new_state, 1);
        }
        match_idx = 0;
    }
#else
    float dummy_state[NSTATES] = {0};
    for (int i = 0; i < NUM_DRONES; i++) {
        memcpy(drone_tasks[i].obs, dummy_state, sizeof(dummy_state));
        atomic_set(&drone_tasks[i].new_state, 1);
    }
    k_sleep(K_MSEC(5000));
#endif
    return 0;
}
```

## src/main_test_binary.cpp
```c
/*
 * SPDX-License-Identifier: Apache-2.0
 * Minimal test app: echo back ID + four test floats for each drone
 */

#include <zephyr/kernel.h>
#include <zephyr/device.h>
#include <zephyr/drivers/uart.h>
// #include <sys/printk.h>
#include <string.h>

#define UART_NODE      DT_NODELABEL(uart0)
#define HDR0           0xDE
#define HDR1           0xAD
#define HDR2           0xBE
#define HDR3           0xEF

static const uint8_t HEADER[4] = { HDR0, HDR1, HDR2, HDR3 };

int main(void)
{
    const struct device *uart = DEVICE_DT_GET(UART_NODE);
    if (!device_is_ready(uart)) {
        // printk("UART not ready\n");
        return 1;
    }

    uint8_t rx;
    size_t match_idx = 0;

    while (1) {
        /* 1) SYNC on header */
        while (match_idx < sizeof(HEADER)) {
            if (uart_poll_in(uart, &rx) == 0) {
                if (rx == HEADER[match_idx]) {
                    match_idx++;
                } else {
                    /* partial-match fallback: if this byte is HDR0, stay at 1 */
                    match_idx = (rx == HEADER[0]) ? 1 : 0;
                }
            }
            /* else timeout: retry */
        }

        /* 2) Read num_drones */
        uint8_t num_drones = 0;
        while (uart_poll_in(uart, &rx) != 0) { /* wait */ }
        num_drones = rx;

        /* 3) Skip over incoming state data: num_drones × 12 floats */
        size_t bytes_to_skip = num_drones * 12 * sizeof(float);
        for (size_t i = 0; i < bytes_to_skip; i++) {
            while (uart_poll_in(uart, &rx) != 0) { /* wait */ }
        }

        /* 4) For each drone, send back [HEADER][id][0,1,2,3] */
        for (uint8_t id = 0; id < num_drones; id++) {
            /* send header */
            for (int i = 0; i < 4; i++) {
                uart_poll_out(uart, HEADER[i]);
            }
            /* send drone id */
            uart_poll_out(uart, id);

            /* send four test floats: 0.0f, 1.0f, 2.0f, 3.0f little-endian */
            float actions[5] = { 0.0f, 1.0f, 2.0f, 3.0f, 0.0f };
            for (int j = 0; j < 5; j++) {
                uint8_t *pb = (uint8_t *)&actions[j];
                for (int b = 0; b < sizeof(float); b++) {
                    uart_poll_out(uart, pb[b]);
                }
            }
        }

        /* reset sync state */
        match_idx = 0;
    }
    return 0;
}
```

## src/main_tracking.cpp
```c
// Quadrotor hovering example (API-converted)
// States: x, y, z, phi, theta, psi, dx, dy, dz, dphi, dtheta, dpsi
// Inputs: u1..u4 (0–1), Crazyflie order
// Note: phi/theta/psi are Rodrigues parameters (see the referenced paper)

#include <stdio.h>
#include <admm.hpp>

#include "problem_data/quadrotor_20hz_params.hpp"
#include "trajectory_data/quadrotor_20hz_y_axis_line.hpp"
#include <zephyr/sys/reboot.h>

extern "C" {

TinyCache cache;
TinyWorkspace work;
TinySettings settings;
TinySolver solver{&settings, &cache, &work};

int main(void)
{
    printf("Entered main!\n");

    enable_vector_operations();
    tiny_init(&solver);
    uint64_t start, end;

    // temporaries
    tiny_VectorNx v1, v2, x0, x1;
    init_VectorNx(&v1);
    init_VectorNx(&v2);
    init_VectorNx(&x0);
    init_VectorNx(&x1);

    // ---- Map arrays from problem_data (row-major) ----
    cache.rho = rho_value;

    matsetv(cache.Kinf.data,     Kinf_data,     cache.Kinf.outer,     cache.Kinf.inner);
    transpose(cache.Kinf.data,   cache.KinfT.data, NINPUTS, NSTATES);

    matsetv(cache.Pinf.data,     Pinf_data,     cache.Pinf.outer,     cache.Pinf.inner);
    transpose(cache.Pinf.data,   cache.PinfT.data, NSTATES, NSTATES);

    matsetv(cache.Quu_inv.data,  Quu_inv_data,  cache.Quu_inv.outer,  cache.Quu_inv.inner);
    matsetv(cache.AmBKt.data,    AmBKt_data,    cache.AmBKt.outer,    cache.AmBKt.inner);
    transpose(cache.AmBKt.data,  cache.AmBKtT.data, NSTATES, NSTATES);
    matsetv(cache.coeff_d2p.data,coeff_d2p_data,cache.coeff_d2p.outer,cache.coeff_d2p.inner);

    matsetv(work.Adyn.data,      Adyn_data,     work.Adyn.outer,      work.Adyn.inner);
    transpose(work.Adyn.data,    work.AdynT.data, NSTATES, NSTATES);
    matsetv(work.Bdyn.data,      Bdyn_data,     work.Bdyn.outer,      work.Bdyn.inner);
    transpose(work.Bdyn.data,    work.BdynT.data, NSTATES, NINPUTS);

    matsetv(work.Q.data,         Q_data,        work.Q.outer,         work.Q.inner);
    matsetv(work.R.data,         R_data,        work.R.outer,         work.R.inner);

    // ---- Valid ranges for inputs and states ----
    matset(work.u_min.data, -0.583f,        work.u_min.outer, work.u_min.inner);
    matset(work.u_max.data, 1.0f - 0.583f,  work.u_max.outer, work.u_max.inner);
    matset(work.x_min.data, -5.0f,          work.x_min.outer, work.x_min.inner);
    matset(work.x_max.data,  5.0f,          work.x_max.outer, work.x_max.inner);

    // ---- Optimization residuals and settings ----
    work.primal_residual_state = 0;
    work.primal_residual_input = 0;
    work.dual_residual_state   = 0;
    work.dual_residual_input   = 0;
    work.status = 0;
    work.iter   = 0;

    settings.abs_pri_tol      = 0.001f;
    settings.abs_dua_tol      = 0.001f;
    settings.max_iter         = 100;
    settings.check_termination= 1;
    settings.en_input_bound   = 1;
    settings.en_state_bound   = 1;

    // ---- Initialize Xref horizon from trajectory (k = 0) ----
    // Xref_data is a flat array with NTOTAL columns of size NSTATES.
    for (int j = 0; j < NHORIZON; ++j) {
        tinytype* src = Xref_data + j * NSTATES;
        matsetv(work.Xref.vector[j], src, 1, NSTATES);
    }
    TRACE_CHECKSUM(init_xref_total, work.Xref);

    // ---- Initial state x0: first state from Xref_data ----
    matsetv(x0.data, Xref_data, x0.outer, x0.inner);
    
    TRACE_CHECKSUM(init_x0, x0);

    for (int k = 0; k < 10; ++k) {
        // Tracking error: || x0 - Xref[:,1] ||
        matsub(x0.data, work.Xref.vector[1], v1.data, 1, NSTATES);
        TRACE_CHECKSUM(main_loop_x0,   x0);
        TRACE_CHECKSUM(main_loop_xref, work.Xref);
        TRACE_CHECKSUM(main_loop_v1,   v1);
        float norm = matnorm(v1.data, 1, NSTATES);
        printf("Tracking error: %0.7f\n", norm);

        // 1) Update measurement into column 0
        matsetv(work.x.vector[0], x0.data, 1, NSTATES);

        // 2) Update reference horizon to start at step k
        for (int j = 0; j < NHORIZON; ++j) {
            const int idx = k + j;
            tinytype* src = Xref_data + idx * NSTATES;
            matsetv(work.Xref.vector[j], src, 1, NSTATES);
        }

        // 3) Reset dual variables
        matset(work.y.data, 0.0f, work.y.outer, work.y.inner);
        matset(work.g.data, 0.0f, work.g.outer, work.g.inner);

        // 4) Solve MPC
        start = read_cycles();
        tiny_solve(&solver);
        end   = read_cycles();
        printf("Time for iter %d: %llu\n", k, (unsigned long long)(end - start));

        // 5) Simulate forward: x1 = A*x0 + B*u(:,0)
    #ifdef USE_MATVEC
        matvec(work.Adyn.data, x0.data,                  v1.data, NSTATES, NSTATES);
        matvec(work.Bdyn.data, work.u.vector[0],         v2.data, NSTATES, NINPUTS);
    #else
        matmul(x0.data,          work.Adyn.data, v1.data, 1, NSTATES, NSTATES);
        matmul(work.u.vector[0], work.Bdyn.data, v2.data, 1, NSTATES, NINPUTS);
    #endif
        matadd(v1.data, v2.data, x0.data, 1, NSTATES);

        TRACE_CHECKSUM(main_loop_u_0, work.u);
        TRACE_CHECKSUM(main_loop_v1,  v1);
        TRACE_CHECKSUM(main_loop_v2,  v2);
        TRACE_CHECKSUM(main_loop_x0,  x0);
    }

    sys_reboot(SYS_REBOOT_COLD);
    return 0;
}

} // extern "C"
```
