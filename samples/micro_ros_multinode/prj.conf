## CMakeLists.txt
```
# SPDX-License-Identifier: Apache-2.0
#
# Two-node micro-ROS smoke test for spike_riscv64 / chipyard_riscv64.
# Talks to ros-jazzy-micro-ros-agent on the host via tools/microros/.

cmake_minimum_required(VERSION 3.20.0)

list(APPEND ZEPHYR_EXTRA_MODULES
    ${CMAKE_CURRENT_SOURCE_DIR}/../../third-party/micro_ros_zephyr_module/modules/libmicroros)

# Same SDK 1.0.0-beta1 newlib + Annex K dance the libmicroros build needs.
# Our sources transitively include <rcl/rcl.h> which pulls rcutils'
# error_handling.h which sets __STDC_WANT_LIB_EXT1__=1 then includes <stdlib.h>,
# tripping the same header-guard ordering bug. Force the macro to 0 for the
# outer Zephyr build so rcutils' #ifndef fast-path keeps it 0.
add_compile_definitions(__STDC_WANT_LIB_EXT1__=0)

find_package(Zephyr REQUIRED HINTS $ENV{ZEPHYR_BASE})
project(micro_ros_multinode)

target_sources(app PRIVATE
    src/main.c
    src/transport_htif.c
    src/shims.c)
```

## prj.conf
```kconfig
# Two-node micro-ROS smoke test.

CONFIG_MICROROS=y
CONFIG_APP_LINK_WITH_MICROROS=y
# A transport choice has to be selected for the libmicroros module to build —
# we override it at runtime via rmw_uros_set_custom_transport(). The serial
# transport's stub functions get linked but never run.
CONFIG_MICROROS_TRANSPORT_SERIAL=y
CONFIG_MICROROS_SERIAL_PORT="0"

CONFIG_MICROROS_NODES="2"
CONFIG_MICROROS_PUBLISHERS="2"
CONFIG_MICROROS_SUBSCRIBERS="0"
CONFIG_MICROROS_CLIENTS="0"
CONFIG_MICROROS_SERVERS="0"

# rclc executor + two timers + transport reader thread; must accommodate
# the largest stack a colcon-built rcl call needs (rosidl init paths can
# burn through ~8K).
CONFIG_MAIN_STACK_SIZE=32768
CONFIG_HEAP_MEM_POOL_SIZE=262144

# rcl/rclc reaches into POSIX clock and pthread internals on some paths.
CONFIG_POSIX_API=y

# Plain printk to console — no LOG subsystem. With CONFIG_LOG=y and the
# default deferred mode, printk text routes through the logger thread, which
# has to compete with our HTIF reader thread for the htif_lock mutex; the
# net effect is that boot-time printks never reach stdout in spike runs
# without a connected agent. Direct printk avoids that dependency entirely.
CONFIG_PRINTK=y
CONFIG_CONSOLE=y
CONFIG_UART_CONSOLE=y
CONFIG_SERIAL=y

# rosidl-generator emits __attribute__((constructor)) for type-support
# registration; Zephyr 4.2 requires this Kconfig to honor them at boot.
CONFIG_STATIC_INIT_GNU=y
```

## src/main.c
```c
/*
 * SPDX-License-Identifier: Apache-2.0
 *
 * Two-node smoke test for micro-ROS on spike_riscv64 / chipyard_riscv64.
 *
 * Spawns two nodes, each with one Int32 publisher fed by a periodic timer.
 * Talks to a ros-jazzy-micro-ros-agent on the host via the HDLC-on-HTIF
 * custom transport (transport_htif.{c,h}). The agent connection is brokered
 * by tools/microros/htif_proxy.py (see tools/microros/run_with_agent.sh).
 *
 *   /node_a/counter   std_msgs/Int32   1 Hz
 *   /node_b/counter   std_msgs/Int32   2 Hz
 */

#include <zephyr/kernel.h>
#include <zephyr/sys/printk.h>
#include <zephyr/sys/reboot.h>

#include <rcl/rcl.h>
#include <rcl/error_handling.h>
#include <rclc/rclc.h>
#include <rclc/executor.h>
#include <rmw_microros/rmw_microros.h>
#include <std_msgs/msg/int32.h>

#include "transport_htif.h"

#define RCCHECK(rc) do { \
	rcl_ret_t _rc = (rc); \
	if (_rc != RCL_RET_OK) { \
		printk("rcl error %d at %s:%d\n", (int)_rc, __FILE__, __LINE__); \
		return; \
	} \
} while (0)

static rcl_publisher_t pub_a;
static rcl_publisher_t pub_b;
static std_msgs__msg__Int32 msg_a;
static std_msgs__msg__Int32 msg_b;

static void timer_a_cb(rcl_timer_t *timer, int64_t last_call_time)
{
	ARG_UNUSED(timer); ARG_UNUSED(last_call_time);
	rcl_ret_t rc = rcl_publish(&pub_a, &msg_a, NULL);
	if (rc != RCL_RET_OK) {
		printk("publish a failed: %d\n", (int)rc);
	}
	msg_a.data++;
}

static void timer_b_cb(rcl_timer_t *timer, int64_t last_call_time)
{
	ARG_UNUSED(timer); ARG_UNUSED(last_call_time);
	rcl_ret_t rc = rcl_publish(&pub_b, &msg_b, NULL);
	if (rc != RCL_RET_OK) {
		printk("publish b failed: %d\n", (int)rc);
	}
	msg_b.data += 10;   /* easy visual distinction from a's stream */
}

static void uros_main(void)
{
	/* 1. Wire the custom transport before anything else touches rmw. */
	rmw_uros_set_custom_transport(
		true,    /* MICRO_ROS_FRAMING_REQUIRED — keeps message reassembly
			  * intact even if our HDLC frames split a multi-byte msg
			  * (we don't, today, but it's robust to add). */
		NULL,
		htif_transport_open,
		htif_transport_close,
		htif_transport_write,
		htif_transport_read);

	/* 2. Wait for the agent to come up. We block forever — that matches
	 *    the post-boot sequencing the host script uses (agent first,
	 *    then it'll feed pings through). */
	printk("micro_ros_multinode: pinging agent...\n");
	while (rmw_uros_ping_agent(1000, 1) != RMW_RET_OK) {
		k_msleep(200);
	}
	printk("micro_ros_multinode: agent reachable\n");

	/* 3. Standard rclc bring-up. */
	rcl_allocator_t allocator = rcl_get_default_allocator();
	rclc_support_t  support;
	RCCHECK(rclc_support_init(&support, 0, NULL, &allocator));

	rcl_node_t node_a, node_b;
	RCCHECK(rclc_node_init_default(&node_a, "node_a", "", &support));
	RCCHECK(rclc_node_init_default(&node_b, "node_b", "", &support));

	const rosidl_message_type_support_t *int32_ts =
		ROSIDL_GET_MSG_TYPE_SUPPORT(std_msgs, msg, Int32);

	RCCHECK(rclc_publisher_init_default(&pub_a, &node_a, int32_ts, "/node_a/counter"));
	RCCHECK(rclc_publisher_init_default(&pub_b, &node_b, int32_ts, "/node_b/counter"));

	std_msgs__msg__Int32__init(&msg_a);
	std_msgs__msg__Int32__init(&msg_b);
	msg_a.data = 0;
	msg_b.data = 0;

	rcl_timer_t timer_a, timer_b;
	RCCHECK(rclc_timer_init_default2(&timer_a, &support,
					RCL_MS_TO_NS(1000), timer_a_cb, true));
	RCCHECK(rclc_timer_init_default2(&timer_b, &support,
					RCL_MS_TO_NS(500),  timer_b_cb, true));

	/* 4. Executor for two timers. */
	rclc_executor_t executor;
	RCCHECK(rclc_executor_init(&executor, &support.context, 2, &allocator));
	RCCHECK(rclc_executor_add_timer(&executor, &timer_a));
	RCCHECK(rclc_executor_add_timer(&executor, &timer_b));

	/* Run for a bounded duration so the sim can self-terminate via the
	 * HTIF exit command. Long enough to see ros2 topic echo cycle through
	 * many publishes, short enough that CI-style runs don't hang. */
	const int64_t deadline_ms = k_uptime_get() + 30000;
	printk("micro_ros_multinode: entering executor loop (30s)\n");
	while (k_uptime_get() < deadline_ms) {
		rclc_executor_spin_some(&executor, RCL_MS_TO_NS(100));
		k_msleep(10);
	}

	printk("micro_ros_multinode: shutting down\n");
	(void)rcl_publisher_fini(&pub_a, &node_a);
	(void)rcl_publisher_fini(&pub_b, &node_b);
	(void)rcl_node_fini(&node_a);
	(void)rcl_node_fini(&node_b);
	(void)rclc_support_fini(&support);
}

int main(void)
{
	printk("*** micro_ros_multinode boot ***\n");
	uros_main();
	printk("*** micro_ros_multinode exit — issuing HTIF shutdown ***\n");
	/* Sends the HTIF exit command, which fesvr handles by terminating the
	 * sim (instead of relying on a host-side timeout to kill spike). */
	sys_reboot(SYS_REBOOT_COLD);
	return 0;
}
```

## src/transport_htif.c
```c
/*
 * SPDX-License-Identifier: Apache-2.0
 *
 * HDLC-on-HTIF micro-ROS custom transport. See transport_htif.h for protocol.
 *
 * Single-threaded design: no separate reader thread. transport_read drives the
 * HDLC parser inline as it pulls bytes from HTIF. Avoids mutex contention with
 * printk and the htif driver's blocking poll_in semantics under no-input.
 */

#include "transport_htif.h"

#include <zephyr/kernel.h>
#include <zephyr/device.h>
#include <zephyr/drivers/uart.h>
#include <zephyr/sys/printk.h>

#define HTIF_NODE   DT_NODELABEL(htif)
#define FLAG        0x7Eu
#define ESC         0x7Du
#define ESC_XOR     0x20u

/* Sized for one XRCE-DDS message. Our colcon.meta caps MTU at 512;
 * pad for headers + worst-case escaping. */
#define MAX_PAYLOAD 1024

/* CRC16-CCITT (poly 0x1021, init 0xFFFF, no xorout, no reflect). */
static uint16_t crc16_ccitt(const uint8_t *data, size_t len)
{
	uint16_t crc = 0xFFFFu;
	for (size_t i = 0; i < len; i++) {
		crc ^= ((uint16_t)data[i]) << 8;
		for (int b = 0; b < 8; b++) {
			crc = (crc & 0x8000u) ? (uint16_t)((crc << 1) ^ 0x1021u)
					      : (uint16_t)(crc << 1);
		}
	}
	return crc;
}

/* ---------- module-private state ---------- */

static const struct device *htif_dev;

enum parser_state {
	PS_OUT_OF_FRAME,
	PS_IN_FRAME,
	PS_IN_FRAME_ESC,
};

/* The parser carries state across transport_read calls so a frame split across
 * multiple reads is handled correctly. */
static enum parser_state parse_state = PS_OUT_OF_FRAME;
static uint8_t parse_accum[MAX_PAYLOAD + 2];
static size_t  parse_len;

/* When a complete, CRC-validated frame is decoded inside transport_read, its
 * payload is staged here and drained byte-by-byte to the caller's buffer. */
static uint8_t staged_payload[MAX_PAYLOAD];
static size_t  staged_len;
static size_t  staged_off;

/* Push one raw byte into the parser. If a frame just completed and was valid,
 * stage its payload for delivery. Returns true if a frame is now staged. */
static bool feed_parser(uint8_t raw)
{
	switch (parse_state) {
	case PS_OUT_OF_FRAME:
		if (raw == FLAG) {
			parse_len = 0;
			parse_state = PS_IN_FRAME;
		}
		/* else: out-of-frame (interleaved printk byte), ignore */
		return false;

	case PS_IN_FRAME:
		if (raw == FLAG) {
			bool ok = false;
			if (parse_len >= 3) {
				size_t plen = parse_len - 2;
				uint16_t got = ((uint16_t)parse_accum[plen] << 8) |
					       (uint16_t)parse_accum[plen + 1];
				uint16_t exp = crc16_ccitt(parse_accum, plen);
				if (got == exp) {
					memcpy(staged_payload, parse_accum, plen);
					staged_len = plen;
					staged_off = 0;
					ok = true;
				}
			}
			parse_len = 0;
			parse_state = PS_IN_FRAME;  /* trailing FLAG = leading FLAG */
			return ok;
		}
		if (raw == ESC) {
			parse_state = PS_IN_FRAME_ESC;
			return false;
		}
		if (parse_len < sizeof(parse_accum)) {
			parse_accum[parse_len++] = raw;
		} else {
			parse_len = 0;
			parse_state = PS_OUT_OF_FRAME;
		}
		return false;

	case PS_IN_FRAME_ESC:
		if (parse_len < sizeof(parse_accum)) {
			parse_accum[parse_len++] = raw ^ ESC_XOR;
			parse_state = PS_IN_FRAME;
		} else {
			parse_len = 0;
			parse_state = PS_OUT_OF_FRAME;
		}
		return false;
	}
	return false;
}

/* ---------- the four uxrCustomTransport hooks ---------- */

bool htif_transport_open(struct uxrCustomTransport *t)
{
	(void)t;
	htif_dev = DEVICE_DT_GET(HTIF_NODE);
	if (!device_is_ready(htif_dev)) {
		printk("htif transport: device not ready\n");
		return false;
	}
	parse_state = PS_OUT_OF_FRAME;
	parse_len = 0;
	staged_len = 0;
	staged_off = 0;
	return true;
}

bool htif_transport_close(struct uxrCustomTransport *t)
{
	(void)t;
	return true;
}

static inline void emit_escaped(uint8_t b)
{
	if (b == FLAG || b == ESC) {
		uart_poll_out(htif_dev, ESC);
		uart_poll_out(htif_dev, b ^ ESC_XOR);
	} else {
		uart_poll_out(htif_dev, b);
	}
}

size_t htif_transport_write(struct uxrCustomTransport *t,
			    const uint8_t *buf, size_t len, uint8_t *err)
{
	(void)t; (void)err;

	uart_poll_out(htif_dev, FLAG);
	for (size_t i = 0; i < len; i++) {
		emit_escaped(buf[i]);
	}
	uint16_t crc = crc16_ccitt(buf, len);
	emit_escaped((uint8_t)(crc >> 8));
	emit_escaped((uint8_t)(crc & 0xFFu));
	uart_poll_out(htif_dev, FLAG);
	return len;
}

/*
 * IMPORTANT — runtime expectation:
 *
 * spike's HTIF console GETC implementation BLOCKS when its stdin has no
 * data available; it does not return -1 on EOF or timeout the way a serial
 * UART would. There is no non-blocking mode for the HTIF byte channel.
 *
 * Consequence: this transport_read can only make forward progress when the
 * agent is actively feeding spike's stdin. The supported runtime path is
 * `tools/microros/run_with_agent.sh`, which launches both spike and
 * micro-ros-agent and pipes the agent's output into spike's stdin via the
 * HDLC proxy. With that in place, GETC unblocks promptly on each agent
 * response, and ping_agent / discovery / data flow all work normally.
 *
 * Running `spike <elf>` directly (no agent) WILL hang here on the first
 * ping_agent transport_read. That is expected for this configuration —
 * it's a stdin-blocking limitation of spike's HTIF frontend, not a bug
 * in this transport.
 */
size_t htif_transport_read(struct uxrCustomTransport *t,
			   uint8_t *buf, size_t len, int timeout_ms, uint8_t *err)
{
	(void)t; (void)err;

	size_t out = 0;

	/* Drain any payload bytes already staged from a previous call. */
	while (staged_off < staged_len && out < len) {
		buf[out++] = staged_payload[staged_off++];
	}
	if (out > 0) {
		return out;
	}

	const int64_t deadline = k_uptime_get() + (int64_t)timeout_ms;
	const int slice_ms = 2;
	for (;;) {
		if (k_uptime_get() >= deadline) {
			return out;
		}
		unsigned char raw;
		int rc = uart_poll_in(htif_dev, &raw);
		if (rc == 0) {
			if (feed_parser((uint8_t)raw)) {
				while (staged_off < staged_len && out < len) {
					buf[out++] = staged_payload[staged_off++];
				}
				return out;
			}
			continue;
		}
		k_msleep(slice_ms);
	}
}
```

## src/transport_htif.h
```c
/*
 * SPDX-License-Identifier: Apache-2.0
 *
 * micro-ROS custom transport over HTIF with HDLC-style framing, so micro-ROS
 * bytes coexist with printk on the shared HTIF console. The four hooks here
 * are wired in via rmw_uros_set_custom_transport() in main.c.
 *
 * Frame format (one frame per transport_write() call):
 *
 *     0x7E  <escaped payload>  <escaped CRC16-CCITT, big-endian>  0x7E
 *
 * Escape rule:  0x7E -> 0x7D 0x5E,   0x7D -> 0x7D 0x5D
 *
 * On read, a Zephyr thread polls HTIF byte-by-byte, drops bytes that aren't
 * inside a frame (those are interleaved printk output, ignored by the
 * transport), unescapes payload, validates CRC, and pushes the payload onto
 * a ring buffer that transport_read() drains.
 */
#ifndef MICRO_ROS_MULTINODE_TRANSPORT_HTIF_H
#define MICRO_ROS_MULTINODE_TRANSPORT_HTIF_H

#include <stdbool.h>
#include <stddef.h>
#include <stdint.h>

struct uxrCustomTransport;

#ifdef __cplusplus
extern "C" {
#endif

bool   htif_transport_open(struct uxrCustomTransport *t);
bool   htif_transport_close(struct uxrCustomTransport *t);
size_t htif_transport_write(struct uxrCustomTransport *t,
                            const uint8_t *buf, size_t len, uint8_t *err);
size_t htif_transport_read(struct uxrCustomTransport *t,
                           uint8_t *buf, size_t len, int timeout_ms, uint8_t *err);

#ifdef __cplusplus
}
#endif

#endif
```
